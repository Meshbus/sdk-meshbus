## dts/bindings/sensor/zephyr,compass-composite.yaml
```yaml
# Copyright (c) 2026 FoBE Studio
# SPDX-License-Identifier: Apache-2.0

description: |
  Composite compass sensor constructed from accelerometer, gyroscope, and
  magnetometer sources.

  The driver performs tilt-compensated heading estimation from accel + magnet,
  then applies heading-domain complementary fusion with gyro short-term
  prediction and adaptive magnetic correction.

compatible: zephyr,compass-composite

include: [sensor-device.yaml]

properties:
  accel-source:
    type: phandle
    required: true
    description: Accelerometer sensor source device.

  gyro-source:
    type: phandle
    required: true
    description: Gyroscope sensor source device.

  magn-source:
    type: phandle
    required: true
    description: Magnetometer sensor source device.

  accel-channel:
    type: int
    default: 3
    description: |
      Accelerometer channel read from accel-source.
      Default is SENSOR_CHAN_ACCEL_XYZ.

  gyro-channel:
    type: int
    default: 7
    description: |
      Gyroscope channel read from gyro-source.
      Default is SENSOR_CHAN_GYRO_XYZ.

  magn-channel:
    type: int
    default: 11
    description: |
      Magnetometer channel read from magn-source.
      Default is SENSOR_CHAN_MAGN_XYZ.

  source-startup-delay-ms:
    type: int
    default: 25
    description: |
      Maximum source warm-up interval in milliseconds. The driver waits this
      long after resuming a suspended source and retries one invalid first
      sample once. Set to 0 only when every source can return valid data
      immediately after resume.

  source-idle-timeout-ms:
    type: int
    default: 250
    description: |
      Runtime-PM idle grace period in milliseconds. With asynchronous runtime
      PM enabled, source suspension is deferred by this interval so periodic
      compass reads avoid repeated power cycling and sensor warm-up. Set to 0
      for immediate suspension after each sample.

  calibration-sample-period-ms:
    type: int
    default: 100
    description: |
      Minimum interval in milliseconds between samples admitted to the rolling
      magnetometer calibration window. Heading and gyro fusion still run on
      every fetch. Keeping calibration sampling time-based prevents a faster
      output rate from shortening the physical-motion history represented by
      the fixed-size calibration window. Set to 0 to admit every sample.

  declination-milli-deg:
    type: int
    default: 0
    description: |
      Local magnetic declination in milli-degrees used as boot default.
      Positive values rotate heading eastward and negative values westward.
      Runtime can override this value through SENSOR_ATTR_COMPASS_DECLINATION.

  mount-offset-milli-deg:
    type: int
    default: 0
    description: |
      Board/assembly yaw mounting offset in milli-degrees used as boot default.
      Positive values rotate heading eastward and negative values westward.
      Runtime can override this value through SENSOR_ATTR_COMPASS_MOUNT_OFFSET.

  gyro-fusion-alpha-milli:
    type: int
    default: 980
    description: |
      Base fusion alpha in milli-scale [0, 1000].
      This controls heading-domain complementary fusion: higher values trust
      gyro integration more, lower values increase magnetic correction. The
      value describes retention over a 100 ms reference interval; the driver
      normalizes magnetic correction to the actual elapsed sample time.
      Runtime can override this value through SENSOR_ATTR_COMPASS_FUSION_ALPHA.

  imu-rate-override-supported:
    type: boolean
    description: |
      Declare that both accel-source and gyro-source implement readable and
      writable SENSOR_ATTR_SAMPLING_FREQUENCY attributes. When absent, the
      composite does not advertise COMPASS_CAP_RATE_OVERRIDE and rejects the
      optional interactive-rate attribute with -ENOTSUP.

  accel-axis-remap:
    type: array
    default: [0, 1, 2]
    description: |
      Axis remap indices applied to accelerometer vector. Three entries, each
      in range [0, 2], defining output {x,y,z} source axis indices.

  accel-axis-sign:
    type: array
    default: [1, 1, 1]
    description: |
      Axis sign multipliers applied after accel-axis-remap. Three entries, each
      either 1 or -1.

  gyro-axis-remap:
    type: array
    description: |
      Axis remap indices applied to gyroscope vector. Three entries, each in
      range [0, 2], defining output {x,y,z} source axis indices. If omitted,
      accel-axis-remap is used.

  gyro-axis-sign:
    type: array
    description: |
      Axis sign multipliers applied after gyro-axis-remap. Three entries, each
      either 1 or -1. If omitted, accel-axis-sign is used.

  magn-axis-remap:
    type: array
    default: [0, 1, 2]
    description: |
      Axis remap indices applied to magnetometer vector. Three entries, each in
      range [0, 2], defining output {x,y,z} source axis indices.

  magn-axis-sign:
    type: array
    default: [1, 1, 1]
    description: |
      Axis sign multipliers applied after magn-axis-remap. Three entries, each
      either 1 or -1.
```

## modules/detools/Kconfig
```kconfig
# Copyright (c) 2026 FoBE Studio
# SPDX-License-Identifier: Apache-2.0

config ZEPHYR_DETOOLS_MODULE
	bool

config DETOOLS
	bool "zcbor DETOOLS library"
	depends on ZEPHYR_DETOOLS_MODULE
	depends on HEATSHRINK
	help
	  DETOOLS decoder library
```

## modules/heatshrink/Kconfig
```kconfig
# Copyright (c) 2026 FoBE Studio
# SPDX-License-Identifier: Apache-2.0

config ZEPHYR_HEATSHRINK_MODULE
	bool

config HEATSHRINK
	bool "Heatshrink library"
	depends on ZEPHYR_HEATSHRINK_MODULE
	help
	  Heatshrink decoder library
```

## modules/meshcore/Kconfig
```kconfig
# Copyright (c) 2026 FoBE Studio
# SPDX-License-Identifier: Apache-2.0

config MESHCORE
	bool "MeshCore C library"
	depends on ZEPHYR_MESHCORE_MODULE
	help
	  MeshCore platform-neutral C protocol/runtime library.
```

## samples/subsys/bluetooth/sample.yaml
```yaml
# SPDX-FileCopyrightText: FoBE Studio
# SPDX-License-Identifier: Apache-2.0

sample:
  name: Meshbus Bluetooth service
  description: Starts Meshbus Bluetooth for board shell, BLE, notify, and MCUmgr manual validation
common:
  tags:
    - meshbus
    - bluetooth
  harness: keyboard
tests:
  sample.subsys.meshbus.services.bluetooth:
    platform_allow:
      - mesh_probe_r2/nrf54l15/cpuapp
    integration_platforms:
      - mesh_probe_r2/nrf54l15/cpuapp
```

## samples/subsys/contact/sample.yaml
```yaml
# SPDX-FileCopyrightText: FoBE Studio
# SPDX-License-Identifier: Apache-2.0

sample:
  name: Meshbus contact service
  description: Starts Meshbus contact and logs request/response channels for board shell manual validation
common:
  tags:
    - meshbus
    - contact
  harness: keyboard
tests:
  sample.subsys.meshbus.services.contact:
    integration_platforms:
      - mesh_probe_r2/nrf54l15/cpuapp
      - tracker_t1000_e
```

## samples/subsys/display/zui/draw/sample.yaml
```yaml
sample:
  description: ZUI draw primitive visual sample
  name: zui draw sample
common:
  tags: zui draw
  build_only: true
tests:
  sample.zui.draw:
    integration_platforms:
      - idea_mesh_tracker_c2/nrf54l15/cpuapp
```

## samples/subsys/display/zui/input/sample.yaml
```yaml
sample:
  name: ZUI input sample
tests:
  sample.subsys.zui.input:
    build_only: true
    platform_allow:
      - idea_mesh_tracker_c2/nrf54l15/cpuapp
    tags:
      - zui
      - input
```

## samples/subsys/gnss/boards/idea_mesh_tracker_c2_nrf54l15_cpuapp.conf
```kconfig
# Peripherals
CONFIG_GPIO=y
CONFIG_SERIAL=y
CONFIG_UART_INTERRUPT_DRIVEN=y

CONFIG_GNSS=y
CONFIG_GNSS_QUECTEL_L76K=y
CONFIG_GNSS_SATELLITES=y

# Power Management
CONFIG_PM_DEVICE=y
CONFIG_PM_DEVICE_RUNTIME=y
CONFIG_PM_DEVICE_SHELL=y
CONFIG_POWER_DOMAIN=y
CONFIG_PM_DEVICE_POWER_DOMAIN=y
```

## samples/subsys/gnss/boards/tracker_t1000_e.conf
```kconfig
# Nordic SoC
CONFIG_SOC_FLASH_NRF_EMULATE_ONE_BYTE_WRITE_ACCESS=y

# Peripherals
CONFIG_GPIO=y
CONFIG_GPIO_HOGS=y
CONFIG_SERIAL=y
CONFIG_UART_INTERRUPT_DRIVEN=y

# GNSS
CONFIG_GNSS=y
CONFIG_GNSS_REFERENCE_FRAME_WGS84=y
CONFIG_GNSS_NMEA_GENERIC=y
CONFIG_GNSS_SATELLITES=y
CONFIG_GNSS_NMEA_GENERIC_SATELLITES_COUNT=32
CONFIG_MODEM_BACKEND_UART_ISR_RECEIVE_IDLE_TIMEOUT_MS=8

# Power Management
CONFIG_PM_DEVICE=y
CONFIG_PM_DEVICE_RUNTIME=y
CONFIG_PM_DEVICE_SHELL=y
CONFIG_POWER_DOMAIN=y
CONFIG_PM_DEVICE_POWER_DOMAIN=y
CONFIG_PM_DEVICE_RUNTIME_ASYNC=y
```

## samples/subsys/gnss/sample.yaml
```yaml
# SPDX-FileCopyrightText: FoBE Studio
# SPDX-License-Identifier: Apache-2.0

sample:
  name: Meshbus GNSS service
  description: Starts Meshbus GNSS for board shell and live GNSS manual validation
common:
  tags:
    - meshbus
    - gnss
  harness: keyboard
tests:
  sample.subsys.meshbus.services.gnss:
    platform_allow:
      - mesh_probe_r2/nrf54l15/cpuapp
    integration_platforms:
      - mesh_probe_r2/nrf54l15/cpuapp
```

## samples/subsys/indicator/boards/tracker_t1000_e.conf
```kconfig
# SPDX-FileCopyrightText: FoBE Studio
# SPDX-License-Identifier: Apache-2.0

# Nordic SoC
CONFIG_SOC_FLASH_NRF_EMULATE_ONE_BYTE_WRITE_ACCESS=y

# Peripherals
CONFIG_GPIO=y
CONFIG_GPIO_HOGS=y
CONFIG_PWM=y
CONFIG_LED=y
CONFIG_LED_PWM=n

# Power Management
CONFIG_PM_DEVICE=y
CONFIG_PM_DEVICE_RUNTIME=y
CONFIG_PM_DEVICE_SHELL=y
CONFIG_POWER_DOMAIN=y
CONFIG_PM_DEVICE_POWER_DOMAIN=y
CONFIG_PM_DEVICE_RUNTIME_ASYNC=y
```

## samples/subsys/indicator/sample.yaml
```yaml
# SPDX-FileCopyrightText: FoBE Studio
# SPDX-License-Identifier: Apache-2.0

sample:
  name: Meshbus indicator service
  description: Starts Meshbus indicator for board shell, LED, and buzzer manual validation
common:
  tags:
    - meshbus
    - indicator
  harness: keyboard
tests:
  sample.subsys.meshbus.services.indicator:
    platform_allow:
      - mesh_probe_r2/nrf54l15/cpuapp
    integration_platforms:
      - mesh_probe_r2/nrf54l15/cpuapp
```

## samples/subsys/meshbus/services/gnss/sample.yaml
```yaml
sample:
  name: Meshbus GNSS service
  description: Starts Meshbus GNSS for board shell and live GNSS manual validation
common:
  tags:
    - meshbus
    - gnss
  harness: keyboard
tests:
  sample.subsys.meshbus.services.gnss:
    platform_allow:
      - idea_mesh_tracker_c2/nrf54l15/cpuapp
    integration_platforms:
      - idea_mesh_tracker_c2/nrf54l15/cpuapp
```

## samples/subsys/meshbus/services/radio/sample.yaml
```yaml
sample:
  name: Meshbus radio service
  description: Starts Meshbus radio for board shell and LoRa manual validation
common:
  tags:
    - meshbus
    - radio
  harness: keyboard
tests:
  sample.subsys.meshbus.services.radio:
    platform_allow:
      - idea_mesh_tracker_c2/nrf54l15/cpuapp
    integration_platforms:
      - idea_mesh_tracker_c2/nrf54l15/cpuapp
```

## samples/subsys/power/boards/idea_mesh_tracker_c2_nrf54l15_cpuapp.conf
```kconfig
# Peripherals
CONFIG_GPIO=y

# Power Management
CONFIG_PM_DEVICE=y
CONFIG_PM_DEVICE_RUNTIME=y
CONFIG_PM_DEVICE_SHELL=y
CONFIG_POWER_DOMAIN=y
CONFIG_PM_DEVICE_POWER_DOMAIN=y
CONFIG_PM_DEVICE_RUNTIME_ASYNC=y
CONFIG_FUEL_GAUGE=y
CONFIG_FUEL_GAUGE_COMPOSITE=y
CONFIG_CHARGER=y
CONFIG_CHARGER_COMPOSITE=y

CONFIG_POWEROFF=y
CONFIG_REBOOT=y
```

## samples/subsys/power/boards/tracker_t1000_e.conf
```kconfig
# Nordic SoC
CONFIG_SOC_FLASH_NRF_EMULATE_ONE_BYTE_WRITE_ACCESS=y

# Peripherals
CONFIG_GPIO=y
CONFIG_GPIO_HOGS=y

# Power Management
CONFIG_PM_DEVICE=y
CONFIG_PM_DEVICE_RUNTIME=y
CONFIG_PM_DEVICE_SHELL=y
CONFIG_POWER_DOMAIN=y
CONFIG_PM_DEVICE_POWER_DOMAIN=y
CONFIG_PM_DEVICE_RUNTIME_ASYNC=y
CONFIG_FUEL_GAUGE=y
CONFIG_FUEL_GAUGE_COMPOSITE=y
CONFIG_CHARGER=y
CONFIG_CHARGER_COMPOSITE=y

CONFIG_POWEROFF=y
CONFIG_REBOOT=y
```

## samples/subsys/power/sample.yaml
```yaml
# SPDX-FileCopyrightText: FoBE Studio
# SPDX-License-Identifier: Apache-2.0

sample:
  name: Meshbus power service
  description: Starts Meshbus power for board shell, fuel gauge, charger, and shutdown manual validation
common:
  tags:
    - meshbus
    - power
  harness: keyboard
tests:
  sample.subsys.meshbus.services.power:
    platform_allow:
      - mesh_probe_r2/nrf54l15/cpuapp
    integration_platforms:
      - mesh_probe_r2/nrf54l15/cpuapp
```

## samples/subsys/radio/boards/devkit_nrf54l15_nrf54l15_cpuapp.conf
```kconfig
# SPDX-FileCopyrightText: FoBE Studio
# SPDX-License-Identifier: Apache-2.0

# Peripherals
CONFIG_GPIO=y
CONFIG_SPI=y
```

## samples/subsys/radio/sample.yaml
```yaml
# SPDX-FileCopyrightText: FoBE Studio
# SPDX-License-Identifier: Apache-2.0

sample:
  name: Meshbus radio service
  description: Starts Meshbus radio for board shell and LoRa manual validation
common:
  tags:
    - meshbus
    - radio
  harness: keyboard
tests:
  sample.subsys.meshbus.services.radio:
    platform_allow:
      - mesh_probe_r2/nrf54l15/cpuapp
    integration_platforms:
      - mesh_probe_r2/nrf54l15/cpuapp
```

## samples/subsys/telemetry/boards/idea_mesh_tracker_c2_nrf54l15_cpuapp.conf
```kconfig
# Peripherals
CONFIG_GPIO=y
CONFIG_GPIO_HOGS=y

# Power Management
CONFIG_PM_DEVICE=y
CONFIG_PM_DEVICE_RUNTIME=y
CONFIG_PM_DEVICE_SHELL=y
CONFIG_POWER_DOMAIN=y
CONFIG_PM_DEVICE_POWER_DOMAIN=y
CONFIG_PM_DEVICE_RUNTIME_ASYNC=y

CONFIG_I2C=y

CONFIG_SENSOR=y
CONFIG_SENSOR_SHELL=y

CONFIG_LSM6DSL_GYRO_ODR=1
CONFIG_LSM6DSL_ACCEL_ODR=1
CONFIG_LSM6DSL_ENABLE_TEMP=y
CONFIG_LSM6DSL_TRIGGER_NONE=y
```

## samples/subsys/telemetry/sample.yaml
```yaml
# SPDX-FileCopyrightText: FoBE Studio
# SPDX-License-Identifier: Apache-2.0

sample:
  name: Meshbus telemetry service
  description: Starts Meshbus telemetry and logs live sensor channel events for board shell manual validation
common:
  tags:
    - meshbus
    - telemetry
  harness: keyboard
tests:
  sample.subsys.meshbus.services.telemetry:
    platform_allow:
      - mesh_probe_r2/nrf54l15/cpuapp
    integration_platforms:
      - mesh_probe_r2/nrf54l15/cpuapp
```
