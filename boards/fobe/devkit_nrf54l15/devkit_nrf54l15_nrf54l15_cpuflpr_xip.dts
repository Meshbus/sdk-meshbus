/*
 * Copyright (c) 2026 FoBE Studio
 * SPDX-License-Identifier: Apache-2.0
 */

#include "devkit_nrf54l15_nrf54l15_cpuflpr.dts"

/delete-node/ &cpuflpr_sram;

&{/soc} {
	cpuflpr_sram: memory@2002f000 {
		compatible = "mmio-sram";
		reg = <0x2002f000 DT_SIZE_K(68)>;
		#address-cells = <1>;
		#size-cells = <1>;
		ranges = <0x0 0x2002f000 DT_SIZE_K(68)>;
	};
};
