/dts-v1/;

#include <nordic/nrf54l15_cpuapp.dtsi>
#include "nrf54l15_cpuapp_common.dtsi"

/ {
	compatible = "fobe,idea_mesh_tracker_c2-nrf54l15-cpuapp";
	model = "FoBE IDEA Mesh Tracker C2 nRF54L15 Application MCU";

	chosen {
		zephyr,code-partition = &slot0_partition;
		zephyr,sram = &cpuapp_sram;
	};
};

&uicr {
	nfct-pins-as-gpios;
};

/* Include default memory partition configuration file */
#include <vendor/nordic/nrf54l15_cpuapp_partition.dtsi>
