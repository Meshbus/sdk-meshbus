## boards/seeed/tracker_t1000_e/board.yml
```yaml
# SPDX-FileCopyrightText: FoBE Studio
# SPDX-License-Identifier: Apache-2.0

board:
  name: tracker_t1000_e
  full_name: SenseCAP Card Tracker T1000-E
  vendor: seeed
  socs:
  - name: nrf52840
```

## bootloader/Kconfig
```kconfig
# SPDX-FileCopyrightText: FoBE Studio
# SPDX-License-Identifier: Apache-2.0

if MCUBOOT

rsource "mcuboot/Kconfig"

endif # MCUBOOT
```

## bootloader/mcuboot/Kconfig
```kconfig
# SPDX-FileCopyrightText: FoBE Studio
# SPDX-License-Identifier: Apache-2.0

rsource "boot/Kconfig"
```

## bootloader/mcuboot/boot/Kconfig
```kconfig
# SPDX-License-Identifier: Apache-2.0

rsource "boot_bluetooth/Kconfig"
rsource "indicator/Kconfig"
```

## bootloader/mcuboot/boot/boot_bluetooth/Kconfig
```kconfig
# SPDX-License-Identifier: Apache-2.0

config MCUBOOT_BOOT_BLUETOOTH
	bool "FoBE MCUboot BLE SMP recovery bridge"
	depends on MCUBOOT
	depends on MCUBOOT_SERIAL
	depends on BT
	select CRC
	help
	  Enable the FoBE BLE SMP bridge for MCUboot serial recovery.

	  This is a bootloader-only transport adapter. It exposes the standard
	  SMP-over-Bluetooth GATT service and bridges requests into MCUboot's
	  boot_serial backend, so mobile and host mcumgr tools can use the same
	  recovery implementation as UART serial recovery.
```

## bootloader/mcuboot/boot/indicator/Kconfig
```kconfig
# SPDX-FileCopyrightText: FoBE Studio
# SPDX-License-Identifier: Apache-2.0

config MCUBOOT_INDICATOR
	bool "FoBE MCUboot status indicator"
	depends on MCUBOOT
	depends on MCUBOOT_ACTION_HOOKS
	depends on GPIO
	help
	  Enable FoBE bootloader status indication hooks for MCUboot.

	  The current implementation uses the mcuboot-led0 devicetree alias for
	  recovery status and wraps serial console read/write calls to show
	  recovery traffic activity.
```

## drivers/Kconfig
```kconfig
# Copyright (c) 2026 FoBE Studio
# SPDX-License-Identifier: Apache-2.0

menu "Device Drivers"

rsource "charger/Kconfig"
rsource "display/Kconfig"
rsource "sensor/Kconfig"
rsource "gnss/Kconfig"
rsource "input/Kconfig"
rsource "mfd/Kconfig"

endmenu
```

## drivers/adc/Kconfig
```kconfig
# Copyright (c) 2026 FoBE Studio
# SPDX-License-Identifier: Apache-2.0

if ADC

rsource "Kconfig.ads1110"

endif # ADC
```

## drivers/adc/Kconfig.ads1110
```kconfig
# ADS1110 ADC configuration options

# Copyright (c) 2026 FoBE Studio
# SPDX-License-Identifier: Apache-2.0

config ADC_ADS1110
	bool "Texas Instruments ADS1110 ADC driver"
	depends on DT_HAS_TI_ADS1110_ENABLED
	default y
	select I2C
	select ADC_CONFIGURABLE_INPUTS
	help
	  Enable the driver implementation for the ADS1110

if ADC_ADS1110

config ADC_ADS1110_ACQUISITION_THREAD_STACK_SIZE
	int "ADS1110 acquisition thread stack size"
	default 768
	help
	  Stack size for the ADS1110 acquisition thread used to wait for
	  single-shot conversion completion.

config ADC_ADS1110_ACQUISITION_THREAD_PRIORITY
	int "ADS1110 acquisition thread priority"
	default 0
	help
	  Priority for the ADS1110 acquisition thread.

endif # ADC_ADS1110
```

## drivers/charger/Kconfig
```kconfig
# Copyright (c) 2025 FoBE Projects
# SPDX-License-Identifier: Apache-2.0

if CHARGER

rsource "Kconfig.charger_composite"

endif # CHARGER
```

## drivers/charger/Kconfig.charger_composite
```kconfig
# Copyright (c) 2025 FoBE Projects
# SPDX-License-Identifier: Apache-2.0

config CHARGER_COMPOSITE
	bool "Zephyr composite charger driver"
	default y
	depends on CHARGER
	depends on DT_HAS_ZEPHYR_CHARGER_COMPOSITE_ENABLED
	imply SENSOR
	imply FUEL_GAUGE
	help
	  Enable driver for the Zephyr composite charger device.

	  This driver combines voltage readings from a sensor or fuel-gauge
	  device with GPIO-based charging status detection to provide a
	  complete charger interface.

	  If only GPIO-based detection is needed (without voltage source),
	  the driver will still work but cannot detect FULL state based on
	  voltage threshold.

if CHARGER_COMPOSITE

config CHARGER_COMPOSITE_DATA_VALIDITY_MS
	int "Data from sensor_fetch is cached for this long (ms)"
	default 150
	help
	  To ensure that data is consistent across multiple calls to
	  charger_get_prop, sensor_fetch is only called if at least
	  this long has passed since the previous call.

endif # CHARGER_COMPOSITE
```

## drivers/display/Kconfig
```kconfig
# Copyright (c) 2026 FoBE Studio
# SPDX-License-Identifier: Apache-2.0

config MODULINO_LED_MATRIX
	bool "Arduino Modulino LED Matrix display"
	default y
	depends on DISPLAY && I2C
	depends on DT_HAS_ARDUINO_MODULINO_LED_MATRIX_ENABLED
	help
	  Drive a 12x8 Modulino LED Matrix running Arduino node_modulino_firmware
	  over I2C. Supports vertically tiled MONO01 and packed L_4 grayscale.
	  See samples/drivers/display/modulino_led_matrix/README.md for usage
	  and firmware protocol limitations.
```

## drivers/ethernet/Kconfig.ch390
```kconfig
# Copyright (c) 2026 FoBE Studio
# SPDX-License-Identifier: Apache-2.0

menuconfig ETH_CH390
	bool "WCH CH390 Ethernet Controller"
	depends on NETWORKING
	depends on NET_L2_ETHERNET
	depends on SPI
	depends on GPIO
	depends on DT_HAS_WCH_CH390_ENABLED
	select NET_CHECKSUM_OFFLOAD_SUPPORTED if NET_L2_ETHERNET
	help
	  WCH CH390D/H Ethernet controller with SPI interface.

config ETH_CH390_RX_THREAD_STACK_SIZE
	int "Stack size for CH390 RX worker"
	depends on ETH_CH390
	default 8192
	help
	  Stack size for the internal worker thread that drains RX packets
	  after a CH390 interrupt.

config ETH_CH390_RX_THREAD_PRIO
	int "Priority for CH390 RX worker"
	depends on ETH_CH390
	default 2
	help
	  Cooperative priority for the internal worker thread that drains
	  RX packets after a CH390 interrupt.

config ETH_CH390_TIMEOUT
	int "CH390 network buffer timeout"
	depends on ETH_CH390
	default 100
	help
	  Maximum amount of time in milliseconds that the driver will wait
	  for a network buffer before dropping an Ethernet frame.

config ETH_CH390_FLOW_CONTROL
	bool "Enable pause-based flow control policy"
	depends on ETH_CH390
	default y
	help
	  Enable pause advertisement and runtime flow-control policy updates
	  based on link negotiation state.

config ETH_CH390_ALLMULTI_DEFAULT
	bool "Enable ALLMULTI by default"
	depends on ETH_CH390
	default n
	help
	  Accept all multicast traffic by default at driver startup.
```

## drivers/gnss/Kconfig
```kconfig
# Copyright (c) 2026 FoBE Studio
# SPDX-License-Identifier: Apache-2.0

if GNSS

rsource "Kconfig.quectel_l76k"

endif
```

## drivers/gnss/Kconfig.quectel_l76k
```kconfig
# Copyright (c) 2026 FoBE Studio
# SPDX-License-Identifier: Apache-2.0

config GNSS_QUECTEL_L76K
	bool "Quectel L76K GNSS modem driver"
	default y
	depends on GNSS
	depends on DT_HAS_QUECTEL_L76K_ENABLED
	select MODEM_MODULES
	select MODEM_BACKEND_UART
	select MODEM_CHAT
	select GNSS_PARSE
	select GNSS_NMEA0183
	select GNSS_NMEA0183_MATCH
	select UART_USE_RUNTIME_CONFIGURE
	help
	  Enable Quectel L76K GNSS modem driver.
	  The L76K is based on the CASIC AT6558R chipset and supports
	  GPS, GLONASS, BeiDou, and QZSS constellations.

if GNSS_QUECTEL_L76K

config GNSS_QUECTEL_L76K_UART_RX_BUF_SIZE
	int "Size of UART backend receive buffer"
	default 512
	help
	  Size of the UART receive buffer in bytes. Should be large enough
	  to hold multiple NMEA sentences. Increase if data is being lost
	  at higher baud rates.

config GNSS_QUECTEL_L76K_UART_TX_BUF_SIZE
	int "Size of UART backend transmit buffer"
	default 128
	help
	  Size of the UART transmit buffer in bytes. Used for sending
	  PCAS configuration commands to the module.

config GNSS_QUECTEL_L76K_CHAT_RX_BUF_SIZE
	int "Size of modem chat receive buffer"
	default 256
	help
	  Size of the modem chat receive buffer in bytes. Should be large
	  enough to hold a complete NMEA sentence (max ~82 characters) plus
	  some margin.

if GNSS_SATELLITES

config GNSS_QUECTEL_L76K_SAT_ARRAY_SIZE
	int "Size of GNSS satellites array"
	default 32

endif # GNSS_SATELLITES

endif # GNSS_QUECTEL_L76K
```

## drivers/input/Kconfig
```kconfig
# Copyright (c) 2025 FoBE Projects
# SPDX-License-Identifier: Apache-2.0

if INPUT

rsource "Kconfig.tca8418"

endif # INPUT
```

## drivers/input/Kconfig.tca8418
```kconfig
# Copyright (c) 2025 FoBE Projects
# SPDX-License-Identifier: Apache-2.0

config INPUT_TCA8418
	bool "TI TCA8418 keyboard matrix scan driver"
	default y
	depends on INPUT
	depends on DT_HAS_TI_TCA8418_KBD_ENABLED
	depends on MFD_TCA8418
	help
	  Enable keyboard matrix scan driver for Texas Instruments TCA8418.
	  This driver works as a child of the TCA8418 MFD driver and supports
	  up to 80 keys (8x10 matrix) with integrated debounce and 10-event FIFO.
```

## drivers/led/Kconfig
```kconfig
# Copyright (c) 2026 FoBE Studio
# SPDX-License-Identifier: Apache-2.0

menuconfig LED_FOBE_LP5024_MONO
	bool "FoBE LP5024 mono LED driver"
	depends on LED && I2C
	depends on DT_HAS_FOBE_LP5024_MONO_ENABLED
	help
	  Single-channel LP5024 LED driver for boards that want to expose LP5024
	  outputs as individual mono LEDs through the Zephyr LED API.
```

## drivers/mfd/Kconfig
```kconfig
# Copyright (c) 2025 FoBE Projects
# SPDX-License-Identifier: Apache-2.0

if MFD

rsource "Kconfig.tca8418"

endif # MFD
```

## drivers/mfd/Kconfig.tca8418
```kconfig
# Copyright (c) 2025 FoBE Projects
# SPDX-License-Identifier: Apache-2.0

config MFD_TCA8418
	bool "TI TCA8418 I2C keypad/GPIO multi-function device driver"
	default y
	depends on MFD
	depends on DT_HAS_TI_TCA8418_ENABLED
	select I2C
	help
	  Enable the TI TCA8418 multi-function device driver.
	  This device provides keypad matrix scanning and GPIO expansion
	  functionality via I2C bus. Child devices (keyboard, GPIO) should
	  be defined under the MFD parent node.
```

## drivers/sensor/Kconfig
```kconfig
# Copyright (c) 2026 FoBE Studio
# SPDX-License-Identifier: Apache-2.0

if SENSOR

rsource "composite/Kconfig"
rsource "qst/Kconfig"
rsource "st/lsm6ds3_family/Kconfig"

endif # SENSOR
```
