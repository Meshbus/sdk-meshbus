## subsys/meshbus/services/notify/Kconfig
```kconfig
# Copyright (c) 2026 FoBE Studio
# SPDX-License-Identifier: Apache-2.0

menuconfig MESHBUS_NOTIFY
	bool "Meshbus notify subsystem"
	depends on ZBUS
	default n
	help
	  Enable Meshbus notify subsystem.

if MESHBUS_NOTIFY
module = MESHBUS_NOTIFY
module-str = meshbus_notify
module-help = Sets log level for Meshbus notify service
source "subsys/logging/Kconfig.template.log_config"

config MESHBUS_NOTIFY_SHELL
	bool "Notify shell commands"
	depends on MESHBUS_SHELL
	default y
	help
	  Enable shell commands for publishing notify messages.

config MESHBUS_NOTIFY_TRANSPORT_SERIAL
	bool "Publish MBN1 Notify frames over the MCUmgr UART"
	depends on MCUMGR_TRANSPORT_UART
	default n
	help
	  Publish Notify payloads as MBN1 sideband frames on the UART selected
	  by zephyr,uart-mcumgr. Leave this disabled when UART MCUmgr shares the
	  UART with console logging: this transport writes synchronously and
	  cannot safely interleave with SMP responses.

endif # MESHBUS_NOTIFY
```

## subsys/meshbus/services/power/Kconfig
```kconfig
# Copyright (c) 2026 FoBE Studio
# SPDX-License-Identifier: Apache-2.0

menuconfig MESHBUS_POWER
	bool "Meshbus Power Management"
	select POWEROFF
	select REBOOT
	default n
	help
	  Enable Meshbus power management subsystem for sleep control,
	  battery monitoring, and power optimization.

if MESHBUS_POWER

module = MESHBUS_POWER
module-str = meshbus_power
module-dep = MESHBUS
source "subsys/logging/Kconfig.template.log_config"

config MESHBUS_POWER_SAMPLE_INTERVAL
	int "Meshbus Power sample interval (ms)"
	default 20000
	range 1000 30000
	help
	  Set the interval in milliseconds for refreshing cached fuel-gauge
	  and charger status over Meshbus. Default is 20000 ms (20 seconds).

config MESHBUS_POWER_SHELL
	bool "Meshbus Power shell commands"
	depends on MESHBUS_SHELL
	default y
	help
	  Enable shell commands for Meshbus power module.

config MESHBUS_POWER_STATS
	bool "Meshbus Power statistics"
	depends on MESHBUS_STATS
	default y
	help
	  Enable statistics collection for Meshbus power module.

config MESHBUS_POWER_BOOTLOADER_GPREGRET
	bool "Use nRF GPREGRET bootloader handoff"
	depends on SOC_SERIES_NRF52 && HAS_HW_NRF_POWER
	help
	  Enable bootloader recovery handoff by writing the nRF GPREGRET
	  register before reboot. This is used by Adafruit nRF52 UF2/CDC
	  bootloaders, which enter bootloader mode when GPREGRET[0] is set
	  to 0x57 before a soft reset.

config MESHBUS_POWER_BACK_HOLD_SHUTDOWN
	bool "Enable BACK hold shutdown gesture"
	depends on MESHBUS_INPUT
	default y
	help
	  Enable a no-screen shutdown gesture on BACK. Holding BACK can play
	  shutdown cue ticks starting around 3 seconds, play a release cue
	  around 6 seconds when Meshbus Indicator is enabled, and shuts down
	  only when BACK is released during the following confirmation window.

endif # MESHBUS_POWER
```

## subsys/meshbus/services/telemetry/Kconfig
```kconfig
# Copyright (c) 2026 FoBE Studio
# SPDX-License-Identifier: Apache-2.0

menuconfig MESHBUS_TELEMETRY
	bool "Meshbus Telemetry Management Layer"
	depends on SENSOR
	default n
	help
	  Enable the Meshbus telemetry management layer which provides:
	  - Periodic collection from devicetree-bound sensor channels
	  - ZBus event publishing for aggregated sensor data
	  - Sampling-policy persistence via Settings
	  - Telemetry statistics via Zephyr Stats

if MESHBUS_TELEMETRY

module = MESHBUS_TELEMETRY
module-str = meshbus_telemetry
module-dep = MESHBUS
module-help = Sets log level for Meshbus Telemetry module
source "subsys/logging/Kconfig.template.log_config"

config MESHBUS_TELEMETRY_DEFAULT_ENABLED
	bool "Default telemetry enabled"
	default y
	help
	  Default runtime enable state for telemetry.
	  This is the initial value before settings storage is loaded.

config MESHBUS_TELEMETRY_MIN_SAMPLE_INTERVAL
	int "Minimum sample interval in milliseconds"
	default 5000
	range 1 $(UINT32_MAX)
	help
	  Minimum allowed interval between telemetry samples.
	  Used for validation when applying runtime configuration.

config MESHBUS_TELEMETRY_DEFAULT_SAMPLE_INTERVAL
	int "Default sample interval in milliseconds"
	default 30000
	range MESHBUS_TELEMETRY_MIN_SAMPLE_INTERVAL $(UINT32_MAX)
	help
	  Default interval between telemetry updates in milliseconds.
	  Can be changed at runtime via configuration API (and validated against
	  MESHBUS_TELEMETRY_MIN_SAMPLE_INTERVAL).

config MESHBUS_TELEMETRY_SHELL
	bool "Meshbus Telemetry shell commands"
	depends on MESHBUS_SHELL
	default y
	help
	  Enable shell commands for Meshbus Telemetry subsystem.
	  Provides commands for telemetry configuration and diagnostics.

config MESHBUS_TELEMETRY_STATS
	bool "Meshbus Telemetry statistics"
	depends on MESHBUS_STATS
	default y
	help
	  Enable statistics for Meshbus Telemetry subsystem.

endif # MESHBUS_TELEMETRY
```

## subsys/meshcore/Kconfig
```kconfig
# Copyright (c) 2026 FoBE Studio
# SPDX-License-Identifier: Apache-2.0

menuconfig MBS_MESHCORE
	bool "Meshbus MeshCore service [EXPERIMENTAL]"
	default n
	depends on SETTINGS
	depends on ZEPHYR_MESHCORE_MODULE
	select MESHCORE
	select REBOOT
	select ENTROPY_GENERATOR
	select EXPERIMENTAL
	help
	  Enable the Meshbus MeshCore service.

	  This service hosts the Zephyr-facing MeshCore runtime and Companion
	  protocol adapters while keeping lib/meshcore as platform-neutral C code.

if MBS_MESHCORE

module = MBS_MESHCORE
module-str = mbs_meshcore
module-dep = MBS
module-help = Sets log level for Meshbus MeshCore service
source "subsys/logging/Kconfig.template.log_config"

config MBS_MESHCORE_NAME_PUBKEY_PREFIX_BYTES
	int "Default MeshCore name pubkey prefix bytes"
	default 3
	range 1 15
	help
	  When mbs_meshcore_config_set() is called with an empty name, the
	  MeshCore service auto-fills a stable default name using the first N
	  bytes of the public key, encoded as uppercase hex.

config MBS_MESHCORE_NODE_KEY_PREFIX_BYTES
	int "MeshCore node key prefix bytes"
	default 4
	range 3 5
	depends on MBS_MESHCORE_RUNTIME
	help
	  Number of public key bytes the MeshCore protocol runtime uses when it
	  tracks node-targeted pending requests and path metadata.

config MBS_MESHCORE_REQUEST_TIMEOUT_MS
	int "MeshCore runtime request timeout (ms)"
	default 10000
	range 10000 60000
	depends on MBS_MESHCORE_RUNTIME
	help
	  Timeout for MeshCore runtime pending node requests, including path,
	  trace, telemetry, and binary request correlation.

config MBS_MESHCORE_DEFAULT_ROLE
	int "Initial MeshCore role when Settings are unavailable"
	default 1 if MBS_CONTACT && MBS_CHANNEL && MBS_MESSAGE
	default 2
	range 1 4
	help
	  Initial role only: 1 CHAT, 2 REPEATER, 3 ROOM, 4 SENSOR.
	  Settings select the role at boot and allow live role changes. CHAT requires the
	  compiled contact/channel/message integration.

config MBS_MESHCORE_RUNTIME
	bool "Enable MeshCore lib-mc runtime"
	default y
	depends on MBS_RADIO
	select PSA_CRYPTO
	select PSA_WANT_ALG_SHA_256
	select PSA_WANT_ALG_ECB_NO_PADDING
	select PSA_WANT_ALG_HMAC
	select PSA_WANT_KEY_TYPE_AES
	select PSA_WANT_KEY_TYPE_HMAC
	help
	  Build the lib-mc based runtime that subscribes to Meshbus request
	  channels and drives MeshCore processing. Tests may disable this when
	  they only need the Companion protocol adapter.

config MBS_MESHCORE_CLIENT
	bool "MeshCore contact/channel/message integration"
	default y if MBS_CHANNEL && MBS_MESSAGE
	depends on MBS_MESHCORE_RUNTIME
	depends on MBS_CONTACT
	depends on MBS_CHANNEL
	depends on MBS_MESSAGE
	help
	  Enable MeshCore client behavior which integrates with Meshbus contact,
	  channel, and message storage APIs.

config MBS_MESHCORE_CLIENT_IGNORE_DIRECT_PATH_REQUESTS
	bool "MeshCore client ignore direct path requests (for relay tests)"
	default n
	depends on MBS_MESHCORE_CLIENT
	help
	  Enable MeshCore client behavior to ignore direct path requests.
	  This is useful for testing multi-hop relay scenarios without
	  interference from direct requests.

config MBS_MESHCORE_SHELL
	bool "MeshCore shell commands"
	depends on MBS_SHELL
	default y
	help
	  Enable shell commands for MeshCore config and MeshCore-owned requests.

config MBS_MESHCORE_STATS
	bool "Meshbus MeshCore statistics"
	depends on MBS_STATS
	default y
	help
	  Enable MeshCore request-admission statistics. Counters distinguish
	  requests accepted by the runtime queue from queue exhaustion, missing
	  runtime consumers, and other submission-layer failures.

config MBS_MESHCORE_INIT_PRIORITY
	int "MeshCore init priority"
	default 95
	depends on MBS_MESHCORE_RUNTIME
	help
	  Init priority for the MeshCore runtime. This must run after Meshbus
	  services initialize because the runtime calls Meshbus service APIs.

config MBS_MESHCORE_WORKQ_STACK_SIZE
	int "MeshCore workqueue stack size"
	default 4096
	depends on MBS_MESHCORE_RUNTIME
	help
	  Stack size for the MeshCore runtime workqueue thread.

config MBS_MESHCORE_WORKQ_PRIORITY
	int "MeshCore workqueue priority"
	default 5
	depends on MBS_MESHCORE_RUNTIME
	help
	  Thread priority for the MeshCore runtime workqueue.

config MBS_MESHCORE_PACKET_POOL_SIZE
	int "MeshCore packet pool size"
	default 10
	depends on MBS_MESHCORE_RUNTIME
	help
	  Packet pool size for MeshCore runtime instance.

config MBS_MESHCORE_REQUEST_QUEUE_DEPTH
	int "MeshCore service request queue depth"
	default 8
	range 1 32
	depends on MBS_MESHCORE_RUNTIME
	help
	  Total number of Meshbus request events that can wait in the MeshCore
	  service inbox. Listener callbacks use this queue with K_NO_WAIT and
	  never block publisher context. Large requests use a separate small slab
	  pool below, so this value mainly sizes lightweight control bursts.

config MBS_MESHCORE_REQUEST_LARGE_QUEUE_DEPTH
	int "MeshCore large request queue depth"
	default 2
	range 1 8
	depends on MBS_MESHCORE_RUNTIME
	help
	  Number of large Meshbus request payloads that can wait in the MeshCore
	  service inbox. Peer-advert and message-send requests need full payload
	  storage; other requests use the lightweight request slab.

config MBS_MESHCORE_RADIO_RX_QUEUE_DEPTH
	int "MeshCore service radio RX queue depth"
	default 4
	range 1 16
	depends on MBS_MESHCORE_RUNTIME
	help
	  Number of received radio packets staged by the MeshCore service before
	  the serialized runtime work handler injects them when the local fallback
	  RX queue is used.

config MBS_MESHCORE_RADIO_RX_ZBUS_SUBSCRIBER
	bool "Use ZBus subscriber for MeshCore radio RX"
	default y if ZBUS_MSG_SUBSCRIBER
	depends on MBS_MESHCORE_RUNTIME
	depends on ZBUS_MSG_SUBSCRIBER
	help
	  Use Zephyr's ZBus message-subscriber queue for radio receive events
	  instead of keeping a MeshCore-private RX ring. Builds that already use
	  ZBus message subscribers can share that pool and reduce MeshCore static
	  RAM. Builds without ZBus message subscribers keep the local service
	  queue above.

config MBS_MESHCORE_TXT_ACK_DELAY
	int "MeshCore TXT ACK delay (ms)"
	default 200
	depends on MBS_MESHCORE_RUNTIME
	help
	  Delay in milliseconds before sending ACK for TXT messages received by
	  the MeshCore runtime.

config MBS_MESHCORE_SERVER_RESPONSE_DELAY
	int "MeshCore server response delay (ms)"
	default 300
	depends on MBS_MESHCORE_RUNTIME
	help
	  Delay in milliseconds before responding to server requests by the
	  MeshCore runtime.

config MBS_MESHCORE_COMPANION_PROTOCOL
	bool "MeshCore Companion binary protocol adapter"
	default n
	depends on MBS_CONTACT
	select PSA_CRYPTO
	select PSA_WANT_ALG_SHA_256
	help
	  Enable the transport-agnostic MeshCore Companion protocol adapter.
	  The adapter parses complete Companion app binary frames and emits
	  complete response or push frames through a caller-provided transport.

if MBS_MESHCORE_COMPANION_PROTOCOL

config MBS_MESHCORE_COMPANION_PROTOCOL_CLOCK_SET
	bool "Enable Companion set-time command"
	default MBS_CLOCK
	help
	  Allow CMD_SET_DEVICE_TIME to call the Meshbus runtime realtime-clock
	  setter. Production builds normally get this through MBS_CLOCK.
	  Tests may enable it with a linker-wrapped setter to avoid pulling the
	  full clock service into RAM-constrained qemu targets.

endif # MBS_MESHCORE_COMPANION_PROTOCOL

config MBS_MESHCORE_COMPANION_BLUETOOTH
	bool "MeshCore Companion Bluetooth NUS transport"
	default n
	depends on MBS_BLUETOOTH
	select BT_ZEPHYR_NUS
	select BT_ZEPHYR_NUS_DEFAULT_INSTANCE
	select MBS_MESHCORE_COMPANION_PROTOCOL
	help
	  Expose the MeshCore Companion binary protocol over Zephyr's upstream
	  Nordic UART Service. Meshbus Bluetooth owns advertising, security, and
	  connection policy; this transport subscribes to Bluetooth state events
	  and binds NUS callbacks to the Companion protocol adapter.

config MBS_MESHCORE_COMPANION_BLUETOOTH_INIT_PRIORITY
	int "MeshCore Companion Bluetooth init priority"
	default 91
	depends on MBS_MESHCORE_COMPANION_BLUETOOTH
	help
	  Initialization priority for the Companion Bluetooth transport. It should
	  run after the Meshbus Bluetooth service initializes its state channels.

config MBS_MESHCORE_COMPANION_BLUETOOTH_WORKQUEUE_STACK_SIZE
	int "MeshCore Companion Bluetooth workqueue stack size"
	default 3072
	depends on MBS_MESHCORE_COMPANION_BLUETOOTH
	help
	  Stack size for the dedicated Companion Bluetooth workqueue.

config MBS_MESHCORE_COMPANION_BLUETOOTH_WORKQUEUE_PRIORITY
	int "MeshCore Companion Bluetooth workqueue priority"
	default 0
	depends on MBS_MESHCORE_COMPANION_BLUETOOTH
	help
	  Priority for the dedicated Companion Bluetooth workqueue.

config MBS_MESHCORE_COMPANION_BLUETOOTH_RX_QUEUE_DEPTH
	int "MeshCore Companion Bluetooth RX queue depth"
	default 2
	range 1 8
	depends on MBS_MESHCORE_COMPANION_BLUETOOTH
	help
	  Number of complete Companion Bluetooth frames that can wait for adapter
	  processing after a NUS receive callback.

config MBS_MESHCORE_COMPANION_BLUETOOTH_TX_QUEUE_DEPTH
	int "MeshCore Companion Bluetooth TX queue depth"
	default 4
	range 1 8
	depends on MBS_MESHCORE_COMPANION_BLUETOOTH
	help
	  Number of complete response and push frames accepted for NUS delivery
	  or retry, including the frame currently being sent. This is the only
	  Companion TX queue; a full queue rejects either frame type immediately.

endif # MBS_MESHCORE
```
