## subsys/message/Kconfig
```kconfig
# Copyright (c) 2026 FoBE Studio
# SPDX-License-Identifier: Apache-2.0

menuconfig MBS_MESSAGE
	bool "Meshbus message subsystem"
	depends on ZBUS
	default n
	help
	  Enable Meshbus message subsystem.

if MBS_MESSAGE
module = MBS_MESSAGE
module-str = mbs_message
module-help = Sets log level for Meshbus message management
source "subsys/logging/Kconfig.template.log_config"

config MBS_MESSAGE_MAX_STORE_COUNT
	int "Maximum number of messages"
	default 10
	range 5 45
	help
	  Maximum number of received messages that can be stored for
	  client-side reads. When the cache is full, the oldest received
	  message is dropped.

config MBS_MESSAGE_TX
	bool "Message send/command APIs"
	depends on MBS_CONTACT
	default y
	help
	  Enable outbound message command APIs and the command ZBus channel.

config MBS_MESSAGE_TX_MAX_LEN
	int "Maximum outbound message length"
	default 160
	range 1 160
	help
	  Maximum length of direct outbound text messages. ACK attempts above 3
	  require two extra protocol bytes and limit the payload to 158 bytes.
	  Channel messages also
	  carry a sender-name prefix, so their accepted payload length is reduced
	  by the current MeshCore node-name length plus two separator bytes.

config MBS_MESSAGE_PENDING_SEND_COUNT
	int "Maximum pending outbound ACK sends"
	default 8
	range 1 256
	help
	  Maximum number of outbound node messages that can wait for ACK
	  confirmation at the same time. The default matches MeshCore
	  companion_radio's expected ACK table size.

config MBS_MESSAGE_TX_TEST_ASSUME_RADIO_READY
	bool "Assume outbound radio is ready in tests"
	depends on ZTEST
	default n
	help
	  Test-only escape hatch for message TX unit tests that exercise the
	  request publishing path without compiling the full radio service.

config MBS_MESSAGE_SHELL
	bool "Message shell commands"
	depends on MBS_SHELL
	default y
	help
	  Enable shell commands for message management.
	  Provides commands for viewing/modifying local message
	  and message information.

endif # MBS_MESSAGE
```

## subsys/notify/Kconfig
```kconfig
# Copyright (c) 2026 FoBE Studio
# SPDX-License-Identifier: Apache-2.0

menuconfig MBS_NOTIFY
	bool "Meshbus notify subsystem"
	depends on ZBUS
	default n
	help
	  Enable Meshbus notify subsystem.

if MBS_NOTIFY
module = MBS_NOTIFY
module-str = mbs_notify
module-help = Sets log level for Meshbus notify service
source "subsys/logging/Kconfig.template.log_config"

config MBS_NOTIFY_SHELL
	bool "Notify shell commands"
	depends on MBS_SHELL
	default y
	help
	  Enable shell commands for publishing notify messages.

config MBS_NOTIFY_TRANSPORT_SERIAL
	bool "Publish MBN1 Notify frames over the MCUmgr UART"
	depends on MCUMGR_TRANSPORT_UART
	default n
	help
	  Publish Notify payloads as MBN1 sideband frames on the UART selected
	  by zephyr,uart-mcumgr. Leave this disabled when UART MCUmgr shares the
	  UART with console logging: this transport writes synchronously and
	  cannot safely interleave with SMP responses.

endif # MBS_NOTIFY
```

## subsys/radio/Kconfig
```kconfig
# Copyright (c) 2026 FoBE Studio
# SPDX-License-Identifier: Apache-2.0

menuconfig MBS_RADIO
	bool "Meshbus Radio Management Layer"
	depends on LORA
	depends on LORA_MODULE_BACKEND_LORA_BASICS_MODEM
	select ZBUS_ASYNC_LISTENER
	default n
	help
	  Enable the Meshbus radio management layer.

if MBS_RADIO

module = MBS_RADIO
module-str = mbs_radio
module-dep = MBS
module-help = Sets log level for Meshbus Radio module
source "subsys/logging/Kconfig.template.log_config"

config MBS_RADIO_RECEIVE_POOL_SIZE
	int "RX message buffer pool size"
	default 4
	range 2 16
	help
	  Number of receive message buffers available for ZBus message
	  subscribers. Increase this value if the meshcore subsystem
	  cannot process messages fast enough and messages are lost.

	  NOTE: This option is not automatically wired to
	  CONFIG_ZBUS_MSG_SUBSCRIBER_NET_BUF_POOL_SIZE. Set that symbol
	  in your application Kconfig/prj.conf to adjust the actual pool size.

config MBS_RADIO_OPERATION_WORK_QUEUE_STACK_SIZE
	int "Radio operation workqueue stack size"
	default 1024
	range 512 4096
	help
	  Stack size of the shared Radio operation workqueue. Packet TX and
	  continuous-wave requests are serialized on this queue so potentially
	  blocking driver operations never block the system workqueue.

config MBS_RADIO_OPERATION_WORK_QUEUE_PRIORITY
	int "Radio operation workqueue priority"
	default 10
	help
	  Cooperative priority of the shared Radio operation workqueue.

config MBS_RADIO_DEFAULT_FREQUENCY
	int "Default frequency in Hz"
	default 915125000
	help
	  Default radio frequency in Hz.

config MBS_RADIO_DEFAULT_BANDWIDTH
	int "Default bandwidth in Hz"
	default 250000
	help
		Default radio bandwidth in Hz.

config MBS_RADIO_DEFAULT_SPREAD_FACTOR
	int "Default spreading factor"
	default 11
	range 5 12
	help
	  Default LoRa spreading factor (5-12).

config MBS_RADIO_DEFAULT_CODING_RATE
	int "Default coding rate"
	default 5
	range 5 8
	help
	  Default LoRa coding rate (5-8).

config MBS_RADIO_DEFAULT_PREAMBLE_LENGTH
	int "Default preamble length in symbols"
	default 16
	range 6 65535
	help
	  Default preamble length in symbols (6-65535).

config MBS_RADIO_DEFAULT_TX_POWER
	int "Default TX power in dBm"
	default 14
	range 0 22
	help
	  Default transmit power in dBm (0-22).

config MBS_RADIO_DEFAULT_ENABLED
	bool "Default radio enabled"
	default y
	help
	  Default radio enabled state at boot when no settings are stored.

config MBS_RADIO_DEFAULT_RECEIVE_ONLY
	bool "Default receive-only mode"
	default n
	help
	  Default receive-only mode at boot when no settings are stored.
	  When enabled, the device will not transmit any radio data.

config MBS_RADIO_DEFAULT_RX_BOOSTED
	bool "Default RX boosted mode"
	default y
	help
	  Default RX boosted mode at boot when no settings are stored.

config MBS_RADIO_DEFAULT_CRC
	bool "Default packet CRC enabled"
	default y
	help
	  Default packet CRC setting at boot when no settings are stored.

config MBS_RADIO_DEFAULT_DUTY_CYCLE
	bool "Default RX duty cycle enabled"
	default n
	help
	  Default RX duty cycle mode at boot when no settings are stored.

config MBS_RADIO_DEFAULT_DUTY_CYCLE_RX_TIME
	int "Default RX duty cycle active window (ms)"
	default 210
	range 1 262143
	help
	  Default active receive window in milliseconds for duty cycle mode.

config MBS_RADIO_DEFAULT_DUTY_CYCLE_SLEEP_TIME
	int "Default RX duty cycle sleep window (ms)"
	default 1790
	range 1 262143
	help
	  Default sleep window in milliseconds for duty cycle mode.

config MBS_RADIO_NOISE_FLOOR_SAMPLES
	int "Number of samples for noise floor calibration"
	default 16
	range 1 128
	help
	  Number of samples for noise floor calibration.

config MBS_RADIO_NOISE_FLOOR_SAMPLE_PERIOD_MS
	int "Noise floor calibration sample period (ms)"
	default 2000
	range 100 60000
	help
	  Period between successful RSSI samples while calibrating the
	  noise floor.

config MBS_RADIO_NOISE_FLOOR_SAMPLE_RETRY_MS
	int "Noise floor calibration retry period (ms)"
	default 2000
	range 100 60000
	help
	  Retry delay used when calibration cannot sample yet (radio not in RX,
	  device not ready, or RSSI read failure).


config MBS_RADIO_SHELL
	bool "Meshbus Radio shell commands"
	depends on MBS_SHELL
	default y
	help
	  Enable shell commands for Meshbus Radio subsystem.
	  Provides commands for radio configuration and diagnostics.

config MBS_RADIO_STATS
	bool "Meshbus Radio statistics"
	depends on MBS_STATS
	default y
	help
	  Enable statistics for Meshbus Radio subsystem.

endif # MBS_RADIO
```

## subsys/settings/Kconfig
```kconfig
# SPDX-FileCopyrightText: FoBE Studio
# SPDX-License-Identifier: Apache-2.0

config MBS_SETTINGS_PERSISTENCE_DELAY
    int "Meshbus settings persistence delay (ms)"
    default 500
    help
      Time in milliseconds to wait after a settings change before
      persisting to non-volatile storage. This helps to reduce
      write cycles by batching multiple changes. If delay is set to 0,
      settings will be persisted immediately after each change.
```

## subsys/shell/Kconfig
```kconfig
# SPDX-FileCopyrightText: FoBE Studio
# SPDX-License-Identifier: Apache-2.0

config MBS_SHELL
	bool "Meshbus shell commands"
	depends on SHELL
	default y
	help
	  Enable shell commands for Meshbus subsystem.
	  Provides commands for radio configuration, status monitoring,
	  and diagnostics under the 'meshbus' command group.
```

## subsys/telemetry/Kconfig
```kconfig
# Copyright (c) 2026 FoBE Studio
# SPDX-License-Identifier: Apache-2.0

menuconfig MBS_TELEMETRY
	bool "Meshbus Telemetry Management Layer"
	depends on SENSOR
	default n
	help
	  Enable the Meshbus telemetry management layer which provides:
	  - Periodic collection from devicetree-bound sensor channels
	  - ZBus event publishing for aggregated sensor data
	  - Sampling-policy persistence via Settings
	  - Telemetry statistics via Zephyr Stats

if MBS_TELEMETRY

module = MBS_TELEMETRY
module-str = mbs_telemetry
module-dep = MBS
module-help = Sets log level for Meshbus Telemetry module
source "subsys/logging/Kconfig.template.log_config"

config MBS_TELEMETRY_DEFAULT_ENABLED
	bool "Default telemetry enabled"
	default y
	help
	  Default runtime enable state for telemetry.
	  This is the initial value before settings storage is loaded.

config MBS_TELEMETRY_MIN_SAMPLE_INTERVAL
	int "Minimum sample interval in milliseconds"
	default 5000
	range 1 $(UINT32_MAX)
	help
	  Minimum allowed interval between telemetry samples.
	  Used for validation when applying runtime configuration.

config MBS_TELEMETRY_DEFAULT_SAMPLE_INTERVAL
	int "Default sample interval in milliseconds"
	default 30000
	range MBS_TELEMETRY_MIN_SAMPLE_INTERVAL $(UINT32_MAX)
	help
	  Default interval between telemetry updates in milliseconds.
	  Can be changed at runtime via configuration API (and validated against
	  MBS_TELEMETRY_MIN_SAMPLE_INTERVAL).

config MBS_TELEMETRY_SHELL
	bool "Meshbus Telemetry shell commands"
	depends on MBS_SHELL
	default y
	help
	  Enable shell commands for Meshbus Telemetry subsystem.
	  Provides commands for telemetry configuration and diagnostics.

config MBS_TELEMETRY_STATS
	bool "Meshbus Telemetry statistics"
	depends on MBS_STATS
	default y
	help
	  Enable statistics for Meshbus Telemetry subsystem.

endif # MBS_TELEMETRY
```

## subsys/u8g2/Kconfig
```kconfig
# SPDX-License-Identifier: Apache-2.0

menuconfig U8G2
	bool "U8G2 graphics library"
	depends on DISPLAY
	help
	  Enable the embedded U8G2 graphics library as an SDK subsystem.

	  Notes:
	  - The Zephyr display adapter (u8g2_display.*) uses dynamic allocation
	    (k_malloc/k_free). Ensure you have a heap configured (e.g.
	    CONFIG_HEAP_MEM_POOL_SIZE > 0).

if U8G2

choice
	prompt "U8G2 buffer mode"
	default U8G2_BUFFER_MODE_FULL

config U8G2_BUFFER_MODE_FULL
	bool "Full framebuffer"
	help
	  Use a full framebuffer in RAM and flush with u8g2_SendBuffer().

config U8G2_BUFFER_MODE_PAGE8
	bool "Paged buffer (fixed 8-row pages)"
	help
	  Use a paged buffer with tile_buf_height=1 (8 pixel rows) and render
	  with the u8g2_FirstPage()/u8g2_NextPage() loop.

endchoice

config U8G2_SNAPSHOT
	bool "Keep the last complete frame for diagnostic snapshots"
	depends on U8G2_BUFFER_MODE_FULL
	default y if ZUI_SHELL || (MESHBUS_DISPLAY && MCUMGR)
	help
	  Keep one extra full framebuffer for synchronized snapshot copies.
	  Shell and Display MCUmgr diagnostics share this source. Frames are
	  published on full-buffer refresh, independently of panel readback.

config U8G2_INVERT
	bool "Invert monochrome output"
	default n
	help
	  Invert the final monochrome pixel stream before it is written via the
	  Zephyr Display API.

config U8G2_FONT_ALL
	bool "Enable all built-in U8G2 fonts"
	default n
	help
	  Build all fonts defined in subsys/u8g2/u8g2_fonts.c.

	  Disable this to selectively enable only required font symbols through
	  the U8G2 font options below.

rsource "Kconfig.fonts"

endif # U8G2
```
