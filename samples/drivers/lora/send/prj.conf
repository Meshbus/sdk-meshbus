## CMakeLists.txt
```
# SPDX-FileCopyrightText: FoBE Studio
# SPDX-License-Identifier: Apache-2.0

cmake_minimum_required(VERSION 3.20.0)

find_package(Zephyr REQUIRED HINTS $ENV{ZEPHYR_BASE})
project(lora_send)

FILE(GLOB app_sources src/*.c)
target_sources(app PRIVATE ${app_sources})
```

## sample.yaml
```
# SPDX-FileCopyrightText: FoBE Studio
# SPDX-License-Identifier: Apache-2.0

common:
  tags: lora
  depends_on: lora
  harness: console
  harness_config:
    type: one_line
    regex:
      - "<inf> lora_send: Data sent 0!"
sample:
  description: Demonstration of LoRa Send functionality
  name: LoRa Send Sample
tests:
  sample.driver.lora.send:
    integration_platforms:
      - b_l072z_lrwan1
  sample.driver.lora.send.lbm:
    filter: dt_compat_enabled("semtech,sx1261") or
      dt_compat_enabled("semtech,sx1262") or
      dt_compat_enabled("semtech,lr1110") or
      dt_compat_enabled("semtech,lr1120") or
      dt_compat_enabled("semtech,lr2021") or
      dt_compat_enabled("semtech,sx1272") or
      dt_compat_enabled("semtech,sx1276")
    integration_platforms:
      - b_l072z_lrwan1
      - rak11720
    extra_configs:
      - CONFIG_LORA_MODULE_BACKEND_LORA_BASICS_MODEM=y
  sample.driver.lora.send.lr2021_build:
    build_only: true
    platform_allow:
      - tracker_t1000_e
    extra_args: DTC_OVERLAY_FILE=../boards/tracker_t1000_e_lr2021.overlay
    extra_configs:
      - CONFIG_LORA_MODULE_BACKEND_LORA_BASICS_MODEM=y
      - CONFIG_LORA_BASICS_MODEM_DEFERRED_INIT=y
```

## prj.conf
```kconfig
# SPDX-FileCopyrightText: FoBE Studio
# SPDX-License-Identifier: Apache-2.0

CONFIG_LOG=y
CONFIG_LORA=y
CONFIG_LORA_MODULE_BACKEND_LORA_BASICS_MODEM=y
CONFIG_PRINTK=y
CONFIG_LORA_LOG_LEVEL_DBG=y
```

## boards/tracker_t1000_e.conf
```kconfig
# SPDX-FileCopyrightText: FoBE Studio
# SPDX-License-Identifier: Apache-2.0

# Give the USB CDC console time to enumerate before the sample starts logging.
CONFIG_BOOT_DELAY=2000

# Keep LR11XX hardware reset/configuration out of the early boot init path.
CONFIG_LORA_BASICS_MODEM_DEFERRED_INIT=y

# Avoid flooding the CDC backend while preserving application-level send logs.
CONFIG_LORA_LOG_LEVEL_INF=y
```

## src/main.c
```c
/*
 * Copyright (c) 2019 Manivannan Sadhasivam
 *
 * SPDX-License-Identifier: Apache-2.0
 */

#include <zephyr/device.h>
#include <zephyr/drivers/lora.h>
#include <errno.h>
#include <zephyr/sys/util.h>
#include <zephyr/kernel.h>

#define DEFAULT_RADIO_NODE DT_ALIAS(lora0)
BUILD_ASSERT(DT_NODE_HAS_STATUS_OKAY(DEFAULT_RADIO_NODE), "No default LoRa radio specified in DT");

#define MAX_DATA_LEN 12
#define CAD_BUSY_BACKOFF_MIN_MS 50U
#define CAD_BUSY_BACKOFF_MAX_MS 300U

#define LOG_LEVEL CONFIG_LOG_DEFAULT_LEVEL
#include <zephyr/logging/log.h>
LOG_MODULE_REGISTER(lora_send);

char data[MAX_DATA_LEN] = {'h', 'e', 'l', 'l', 'o', 'w', 'o', 'r', 'l', 'd', ' ', '0'};

static uint32_t cad_busy_backoff_ms(void)
{
	uint32_t span = CAD_BUSY_BACKOFF_MAX_MS - CAD_BUSY_BACKOFF_MIN_MS + 1U;

	return CAD_BUSY_BACKOFF_MIN_MS + (k_cycle_get_32() % span);
}

int main(void)
{
	const struct device *const lora_dev = DEVICE_DT_GET(DEFAULT_RADIO_NODE);
	struct lora_modem_config config = {0};
	int ret;

	if (!device_is_ready(lora_dev)) {
		LOG_ERR("%s Device not ready", lora_dev->name);
		return 0;
	}

	config.frequency = 915125000;
	config.bandwidth = BW_125_KHZ;
	config.datarate = SF_8;
	config.preamble_len = 96;
	config.coding_rate = CR_4_7;
	config.iq_inverted = false;
	config.public_network = false;
	config.rx_boosted = RX_BOOST_DISABLED;
	config.cad.mode = LORA_CAD_MODE_LBT;
	config.tx_power = 0;
	config.tx = true;

	ret = lora_config(lora_dev, &config);
	if (ret < 0) {
		LOG_ERR("LoRa config failed");
		return 0;
	}

	LOG_INF("Expected packet airtime: %u ms", lora_airtime(lora_dev, MAX_DATA_LEN));

	while (1) {
		ret = lora_send(lora_dev, data, MAX_DATA_LEN);
		if (ret < 0) {
			if (ret == -EBUSY) {
				uint32_t backoff_ms = cad_busy_backoff_ms();

				LOG_WRN("Channel busy (CAD LBT), backoff %u ms", backoff_ms);
				k_sleep(K_MSEC(backoff_ms));
				continue;
			}

			LOG_ERR("LoRa send failed (%d)", ret);
			return 0;
		}

		LOG_INF("Data sent %c!", data[MAX_DATA_LEN - 1]);

		/* Send data at 1s interval */
		k_sleep(K_MSEC(1000));

		/* Increment final character to differentiate packets */
		if (data[MAX_DATA_LEN - 1] == '9') {
			data[MAX_DATA_LEN - 1] = '0';
		} else {
			data[MAX_DATA_LEN - 1] += 1;
		}
	}
	return 0;
}
```
