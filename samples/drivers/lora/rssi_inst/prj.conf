## CMakeLists.txt
```
# SPDX-FileCopyrightText: FoBE Studio
# SPDX-License-Identifier: Apache-2.0

cmake_minimum_required(VERSION 3.20.0)

find_package(Zephyr REQUIRED HINTS $ENV{ZEPHYR_BASE})
project(lora_rssi_inst)

FILE(GLOB app_sources src/*.c)
target_sources(app PRIVATE ${app_sources})
```

## sample.yaml
```
# SPDX-FileCopyrightText: FoBE Studio
# SPDX-License-Identifier: Apache-2.0

common:
  tags: lora
  depends_on: lora
  harness: console
  harness_config:
    type: one_line
    regex:
      - "<inf> lora_rssi_inst: Starting asynchronous reception"
sample:
  description: Demonstration of LoRa instantaneous RSSI (rssi_inst) functionality
  name: LoRa RSSI Instant Sample
tests:
  sample.driver.lora.rssi_inst:
    integration_platforms:
      - b_l072z_lrwan1
  sample.driver.lora.rssi_inst.lbm:
    filter: dt_compat_enabled("semtech,sx1261") or
      dt_compat_enabled("semtech,sx1262") or
      dt_compat_enabled("semtech,lr1110") or
      dt_compat_enabled("semtech,lr1120") or
      dt_compat_enabled("semtech,lr2021") or
      dt_compat_enabled("semtech,sx1272") or
      dt_compat_enabled("semtech,sx1276")
    integration_platforms:
      - b_l072z_lrwan1
      - rak11720
    extra_configs:
      - CONFIG_LORA_MODULE_BACKEND_LORA_BASICS_MODEM=y
  sample.driver.lora.rssi_inst.lr2021_build:
    build_only: true
    platform_allow:
      - tracker_t1000_e
    extra_args: DTC_OVERLAY_FILE=../boards/tracker_t1000_e_lr2021.overlay
    extra_configs:
      - CONFIG_LORA_MODULE_BACKEND_LORA_BASICS_MODEM=y
      - CONFIG_LORA_BASICS_MODEM_DEFERRED_INIT=y
```

## prj.conf
```kconfig
# SPDX-FileCopyrightText: FoBE Studio
# SPDX-License-Identifier: Apache-2.0

CONFIG_LOG=y
CONFIG_LORA=y
CONFIG_LORA_MODULE_BACKEND_LORA_BASICS_MODEM=y
CONFIG_PRINTK=y
CONFIG_CONSOLE=y
CONFIG_UART_CONSOLE=y
```

## src/main.c
```c
/*
 * Copyright (c) 2026
 *
 * SPDX-License-Identifier: Apache-2.0
 */

#include <errno.h>
#include <stdbool.h>
#include <zephyr/device.h>
#include <zephyr/drivers/lora.h>
#include <zephyr/kernel.h>
#include <zephyr/sys/util.h>

#define DEFAULT_RADIO_NODE DT_ALIAS(lora0)
BUILD_ASSERT(DT_NODE_HAS_STATUS_OKAY(DEFAULT_RADIO_NODE),
	     "No default LoRa radio specified in DT");

#define MAX_DATA_LEN 255
#define RSSI_POLL_INTERVAL K_MSEC(1000)

#define LOG_LEVEL CONFIG_LOG_DEFAULT_LEVEL
#include <zephyr/logging/log.h>
LOG_MODULE_REGISTER(lora_rssi_inst);

static void lora_receive_cb(const struct device *dev, uint8_t *data, uint16_t size,
			    int16_t rssi, int8_t snr, void *user_data)
{
	ARG_UNUSED(dev);
	ARG_UNUSED(user_data);

	LOG_INF("LoRa RX packet RSSI: %d dBm, SNR: %d dB", rssi, snr);
	LOG_HEXDUMP_INF(data, size, "LoRa RX payload");
}

int main(void)
{
	const struct device *const lora_dev = DEVICE_DT_GET(DEFAULT_RADIO_NODE);
	struct lora_modem_config config = {0};
	int ret;

	if (!device_is_ready(lora_dev)) {
		LOG_ERR("%s Device not ready", lora_dev->name);
		return 0;
	}

	/* Match the send/receive samples' default configuration. */
	config.frequency = 915125000;
	config.bandwidth = BW_125_KHZ;
	config.datarate = SF_8;
	config.preamble_len = 96;
	config.coding_rate = CR_4_7;
	config.iq_inverted = false;
	config.public_network = false;
	config.rx_boosted = RX_BOOST_ENABLED;
	config.tx_power = 0;
	config.tx = false;

	ret = lora_config(lora_dev, &config);
	if (ret < 0) {
		LOG_ERR("LoRa config failed (%d)", ret);
		return 0;
	}

	/*
	 * Per the API contract, lora_rssi_inst() should be called while the modem
	 * is in receive mode, e.g. during asynchronous receive.
	 */
	LOG_INF("Starting asynchronous reception (required for rssi_inst)");
	ret = lora_recv_async(lora_dev, lora_receive_cb, NULL);
	if (ret < 0) {
		LOG_ERR("LoRa async receive setup failed (%d)", ret);
		return 0;
	}

	while (1) {
		int16_t rssi = 0;

		ret = lora_rssi_inst(lora_dev, &rssi);
		if (ret == -ENOSYS) {
			LOG_WRN("Instantaneous RSSI not supported by this driver");
			break;
		} else if (ret < 0) {
			LOG_WRN("Instantaneous RSSI query failed (%d)", ret);
		} else {
			LOG_INF("Instantaneous RSSI: %d dBm", rssi);
		}

		k_sleep(RSSI_POLL_INTERVAL);
	}

	/* Keep the application alive so logs can be inspected. */
	k_sleep(K_FOREVER);
	return 0;
}
```
