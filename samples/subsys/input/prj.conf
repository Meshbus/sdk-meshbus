## CMakeLists.txt
```
# SPDX-FileCopyrightText: FoBE Studio
# SPDX-License-Identifier: Apache-2.0

cmake_minimum_required(VERSION 3.20.0)

find_package(Zephyr REQUIRED HINTS $ENV{ZEPHYR_BASE})
project(input)

FILE(GLOB app_sources src/*.c)
target_sources(app PRIVATE ${app_sources})
```

## sample.yaml
```
# SPDX-FileCopyrightText: FoBE Studio
# SPDX-License-Identifier: Apache-2.0

sample:
  name: Meshbus input service
  description: Starts Meshbus input and logs raw/action events for board shell manual validation
common:
  tags:
    - meshbus
    - input
  harness: keyboard
tests:
  sample.subsys.meshbus.services.input:
    platform_allow:
      - mesh_probe_r2/nrf54l15/cpuapp
    integration_platforms:
      - mesh_probe_r2/nrf54l15/cpuapp
```

## prj.conf
```kconfig
# SPDX-FileCopyrightText: FoBE Studio
# SPDX-License-Identifier: Apache-2.0

# Logging Management
CONFIG_LOG=y
CONFIG_LOG_MODE_IMMEDIATE=y

# Kernel Management
CONFIG_KERNEL_SHELL=y
CONFIG_POLL=y
CONFIG_HEAP_MEM_POOL_SIZE=16384
CONFIG_ISR_STACK_SIZE=4096
CONFIG_MAIN_STACK_SIZE=4096
CONFIG_SYSTEM_WORKQUEUE_STACK_SIZE=4096

# Shell Management
CONFIG_SHELL=y
CONFIG_SHELL_STACK_SIZE=16384
CONFIG_SHELL_BACKEND_SERIAL=y

# Flash Management
CONFIG_FLASH=y
CONFIG_FLASH_MAP=y
CONFIG_FLASH_PAGE_LAYOUT=y
CONFIG_MPU_ALLOW_FLASH_WRITE=y

# ZMS Management
CONFIG_ZMS=y
CONFIG_ZMS_LOOKUP_CACHE=y
CONFIG_ZMS_LOOKUP_CACHE_SIZE=512
CONFIG_ZMS_LOOKUP_CACHE_FOR_SETTINGS=y

# Settings Management
CONFIG_SETTINGS=y
CONFIG_SETTINGS_ZMS=y
CONFIG_SETTINGS_ZMS_LL_CACHE=y
CONFIG_SETTINGS_ZMS_LL_CACHE_SIZE=512
CONFIG_SETTINGS_SHELL=y
CONFIG_SETTINGS_RUNTIME=y
CONFIG_SETTINGS_DYNAMIC_HANDLERS=y

# Stats
CONFIG_STATS=y
CONFIG_STATS_NAMES=y
CONFIG_STATS_SHELL=y

# Meshbus
CONFIG_MBS=y
CONFIG_MBS_SHELL=y
CONFIG_MBS_STATS=y
CONFIG_MBS_LOG_LEVEL_DBG=y
CONFIG_MBS_INPUT=y
CONFIG_MBS_INPUT_SHELL=y
CONFIG_MBS_INPUT_LOG_LEVEL_DBG=y

# ZBus
CONFIG_ZBUS=y
CONFIG_ZBUS_ASYNC_LISTENER=y
CONFIG_ZBUS_MSG_SUBSCRIBER=y
CONFIG_ZBUS_RUNTIME_OBSERVERS=y
```

## boards/idea_mesh_tracker_c2_nrf54l15_cpuapp.conf
```kconfig
# Peripherals
CONFIG_GPIO=y
CONFIG_INPUT=y

# Input
CONFIG_INPUT_GPIO_KEYS=y
CONFIG_INPUT_GPIO_QDEC=y
CONFIG_MBS_INPUT_BUTTON_MAX=10
# CONFIG_MFD=y
# CONFIG_MFD_TCA8418=y
# CONFIG_INPUT_TCA8418=y

# Power Management
CONFIG_PM_DEVICE=y
CONFIG_PM_DEVICE_RUNTIME=y
CONFIG_PM_DEVICE_SHELL=y
CONFIG_POWER_DOMAIN=y
CONFIG_PM_DEVICE_POWER_DOMAIN=y
CONFIG_PM_DEVICE_RUNTIME_ASYNC=y
```

## boards/mesh_probe_r2_nrf54l15_cpuapp.conf
```kconfig
# SPDX-FileCopyrightText: FoBE Studio
# SPDX-License-Identifier: Apache-2.0

# Peripherals
CONFIG_GPIO=y
CONFIG_INPUT=y

# Input
CONFIG_INPUT_GPIO_KEYS=y
CONFIG_INPUT_GPIO_QDEC=y
CONFIG_MBS_INPUT_BUTTON_MAX=10
# CONFIG_MFD=y
# CONFIG_MFD_TCA8418=y
# CONFIG_INPUT_TCA8418=y

# Power Management
CONFIG_PM_DEVICE=y
CONFIG_PM_DEVICE_RUNTIME=y
CONFIG_PM_DEVICE_SHELL=y
CONFIG_POWER_DOMAIN=y
CONFIG_PM_DEVICE_POWER_DOMAIN=y
CONFIG_PM_DEVICE_RUNTIME_ASYNC=y
```

## boards/tracker_t1000_e.conf
```kconfig
# SPDX-FileCopyrightText: FoBE Studio
# SPDX-License-Identifier: Apache-2.0

# Nordic SoC
CONFIG_SOC_FLASH_NRF_EMULATE_ONE_BYTE_WRITE_ACCESS=y

# Peripherals
CONFIG_GPIO=y
CONFIG_GPIO_HOGS=y
CONFIG_INPUT=y
CONFIG_INPUT_GPIO_KEYS=y

# Meshbus input
CONFIG_MBS_INPUT_BUTTON_MAX=1

# Power Management
CONFIG_PM_DEVICE=y
CONFIG_PM_DEVICE_RUNTIME=y
CONFIG_PM_DEVICE_SHELL=y
CONFIG_POWER_DOMAIN=y
CONFIG_PM_DEVICE_POWER_DOMAIN=y
CONFIG_PM_DEVICE_RUNTIME_ASYNC=y
```

## boards/idea_mesh_tracker_c2_nrf54l15_cpuapp.overlay
```dts
/*
 * Copyright (c) 2026 FoBE Studio
 *
 * SPDX-License-Identifier: Apache-2.0
 *
 * This overlay binds the board hardware used by the input sample.
 */

/ {
	chosen {
		meshbus,input-buttons = &buttons;
		meshbus,input-encoder = &encoder;
	};
};
```

## boards/tracker_t1000_e.overlay
```dts
/*
 * SPDX-FileCopyrightText: FoBE Studio
 * SPDX-License-Identifier: Apache-2.0
 */

/ {
	chosen {
		meshbus,input-buttons = &buttons;
	};
};

&button0 {
	zephyr,code = <INPUT_BTN_BACK>;
};

&buttons {
	wakeup-source;
};
```

## src/main.c
```c
/*
 * Copyright (c) 2025 FoBE Projects
 *
 * SPDX-License-Identifier: Apache-2.0
 */

/**
 * @file
 * @brief Meshbus subsystem test application
 */

#include <zephyr/kernel.h>
#include <zephyr/logging/log.h>
#include <zephyr/zbus/zbus.h>

#include <input/input.h>

LOG_MODULE_REGISTER(mbs_test, LOG_LEVEL_INF);

static const char *act_str(uint8_t action)
{
	switch (action) {
	case INPUT_ACT_KEY_SHORT:
		return "short";
	case INPUT_ACT_KEY_LONG:
		return "long";
	case INPUT_ACT_SCROLL_CW:
		return "scroll_cw";
	case INPUT_ACT_SCROLL_CCW:
		return "scroll_ccw";
	default:
		return "unknown";
	}
}

static void input_raw_listener_cb(const struct zbus_channel *chan, const void *message)
{
	if (chan != &mbs_input_raw_event_chan || message == NULL) {
		return;
	}

	const struct mbs_input_event *evt = message;

	LOG_INF("input/raw: type=%u code=0x%04x value=%d", (unsigned int)evt->type, evt->code,
		evt->value);
}

static void input_act_listener_cb(const struct zbus_channel *chan, const void *message)
{
	if (chan != &mbs_input_action_chan || message == NULL) {
		return;
	}

	const struct mbs_input_act_event *evt = message;

	LOG_INF("input/act: type=%u code=0x%04x action=%s(%u)", (unsigned int)evt->type, evt->code,
		act_str(evt->action), (unsigned int)evt->action);
}

ZBUS_ASYNC_LISTENER_DEFINE(input_raw_listener, input_raw_listener_cb);
ZBUS_ASYNC_LISTENER_DEFINE(input_act_listener, input_act_listener_cb);

int main(void)
{
	LOG_INF("Meshbus test application started");
	LOG_INF("Build timestamp: " __DATE__ " " __TIME__);

#ifdef CONFIG_BOOTLOADER_MCUBOOT
	LOG_INF("MCUboot bootloader support enabled");
#endif

	int rc = zbus_chan_add_obs(&mbs_input_raw_event_chan, &input_raw_listener, K_MSEC(100));
	if (rc != 0) {
		LOG_ERR("Failed to subscribe mbs_input_raw_event_chan: %d", rc);
	} else {
		LOG_INF("Subscribed to mbs_input_raw_event_chan");
	}

	rc = zbus_chan_add_obs(&mbs_input_action_chan, &input_act_listener, K_MSEC(100));
	if (rc != 0) {
		LOG_ERR("Failed to subscribe mbs_input_action_chan: %d", rc);
	} else {
		LOG_INF("Subscribed to mbs_input_action_chan");
	}

	return 0;
}
```
