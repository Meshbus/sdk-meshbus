## sample.yaml
```
sample:
  name: Meshbus Bluetooth service
  description: Starts Meshbus Bluetooth for board shell, BLE, notify, and MCUmgr manual validation
common:
  tags:
    - meshbus
    - bluetooth
  harness: keyboard
tests:
  sample.subsys.meshbus.services.bluetooth:
    platform_allow:
      - idea_mesh_tracker_c2/nrf54l15/cpuapp
    integration_platforms:
      - idea_mesh_tracker_c2/nrf54l15/cpuapp
      - tracker_t1000_e
```

## prj.conf
```kconfig
# Console/Shell (over chosen UART)
CONFIG_SERIAL=y
CONFIG_CONSOLE=y
CONFIG_UART_CONSOLE=y

CONFIG_SHELL=y
CONFIG_SHELL_STACK_SIZE=16384
CONFIG_SHELL_BACKEND_SERIAL=y
CONFIG_KERNEL_SHELL=y

# Logging
CONFIG_LOG=y
# Keep deferred logging; on BLE console the early output may be buffered.
# CONFIG_LOG_MODE_IMMEDIATE=y

# Kernel sizing (shell + mcumgr)
CONFIG_HEAP_MEM_POOL_SIZE=16384
CONFIG_ISR_STACK_SIZE=4096
CONFIG_MAIN_STACK_SIZE=4096
CONFIG_SYSTEM_WORKQUEUE_STACK_SIZE=4096

# Flash/ZMS/Settings (Meshbus config persistence)
CONFIG_FLASH=y
CONFIG_FLASH_MAP=y
CONFIG_FLASH_PAGE_LAYOUT=y
CONFIG_MPU_ALLOW_FLASH_WRITE=y

CONFIG_ZMS=y
CONFIG_ZMS_LOOKUP_CACHE=y
CONFIG_ZMS_LOOKUP_CACHE_SIZE=512
CONFIG_ZMS_LOOKUP_CACHE_FOR_SETTINGS=y
CONFIG_SETTINGS=y
CONFIG_SETTINGS_ZMS=y
CONFIG_SETTINGS_ZMS_LL_CACHE=y
CONFIG_SETTINGS_ZMS_LL_CACHE_SIZE=512
CONFIG_SETTINGS_RUNTIME=y
CONFIG_SETTINGS_DYNAMIC_HANDLERS=y

# Meshbus
CONFIG_MBS=y
CONFIG_MBS_SHELL=y
CONFIG_MBS_LOG_LEVEL_DBG=y

CONFIG_MBS_BLUETOOTH=y
CONFIG_MBS_BLUETOOTH_SHELL=y
CONFIG_MBS_BLUETOOTH_LOG_LEVEL_DBG=y
CONFIG_MBS_NOTIFY=y
CONFIG_MBS_NOTIFY_SHELL=y
CONFIG_MBS_NOTIFY_LOG_LEVEL_DBG=y

# Bluetooth core + security (SC + MITM)
CONFIG_BT=y
CONFIG_BT_PERIPHERAL=y
CONFIG_BT_DEVICE_NAME="MeshCore-FoBE"
#
# BT RX workqueue stack:
# Pairing/SMP + log formatting can overflow some board defaults.
#
CONFIG_BT_RX_STACK_SIZE=2048

CONFIG_BT_SMP=y
CONFIG_BT_SMP_SC_ONLY=y
CONFIG_BT_SMP_SC_PAIR_ONLY=y
CONFIG_BT_SMP_ENFORCE_MITM=y
CONFIG_BT_APP_PASSKEY=y
CONFIG_BT_BONDABLE=y
CONFIG_BT_SETTINGS=y

CONFIG_BT_MAX_CONN=1
CONFIG_BT_MAX_PAIRED=5

# Device Information Service
CONFIG_BT_DIS=y
CONFIG_BT_DIS_MANUF_NAME=y
CONFIG_BT_DIS_MANUF_NAME_STR="FoBE Studio"
CONFIG_BT_DIS_MODEL_NUMBER=y
CONFIG_BT_DIS_MODEL_NUMBER_STR="F2104,1a"

# Battery Service (demo data)
CONFIG_BT_BAS=y

# TX Power Service
CONFIG_BT_TPS=y

# MCUmgr over BLE (SMP)
CONFIG_NET_BUF=y
CONFIG_ZCBOR=y
CONFIG_CRC=y

# MCUmgr Management
CONFIG_MCUMGR=y
CONFIG_MCUMGR_TRANSPORT_BT=y
CONFIG_MCUMGR_TRANSPORT_BT_REASSEMBLY=y
CONFIG_MCUMGR_TRANSPORT_BT_PERM_RW_AUTHEN=y
CONFIG_MCUMGR_TRANSPORT_NETBUF_SIZE=2475
CONFIG_MCUMGR_TRANSPORT_WORKQUEUE_STACK_SIZE=4608
CONFIG_MCUMGR_GRP_ENUM=y
CONFIG_MCUMGR_GRP_ENUM_DETAILS=y
CONFIG_MCUMGR_GRP_ENUM_DETAILS_NAME=y
CONFIG_MCUMGR_GRP_OS=y
CONFIG_MCUMGR_GRP_OS_ECHO=y
CONFIG_MCUMGR_GRP_OS_INFO=y
CONFIG_MCUMGR_GRP_OS_TASKSTAT=y
CONFIG_MCUMGR_GRP_OS_BOOTLOADER_INFO=y
CONFIG_MCUMGR_GRP_OS_MCUMGR_PARAMS=y
CONFIG_MCUMGR_GRP_ZBASIC=y
CONFIG_MCUMGR_GRP_ZBASIC_STORAGE_ERASE=y
CONFIG_MCUMGR_GRP_STAT=y
CONFIG_MCUMGR_GRP_STAT_MAX_NAME_LEN=32
CONFIG_MCUMGR_GRP_SETTINGS=y
CONFIG_MCUMGR_GRP_SETTINGS_ACCESS_HOOK=y
CONFIG_MCUMGR_MGMT_NOTIFICATION_HOOKS=y
CONFIG_MCUMGR_GRP_SETTINGS_VALUE_LEN=128
CONFIG_MCUMGR_GRP_SHELL=y
CONFIG_SHELL_BACKEND_DUMMY=y

# Power Management
CONFIG_PM_DEVICE=y
CONFIG_PM_DEVICE_RUNTIME=y
CONFIG_PM_DEVICE_SHELL=y
CONFIG_PM_DEVICE_POWER_DOMAIN=y
CONFIG_PM_DEVICE_RUNTIME_ASYNC=y
CONFIG_POWER_DOMAIN=y
```

## src/main.c
```c
/*
 * Copyright (c) 2026 FoBE Studio
 *
 * SPDX-License-Identifier: Apache-2.0
 */

/**
 * @file
 * @brief Meshbus Bluetooth service sample
 */

#include <zephyr/kernel.h>
#include <zephyr/logging/log.h>

LOG_MODULE_REGISTER(mbs_services_bluetooth_sample, LOG_LEVEL_INF);

int main(void)
{
	LOG_INF("Meshbus Bluetooth service sample started");
	LOG_INF("Build timestamp: " __DATE__ " " __TIME__);
	return 0;
}
```
