## CMakeLists.txt
```
# SPDX-License-Identifier: Apache-2.0

cmake_minimum_required(VERSION 3.20.0)

find_package(Zephyr REQUIRED HINTS $ENV{ZEPHYR_BASE})
project(input)

FILE(GLOB app_sources src/*.c)
target_sources(app PRIVATE ${app_sources})
```

## prj.conf
```kconfig
# Logging Management
CONFIG_LOG=y
CONFIG_LOG_MODE_IMMEDIATE=y

# Kernel Management
CONFIG_KERNEL_SHELL=y
CONFIG_POLL=y
CONFIG_HEAP_MEM_POOL_SIZE=16384
CONFIG_ISR_STACK_SIZE=4096
CONFIG_MAIN_STACK_SIZE=4096
CONFIG_SYSTEM_WORKQUEUE_STACK_SIZE=4096

# Shell Management
CONFIG_SHELL=y
CONFIG_SHELL_STACK_SIZE=16384
CONFIG_SHELL_BACKEND_SERIAL=y

# Flash Management
CONFIG_FLASH=y
CONFIG_FLASH_MAP=y
CONFIG_FLASH_PAGE_LAYOUT=y
CONFIG_MPU_ALLOW_FLASH_WRITE=y

# ZMS Management
CONFIG_ZMS=y
CONFIG_ZMS_LOOKUP_CACHE=y
CONFIG_ZMS_LOOKUP_CACHE_SIZE=512
CONFIG_ZMS_LOOKUP_CACHE_FOR_SETTINGS=y

# Settings Management
CONFIG_SETTINGS=y
CONFIG_SETTINGS_ZMS=y
CONFIG_SETTINGS_ZMS_LL_CACHE=y
CONFIG_SETTINGS_ZMS_LL_CACHE_SIZE=512
CONFIG_SETTINGS_SHELL=y
CONFIG_SETTINGS_RUNTIME=y
CONFIG_SETTINGS_DYNAMIC_HANDLERS=y

# Stats
CONFIG_STATS=y
CONFIG_STATS_NAMES=y
CONFIG_STATS_SHELL=y

# Meshbus
CONFIG_MBS=y
CONFIG_MBS_SHELL=y
CONFIG_MBS_STATS=y
CONFIG_MBS_LOG_LEVEL_DBG=y
CONFIG_MBS_POWER=y
CONFIG_MBS_POWER_SHELL=y
CONFIG_MBS_POWER_LOG_LEVEL_DBG=y

# ZBus
CONFIG_ZBUS=y
CONFIG_ZBUS_ASYNC_LISTENER=y
CONFIG_ZBUS_MSG_SUBSCRIBER=y
CONFIG_ZBUS_RUNTIME_OBSERVERS=y
```

## boards/idea_mesh_tracker_c2_nrf54l15_cpuapp.overlay
```dts
/*
 * Copyright (c) 2026 FoBE Studio
 *
 * SPDX-License-Identifier: Apache-2.0
 *
 * This overlay defines a fake LoRa device node for testing the LBM driver API.
 */

/ {
	chosen {
		meshbus,fuel-gauge = &fuel_gauge;
		meshbus,power-button = &button0;
	};
};

&button0 {
	zephyr,code = <INPUT_BTN_SELECT>;
};

&buttons{
	wakeup-source;
};
```

## src/main.c
```c
/*
 * Copyright (c) 2025 FoBE Projects
 *
 * SPDX-License-Identifier: Apache-2.0
 */

/**
 * @file
 * @brief Meshbus subsystem test application
 */

#include <zephyr/kernel.h>
#include <zephyr/logging/log.h>

LOG_MODULE_REGISTER(mbs_test, LOG_LEVEL_INF);

int main(void)
{
	LOG_INF("Meshbus test application started");
	LOG_INF("Build timestamp: " __DATE__ " " __TIME__);

#ifdef CONFIG_BOOTLOADER_MCUBOOT
	LOG_INF("MCUboot bootloader support enabled");
#endif

	return 0;
}
```
