## CMakeLists.txt
```
# SPDX-License-Identifier: Apache-2.0

cmake_minimum_required(VERSION 3.20.0)

find_package(Zephyr REQUIRED HINTS $ENV{ZEPHYR_BASE})
project(contact)

FILE(GLOB app_sources src/*.c)
target_sources(app PRIVATE ${app_sources})
```

## sample.yaml
```
sample:
  name: Meshbus contact service
  description: Starts Meshbus contact and logs request/response channels for board shell manual validation
common:
  tags:
    - meshbus
    - contact
  harness: keyboard
tests:
  sample.subsys.meshbus.services.contact:
    integration_platforms:
      - idea_mesh_tracker_c2/nrf54l15/cpuapp
      - tracker_t1000_e
```

## prj.conf
```kconfig
# Logging Management
CONFIG_LOG=y
CONFIG_LOG_MODE_IMMEDIATE=y

# Kernel Management
CONFIG_KERNEL_SHELL=y
CONFIG_POLL=y
CONFIG_HEAP_MEM_POOL_SIZE=16384
CONFIG_ISR_STACK_SIZE=4096
CONFIG_MAIN_STACK_SIZE=4096
CONFIG_SYSTEM_WORKQUEUE_STACK_SIZE=4096

# Shell Management
CONFIG_SHELL=y
CONFIG_SHELL_STACK_SIZE=16384
CONFIG_SHELL_BACKEND_SERIAL=y

# Flash Management
CONFIG_FLASH=y
CONFIG_FLASH_MAP=y
CONFIG_FLASH_PAGE_LAYOUT=y
CONFIG_MPU_ALLOW_FLASH_WRITE=y

# ZMS Management
CONFIG_ZMS=y
CONFIG_ZMS_LOOKUP_CACHE=y
CONFIG_ZMS_LOOKUP_CACHE_SIZE=512
CONFIG_ZMS_LOOKUP_CACHE_FOR_SETTINGS=y

# Settings Management
CONFIG_SETTINGS=y
CONFIG_SETTINGS_ZMS=y
CONFIG_SETTINGS_ZMS_LL_CACHE=y
CONFIG_SETTINGS_ZMS_LL_CACHE_SIZE=512
CONFIG_SETTINGS_SHELL=y
CONFIG_SETTINGS_RUNTIME=y
CONFIG_SETTINGS_DYNAMIC_HANDLERS=y

# Stats
CONFIG_STATS=y
CONFIG_STATS_NAMES=y
CONFIG_STATS_SHELL=y

# Meshbus
CONFIG_MBS=y
CONFIG_MBS_SHELL=y
CONFIG_MBS_STATS=y
CONFIG_MBS_LOG_LEVEL_DBG=y
CONFIG_MBS_MESHCORE=y
CONFIG_MBS_CONTACT=y
CONFIG_MBS_MESHCORE_SHELL=y
CONFIG_MBS_CONTACT_LOG_LEVEL_DBG=y

# ZBus
CONFIG_ZBUS=y
CONFIG_ZBUS_ASYNC_LISTENER=y
CONFIG_ZBUS_MSG_SUBSCRIBER=y
CONFIG_ZBUS_RUNTIME_OBSERVERS=y
```

## src/main.c
```c
/*
 * Copyright (c) 2026 FoBE Studio
 *
 * SPDX-License-Identifier: Apache-2.0
 */

#include <zephyr/kernel.h>
#include <zephyr/logging/log.h>
#include <contact/contact.h>
#include <meshcore/meshcore.h>
#include <zephyr/zbus/zbus.h>

LOG_MODULE_REGISTER(mbs_contact_sample, LOG_LEVEL_INF);

static void contact_listener_cb(const struct zbus_channel *chan, const void *message)
{
	ARG_UNUSED(message);

	if (chan == &mbs_meshcore_advert_request_chan) {
		const mbs_meshcore_advert_request_event *event = message;

		LOG_INF("contact/advert request: flood=%u", event->flood ? 1U : 0U);
	} else if (chan == &mbs_contact_share_request_chan) {
		LOG_INF("contact/share request");
	} else if (chan == &mbs_contact_discover_path_request_chan) {
		LOG_INF("contact/discover-path request");
	} else if (chan == &mbs_contact_trace_path_request_chan) {
		LOG_INF("contact/trace-path request");
	} else if (chan == &mbs_contact_telemetry_request_chan) {
		LOG_INF("contact/telemetry request");
	} else if (chan == &mbs_contact_advert_response_chan) {
		const mbs_contact_response_advert_event *event = message;

		LOG_INF("contact/advert response: name=\"%s\" role=%d", event->name, event->role);
	} else if (chan == &mbs_contact_path_response_chan) {
		const mbs_contact_response_path_event *event = message;

		LOG_INF("contact/path response: discover=%u timestamp=%u",
			event->is_discover ? 1U : 0U, event->timestamp);
	} else if (chan == &mbs_contact_trace_path_response_chan) {
		const mbs_contact_response_trace_path_event *event = message;

		LOG_INF("contact/trace-path response: timestamp=%u state=%u", event->timestamp,
			(unsigned int)event->state);
	} else if (chan == &mbs_contact_telemetry_response_chan) {
		const mbs_contact_response_telemetry_event *event = message;

		LOG_INF("contact/telemetry response: timestamp=%u payload_len=%u", event->timestamp,
			(unsigned int)event->payload_len);
	}
}

ZBUS_ASYNC_LISTENER_DEFINE(contact_listener, contact_listener_cb);

static void subscribe_contact_channel(const struct zbus_channel *chan, const char *name)
{
	int rc = zbus_chan_add_obs(chan, &contact_listener, K_MSEC(100));

	if (rc != 0) {
		LOG_ERR("Failed to subscribe %s: %d", name, rc);
	} else {
		LOG_INF("Subscribed to %s", name);
	}
}

int main(void)
{
	LOG_INF("Meshbus contact sample started");
	LOG_INF("Build timestamp: " __DATE__ " " __TIME__);
	LOG_INF("Contact store: count=%u capacity=%u",
		(unsigned int)mbs_contact_store_count(),
		(unsigned int)mbs_contact_store_size());

	subscribe_contact_channel(&mbs_meshcore_advert_request_chan, "mbs_meshcore_advert_request_chan");
	subscribe_contact_channel(&mbs_contact_share_request_chan,
			       "mbs_contact_share_request_chan");
	subscribe_contact_channel(&mbs_contact_discover_path_request_chan,
			       "mbs_contact_discover_path_request_chan");
	subscribe_contact_channel(&mbs_contact_trace_path_request_chan,
			       "mbs_contact_trace_path_request_chan");
	subscribe_contact_channel(&mbs_contact_telemetry_request_chan,
			       "mbs_contact_telemetry_request_chan");
	subscribe_contact_channel(&mbs_contact_advert_response_chan,
			       "mbs_contact_advert_response_chan");
	subscribe_contact_channel(&mbs_contact_path_response_chan,
			       "mbs_contact_path_response_chan");
	subscribe_contact_channel(&mbs_contact_trace_path_response_chan,
			       "mbs_contact_trace_path_response_chan");
	subscribe_contact_channel(&mbs_contact_telemetry_response_chan,
			       "mbs_contact_telemetry_response_chan");

	return 0;
}
```
