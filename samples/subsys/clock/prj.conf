## CMakeLists.txt
```
# SPDX-FileCopyrightText: FoBE Studio
# SPDX-License-Identifier: Apache-2.0

cmake_minimum_required(VERSION 3.20.0)

find_package(Zephyr REQUIRED HINTS $ENV{ZEPHYR_BASE})
project(clock)

FILE(GLOB app_sources src/*.c)
target_sources(app PRIVATE ${app_sources})
```

## sample.yaml
```
# SPDX-FileCopyrightText: FoBE Studio
# SPDX-License-Identifier: Apache-2.0

sample:
  name: Meshbus clock service
  description: Starts Meshbus clock and exposes config shell commands for board manual validation
common:
  tags:
    - meshbus
    - clock
  harness: keyboard
tests:
  sample.subsys.meshbus.services.clock:
    integration_platforms:
      - mesh_probe_r2/nrf54l15/cpuapp
      - tracker_t1000_e
```

## prj.conf
```kconfig
# SPDX-FileCopyrightText: FoBE Studio
# SPDX-License-Identifier: Apache-2.0

# Logging Management
CONFIG_LOG=y
CONFIG_LOG_MODE_IMMEDIATE=y

# Kernel Management
CONFIG_KERNEL_SHELL=y
CONFIG_POLL=y
CONFIG_HEAP_MEM_POOL_SIZE=16384
CONFIG_ISR_STACK_SIZE=4096
CONFIG_MAIN_STACK_SIZE=4096
CONFIG_SYSTEM_WORKQUEUE_STACK_SIZE=4096

# Shell Management
CONFIG_SHELL=y
CONFIG_SHELL_STACK_SIZE=16384
CONFIG_SHELL_BACKEND_SERIAL=y

# Flash Management
CONFIG_FLASH=y
CONFIG_FLASH_MAP=y
CONFIG_FLASH_PAGE_LAYOUT=y
CONFIG_MPU_ALLOW_FLASH_WRITE=y

# ZMS Management
CONFIG_ZMS=y
CONFIG_ZMS_LOOKUP_CACHE=y
CONFIG_ZMS_LOOKUP_CACHE_SIZE=512
CONFIG_ZMS_LOOKUP_CACHE_FOR_SETTINGS=y

# Settings Management
CONFIG_SETTINGS=y
CONFIG_SETTINGS_ZMS=y
CONFIG_SETTINGS_ZMS_LL_CACHE=y
CONFIG_SETTINGS_ZMS_LL_CACHE_SIZE=512
CONFIG_SETTINGS_SHELL=y
CONFIG_SETTINGS_RUNTIME=y
CONFIG_SETTINGS_DYNAMIC_HANDLERS=y

# Stats
CONFIG_STATS=y
CONFIG_STATS_NAMES=y
CONFIG_STATS_SHELL=y

# Meshbus
CONFIG_MBS=y
CONFIG_MBS_SHELL=y
CONFIG_MBS_STATS=y
CONFIG_MBS_LOG_LEVEL_DBG=y
CONFIG_MBS_CLOCK=y
CONFIG_MBS_CLOCK_SHELL=y
CONFIG_MBS_CLOCK_LOG_LEVEL_DBG=y

# ZBus
CONFIG_ZBUS=y
CONFIG_ZBUS_MSG_SUBSCRIBER=y
CONFIG_ZBUS_RUNTIME_OBSERVERS=y
```

## src/main.c
```c
/*
 * Copyright (c) 2026 FoBE Studio
 *
 * SPDX-License-Identifier: Apache-2.0
 */

#include <zephyr/kernel.h>
#include <zephyr/logging/log.h>
#include <clock/clock.h>

LOG_MODULE_REGISTER(mbs_clock_sample, LOG_LEVEL_INF);

int main(void)
{
	mbs_clock_config cfg;
	int rc;

	LOG_INF("Meshbus clock sample started");
	LOG_INF("Build timestamp: " __DATE__ " " __TIME__);

	rc = mbs_clock_config_get(&cfg);
	if (rc != 0) {
		LOG_ERR("Failed to read clock config: %d", rc);
		return 0;
	}

	LOG_INF("clock/config: time_format=%d utc_offset_minutes=%d", cfg.time_format,
		cfg.utc_offset_minutes);

	return 0;
}
```
