## subsys/meshbus/services/meshcore/Kconfig
```kconfig
# Copyright (c) 2026 FoBE Studio
# SPDX-License-Identifier: Apache-2.0

menuconfig MESHBUS_MESHCORE
	bool "Meshbus MeshCore service [EXPERIMENTAL]"
	default n
	depends on SETTINGS
	depends on ZEPHYR_MESHCORE_MODULE
	select MESHCORE
	select REBOOT
	select ENTROPY_GENERATOR
	select EXPERIMENTAL
	help
	  Enable the Meshbus MeshCore service.

	  This service hosts the Zephyr-facing MeshCore runtime and Companion
	  protocol adapters while keeping lib/meshcore as platform-neutral C code.

if MESHBUS_MESHCORE

module = MESHBUS_MESHCORE
module-str = meshbus_meshcore
module-dep = MESHBUS
module-help = Sets log level for Meshbus MeshCore service
source "subsys/logging/Kconfig.template.log_config"

config MESHBUS_MESHCORE_NAME_PUBKEY_PREFIX_BYTES
	int "Default MeshCore name pubkey prefix bytes"
	default 3
	range 1 15
	help
	  When meshbus_meshcore_config_set() is called with an empty name, the
	  MeshCore service auto-fills a stable default name using the first N
	  bytes of the public key, encoded as uppercase hex.

config MESHBUS_MESHCORE_NODE_KEY_PREFIX_BYTES
	int "MeshCore node key prefix bytes"
	default 4
	range 3 5
	depends on MESHBUS_MESHCORE_RUNTIME
	help
	  Number of public key bytes the MeshCore protocol runtime uses when it
	  tracks node-targeted pending requests and path metadata.

config MESHBUS_MESHCORE_REQUEST_TIMEOUT_MS
	int "MeshCore runtime request timeout (ms)"
	default 10000
	range 10000 60000
	depends on MESHBUS_MESHCORE_RUNTIME
	help
	  Timeout for MeshCore runtime pending node requests, including path,
	  trace, telemetry, and binary request correlation.

	choice
	prompt "MeshCore firmware role"
	default MESHBUS_MESHCORE_ROLE_CHAT
	help
	  Select the firmware role reported by this image. This is a build-time
	  product identity; it is not part of mutable MeshCore configuration.

config MESHBUS_MESHCORE_ROLE_CHAT
	bool "Chat/client"

config MESHBUS_MESHCORE_ROLE_REPEATER
	bool "Repeater"

config MESHBUS_MESHCORE_ROLE_ROOM
	bool "Room"

config MESHBUS_MESHCORE_ROLE_SENSOR
	bool "Sensor"

	endchoice

config MESHBUS_MESHCORE_FIRMWARE_ROLE
	int
	default 1 if MESHBUS_MESHCORE_ROLE_CHAT
	default 2 if MESHBUS_MESHCORE_ROLE_REPEATER
	default 3 if MESHBUS_MESHCORE_ROLE_ROOM
	default 4 if MESHBUS_MESHCORE_ROLE_SENSOR

config MESHBUS_MESHCORE_RUNTIME
	bool "Enable MeshCore lib-mc runtime"
	default y
	depends on MESHBUS_RADIO
	help
	  Build the lib-mc based runtime that subscribes to Meshbus request
	  channels and drives MeshCore processing. Tests may disable this when
	  they only need the Companion protocol adapter.

config MESHBUS_MESHCORE_CLIENT
	bool "MeshCore client role support"
	default y if MESHBUS_CHANNEL && MESHBUS_MESSAGE
	depends on MESHBUS_MESHCORE_RUNTIME
	depends on MESHBUS_CONTACT
	depends on MESHBUS_CHANNEL
	depends on MESHBUS_MESSAGE
	help
	  Enable MeshCore client behavior which integrates with Meshbus contact,
	  channel, and message storage APIs.

config MESHBUS_MESHCORE_CLIENT_IGNORE_DIRECT_PATH_REQUESTS
	bool "MeshCore client ignore direct path requests (for relay tests)"
	default n
	depends on MESHBUS_MESHCORE_CLIENT
	help
	  Enable MeshCore client behavior to ignore direct path requests.
	  This is useful for testing multi-hop relay scenarios without
	  interference from direct requests.

config MESHBUS_MESHCORE_SHELL
	bool "MeshCore shell commands"
	depends on MESHBUS_SHELL
	default y
	help
	  Enable shell commands for MeshCore config and MeshCore-owned requests.

config MESHBUS_MESHCORE_STATS
	bool "Meshbus MeshCore statistics"
	depends on MESHBUS_STATS
	default y
	help
	  Enable MeshCore request-admission statistics. Counters distinguish
	  requests accepted by the runtime queue from queue exhaustion, missing
	  runtime consumers, and other submission-layer failures.

config MESHBUS_MESHCORE_INIT_PRIORITY
	int "MeshCore init priority"
	default 95
	depends on MESHBUS_MESHCORE_RUNTIME
	help
	  Init priority for the MeshCore runtime. This must run after Meshbus
	  services initialize because the runtime calls Meshbus service APIs.

config MESHBUS_MESHCORE_WORKQ_STACK_SIZE
	int "MeshCore workqueue stack size"
	default 4096
	depends on MESHBUS_MESHCORE_RUNTIME
	help
	  Stack size for the MeshCore runtime workqueue thread.

config MESHBUS_MESHCORE_WORKQ_PRIORITY
	int "MeshCore workqueue priority"
	default 5
	depends on MESHBUS_MESHCORE_RUNTIME
	help
	  Thread priority for the MeshCore runtime workqueue.

config MESHBUS_MESHCORE_PACKET_POOL_SIZE
	int "MeshCore packet pool size"
	default 10
	depends on MESHBUS_MESHCORE_RUNTIME
	help
	  Packet pool size for MeshCore runtime instance.

config MESHBUS_MESHCORE_REQUEST_QUEUE_DEPTH
	int "MeshCore service request queue depth"
	default 8
	range 1 32
	depends on MESHBUS_MESHCORE_RUNTIME
	help
	  Total number of Meshbus request events that can wait in the MeshCore
	  service inbox. Listener callbacks use this queue with K_NO_WAIT and
	  never block publisher context. Large requests use a separate small slab
	  pool below, so this value mainly sizes lightweight control bursts.

config MESHBUS_MESHCORE_REQUEST_LARGE_QUEUE_DEPTH
	int "MeshCore large request queue depth"
	default 2
	range 1 8
	depends on MESHBUS_MESHCORE_RUNTIME
	help
	  Number of large Meshbus request payloads that can wait in the MeshCore
	  service inbox. Peer-advert and message-send requests need full payload
	  storage; other requests use the lightweight request slab.

config MESHBUS_MESHCORE_RADIO_RX_QUEUE_DEPTH
	int "MeshCore service radio RX queue depth"
	default 4
	range 1 16
	depends on MESHBUS_MESHCORE_RUNTIME
	help
	  Number of received radio packets staged by the MeshCore service before
	  the serialized runtime work handler injects them when the local fallback
	  RX queue is used.

config MESHBUS_MESHCORE_RADIO_RX_ZBUS_SUBSCRIBER
	bool "Use ZBus subscriber for MeshCore radio RX"
	default y if ZBUS_MSG_SUBSCRIBER
	depends on MESHBUS_MESHCORE_RUNTIME
	depends on ZBUS_MSG_SUBSCRIBER
	help
	  Use Zephyr's ZBus message-subscriber queue for radio receive events
	  instead of keeping a MeshCore-private RX ring. Builds that already use
	  ZBus message subscribers can share that pool and reduce MeshCore static
	  RAM. Builds without ZBus message subscribers keep the local service
	  queue above.

config MESHBUS_MESHCORE_TXT_ACK_DELAY
	int "MeshCore TXT ACK delay (ms)"
	default 200
	depends on MESHBUS_MESHCORE_RUNTIME
	help
	  Delay in milliseconds before sending ACK for TXT messages received by
	  the MeshCore runtime.

config MESHBUS_MESHCORE_SERVER_RESPONSE_DELAY
	int "MeshCore server response delay (ms)"
	default 300
	depends on MESHBUS_MESHCORE_RUNTIME
	help
	  Delay in milliseconds before responding to server requests by the
	  MeshCore runtime.

config MESHBUS_MESHCORE_COMPANION_PROTOCOL
	bool "MeshCore Companion binary protocol adapter"
	default n
	depends on MESHBUS_CONTACT
	select PSA_CRYPTO
	select PSA_WANT_ALG_SHA_256
	help
	  Enable the transport-agnostic MeshCore Companion protocol adapter.
	  The adapter parses complete Companion app binary frames and emits
	  complete response or push frames through a caller-provided transport.

if MESHBUS_MESHCORE_COMPANION_PROTOCOL

config MESHBUS_MESHCORE_COMPANION_PROTOCOL_CLOCK_SET
	bool "Enable Companion set-time command"
	default MESHBUS_CLOCK
	help
	  Allow CMD_SET_DEVICE_TIME to call the Meshbus runtime realtime-clock
	  setter. Production builds normally get this through MESHBUS_CLOCK.
	  Tests may enable it with a linker-wrapped setter to avoid pulling the
	  full clock service into RAM-constrained qemu targets.

endif # MESHBUS_MESHCORE_COMPANION_PROTOCOL

config MESHBUS_MESHCORE_COMPANION_BLUETOOTH
	bool "MeshCore Companion Bluetooth NUS transport"
	default n
	depends on MESHBUS_BLUETOOTH
	select BT_ZEPHYR_NUS
	select BT_ZEPHYR_NUS_DEFAULT_INSTANCE
	select MESHBUS_MESHCORE_COMPANION_PROTOCOL
	help
	  Expose the MeshCore Companion binary protocol over Zephyr's upstream
	  Nordic UART Service. Meshbus Bluetooth owns advertising, security, and
	  connection policy; this transport subscribes to Bluetooth state events
	  and binds NUS callbacks to the Companion protocol adapter.

config MESHBUS_MESHCORE_COMPANION_BLUETOOTH_INIT_PRIORITY
	int "MeshCore Companion Bluetooth init priority"
	default 91
	depends on MESHBUS_MESHCORE_COMPANION_BLUETOOTH
	help
	  Initialization priority for the Companion Bluetooth transport. It should
	  run after the Meshbus Bluetooth service initializes its state channels.

config MESHBUS_MESHCORE_COMPANION_BLUETOOTH_WORKQUEUE_STACK_SIZE
	int "MeshCore Companion Bluetooth workqueue stack size"
	default 3072
	depends on MESHBUS_MESHCORE_COMPANION_BLUETOOTH
	help
	  Stack size for the dedicated Companion Bluetooth workqueue.

config MESHBUS_MESHCORE_COMPANION_BLUETOOTH_WORKQUEUE_PRIORITY
	int "MeshCore Companion Bluetooth workqueue priority"
	default 0
	depends on MESHBUS_MESHCORE_COMPANION_BLUETOOTH
	help
	  Priority for the dedicated Companion Bluetooth workqueue.

config MESHBUS_MESHCORE_COMPANION_BLUETOOTH_RX_QUEUE_DEPTH
	int "MeshCore Companion Bluetooth RX queue depth"
	default 2
	range 1 8
	depends on MESHBUS_MESHCORE_COMPANION_BLUETOOTH
	help
	  Number of complete Companion Bluetooth frames that can wait for adapter
	  processing after a NUS receive callback.

config MESHBUS_MESHCORE_COMPANION_BLUETOOTH_TX_QUEUE_DEPTH
	int "MeshCore Companion Bluetooth TX queue depth"
	default 4
	range 1 8
	depends on MESHBUS_MESHCORE_COMPANION_BLUETOOTH
	help
	  Number of complete response and push frames accepted for NUS delivery
	  or retry, including the frame currently being sent. This is the only
	  Companion TX queue; a full queue rejects either frame type immediately.

endif # MESHBUS_MESHCORE
```
