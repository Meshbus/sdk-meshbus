## subsys/dfu/Kconfig
```kconfig
# DFU support configuration options

# Copyright (c) 2026 FoBE Studio
# SPDX-License-Identifier: Apache-2.0

#
# DFU
#

menuconfig IMG_MANAGER
	bool "DFU image manager"
	depends on STREAM_FLASH
	depends on !MCUBOOT_BOOTLOADER_MODE_RAM_LOAD || RETENTION_BOOTLOADER_INFO_OUTPUT_FUNCTION
	help
	  Enable support for managing DFU image.

if IMG_MANAGER

if MCUBOOT_IMG_MANAGER

config MCUBOOT_DELTA
	bool "MCUboot delta updates"
	depends on DETOOLS
	select PSA_CRYPTO
	select PSA_WANT_ALG_SHA_256
	help
	  Enable support for MCUboot delta updates.

config MCUBOOT_DELTA_SHELL
	bool "MCUboot shell"
	depends on SHELL
	depends on MCUBOOT_DELTA
	help
	  Enable shell module, which provides commands to create
	  and apply delta updates.

endif # MCUBOOT_IMG_MANAGER

module = IMG_MANAGER
module-str = image manager
source "subsys/logging/Kconfig.template.log_config"

endif # IMG_MANAGER
```

## subsys/display/Kconfig
```kconfig
# Copyright (c) 2026 FoBE Studio
# SPDX-License-Identifier: Apache-2.0

menuconfig MBS_DISPLAY
	bool "Meshbus Display Service"
	depends on DISPLAY
	default n
	help
	  Enable Meshbus display service.

	  This service provides runtime display configuration, automatic sleep,
	  and display state publishing via ZBus.

if MBS_DISPLAY

module = MBS_DISPLAY
module-str = mbs_display
module-dep = MBS
module-help = Sets log level for Meshbus Display service
source "subsys/logging/Kconfig.template.log_config"

config MBS_DISPLAY_DEFAULT_BRIGHTNESS
	int "Default brightness"
	range 0 100
	default 100
	help
	  Default display brightness percentage (0-100).

config MBS_DISPLAY_DEFAULT_SLEEP_TIMEOUT
	int "Default sleep timeout (seconds)"
	range 0 300
	default 0
	help
	  Default display sleep timeout in seconds.
	  0 means automatic sleep is disabled.

config MBS_DISPLAY_DEFAULT_INVERT
	bool "Default invert"
	default n
	help
	  Default display invert setting.

config MBS_DISPLAY_INIT_PRIORITY
	int "Display service init priority"
	default 90
	help
	  Initialization priority for the Meshbus Display service.

config MBS_DISPLAY_DUMP_MAX_SIZE
	int "Maximum frozen display snapshot size in bytes"
	depends on U8G2_SNAPSHOT
	range 1 65536
	default 1024
	help
	  Storage for one shared snapshot used by chunked Display dump reads.
	  1024 bytes holds a 128x64 monochrome frame. Larger frames return
	  an error unless this limit is increased.

config MBS_DISPLAY_SHELL
	bool "Meshbus Display shell commands"
	depends on MBS_SHELL
	default y
	help
	  Enable shell commands for Meshbus Display service.

endif # MBS_DISPLAY
```

## subsys/firmware/Kconfig
```kconfig
# Copyright (c) 2026 FoBE Studio
# SPDX-License-Identifier: Apache-2.0

config MBS_FIRMWARE_IMAGE_IDENTITY
	bool "Read installed firmware image identity"
	depends on BOOTLOADER_MCUBOOT && FLASH_MAP
	select PSA_CRYPTO
	select PSA_WANT_ALG_SHA_256
	help
	  Read the primary MCUboot image digest for exact EDK selection without
	  enabling firmware updates or changing boot signature verification.

menuconfig MBS_FIRMWARE
	bool "Meshbus firmware update coordinator [EXPERIMENTAL]"
	default n
	depends on MBS
	depends on BOOTLOADER_MCUBOOT
	depends on MCUBOOT_BOOTLOADER_MODE_SWAP_USING_OFFSET
	depends on IMG_MANAGER && FLASH_MAP
	depends on MCUBOOT_DELTA
	select CRC
	select PSA_CRYPTO
	select PSA_WANT_ALG_SHA_256
	select EXPERIMENTAL
	help
	  Register transport-independent Firmware MCUmgr commands and coordinate the
	  shared MCUboot update lifecycle. Any configured SMP transport may dispatch
	  these commands through MCUmgr. Product transport policy decides which
	  groups each bearer exposes; the Firmware service does not branch on UART,
	  Bluetooth, or MeshCore/LoRa origin.

if MBS_FIRMWARE

module = MBS_FIRMWARE
module-str = mbs_firmware
module-dep = MBS
module-help = Sets log level for Meshbus Firmware service
source "subsys/logging/Kconfig.template.log_config"

config MBS_FIRMWARE_ROLE
	int "Endpoint image class"
	default 1
	range 1 3
	help
	  Immutable update-format identity, independent of the MeshCore role.

config MBS_FIRMWARE_BOARD_ID
	string
	default "mesh_probe_r2" if BOARD_MESH_PROBE_R2
	default "devkit_nrf54l15" if BOARD_DEVKIT_NRF54L15
	default "unsupported"

config MBS_FIRMWARE_SOC_ID
	string
	default "nrf54l15"

config MBS_FIRMWARE_HARDWARE_REVISION
	int
	default 1
	range 0 65535

config MBS_FIRMWARE_IMAGE_KEY_ID
	int
	default 1
	range 1 65535

config MBS_FIRMWARE_MANIFEST_KEY_ID
	int
	default 1
	range 1 65535

config MBS_FIRMWARE_SECURITY_COUNTER
	int "Minimum accepted delta security counter"
	default 1
	range 0 2147483647
	help
	  Reject manifests whose protected MCUboot security counter is below
	  this value. Set the target or release floor to match its anti-rollback
	  policy. This does not set the counter stamped into signed images; use
	  CONFIG_MCUBOOT_EXTRA_IMGTOOL_ARGS for that value.

config MBS_FIRMWARE_MANIFEST_PUBLIC_KEY_HEX
	string
	default "d4b31ba49a3add3f825d10ca7f31b50b0de87f37ccc49f1a403a5c1320ffb4e0"
	help
	  Raw 32-byte Ed25519 public key in hex. The default is the repository
	  engineering key and must never be used as a production trust root.

config MBS_FIRMWARE_IMAGE_PUBLIC_KEY_HEX
	string
	default "d4b31ba49a3add3f825d10ca7f31b50b0de87f37ccc49f1a403a5c1320ffb4e0"
	help
	  Raw 32-byte MCUboot Ed25519 public key in hex. This is deliberately
	  independent of MBS_FIRMWARE_MANIFEST_PUBLIC_KEY_HEX even when both
	  engineering defaults currently name the same repository test key.

config MBS_FIRMWARE_ACTIVATE_HANDOFF_TIMEOUT_MS
	int "Activation response handoff fallback timeout"
	default 60000
	range 5000 300000
	help
	  Maximum time to wait for an SMP transport adapter to report delivery of
	  the DELTA_ACTIVATE response. The timeout is a transport-independent
	  recovery fallback. An adapter with a reliable delivery-completion signal
	  may request the normal immediate reboot handoff.

config MBS_FIRMWARE_MCUMGR_IMAGE
	bool "Coordinate standard MCUmgr full-image uploads"
	default y
	depends on MCUMGR_GRP_IMG
	depends on !MCUMGR_GRP_IMG_ALLOW_CONFIRM_NON_ACTIVE_SLOT
	select MCUMGR_MGMT_NOTIFICATION_HOOKS
	select MCUMGR_SMP_COMMAND_STATUS_HOOKS
	select MCUMGR_GRP_IMG_UPLOAD_CHECK_HOOK
	select MCUMGR_GRP_IMG_STATUS_HOOKS
	select MCUMGR_GRP_IMG_MUTEX
	help
	  Apply the Firmware service's update-slot exclusion and power policy to
	  Zephyr's standard image-management group, independently of the SMP
	  transport that dispatched it. Each configured SMP transport or adapter
	  owns its own group-exposure policy. Permanent activation of an image that
	  has not booted is deliberately disabled; the candidate must boot in test
	  mode before the application can ask Firmware to confirm it.

config MBS_FIRMWARE_ASSUME_SAFE_POWER
	bool "Assume a stable external power source"
	default n
	help
	  Explicit engineering-fixture escape hatch for targets that have no
	  Meshbus Power service or fuel-gauge/charger telemetry. Production
	  targets should leave this disabled and remain fail-closed until the
	  Power service reports an online or charging external source.

config MBS_FIRMWARE_APPLY_STACK_SIZE
	int
	default 6144
	range 4096 16384

config MBS_FIRMWARE_INIT_PRIORITY
	int
	default 97

endif
```

## subsys/gnss/Kconfig
```kconfig
# Copyright (c) 2026 FoBE Studio
# SPDX-License-Identifier: Apache-2.0

menuconfig MBS_GNSS
	bool "Meshbus GNSS Management Layer"
	depends on GNSS
	depends on ZBUS
	depends on SETTINGS
	default n
	help
	  Enable the Meshbus GNSS management layer which provides:
	  - GNSS configuration persistence via Settings
	  - Periodic position sampling with power management
	  - ZBus event publishing for position data
	  - GNSS statistics via Zephyr Stats (MCUmgr compatible)

if MBS_GNSS

module = MBS_GNSS
module-str = mbs_gnss
module-dep = MBS
module-help = Sets log level for Meshbus GNSS module
source "subsys/logging/Kconfig.template.log_config"

config MBS_GNSS_MIN_ACTIVE_TIME
	int "Minimum allowed GNSS active time (ms)"
	default 1000
	range 100 86400000
	help
	  Lower bound for mbs_config.gnss.min_active_time.

config MBS_GNSS_MAX_ACTIVE_TIME
	int "Maximum allowed GNSS active time (ms)"
	default MBS_GNSS_MAX_UPDATE_INTERVAL
	range 100 86400000
	help
	  Upper bound for mbs_config.gnss.min_active_time.
	  Note: if min_active_time is larger than update_interval at runtime,
	  the effective active time will be clamped to update_interval.

config MBS_GNSS_DEFAULT_MIN_ACTIVE_TIME
	int "Default minimum GNSS active time (ms)"
	default 15000
	range MBS_GNSS_MIN_ACTIVE_TIME MBS_GNSS_MAX_ACTIVE_TIME
	help
	  Default value for mbs_config.gnss.min_active_time.

config MBS_GNSS_MIN_UPDATE_INTERVAL
	int "Minimum GNSS update interval in milliseconds"
	default 1000
	range 1000 86400000
	help
	  Minimum allowed interval between GNSS position updates (ms).
	  Used by runtime validation and as the lower bound for the
	  default update interval.

config MBS_GNSS_MAX_UPDATE_INTERVAL
	int "Maximum GNSS update interval in milliseconds"
	default 86400000
	range 1000 86400000
	help
	  Maximum allowed interval between GNSS position updates (ms).
	  Used by runtime validation and as the upper bound for the
	  default update interval.

config MBS_GNSS_DEFAULT_ENABLED
	bool "Default GNSS enabled state"
	default y
	help
	  Default value for mbs_gnss_config.enabled.

config MBS_GNSS_DEFAULT_UPDATE_INTERVAL
	int "Default update interval in milliseconds"
	default 30000
	range MBS_GNSS_MIN_UPDATE_INTERVAL MBS_GNSS_MAX_UPDATE_INTERVAL
	help
	  Default interval between GNSS position updates in milliseconds.
	  Must be between MBS_GNSS_MIN_UPDATE_INTERVAL and
	  MBS_GNSS_MAX_UPDATE_INTERVAL.
	  Can be changed at runtime via configuration API.

config MBS_GNSS_DEFAULT_NAV_MODE
	int "Default GNSS navigation mode"
	default 0
	range 0 3
	help
	  Default value for mbs_gnss_config.nav_mode.
	  0..3 maps directly to Zephyr gnss_navigation_mode.

config MBS_GNSS_DEFAULT_FIX_RATE
	int "Default fix rate in Hz"
	default 1
	range 1 10
	help
	  Default GNSS fix rate (position updates per second when active).
	  Higher values consume more power.

config MBS_GNSS_DEFAULT_SYSTEM_MASK
	hex "Default GNSS system mask"
	default 0xFF
	range 0x01 0xFF
	help
	  Default value for mbs_gnss_config.system_mask.
	  Each bit enables a GNSS system (GPS/GLONASS/Galileo/BeiDou/...).

config MBS_GNSS_DEFAULT_TIME_SYNC
	bool "Default GNSS time_sync"
	default y
	help
	  Default value for mbs_gnss_config.time_sync.

config MBS_GNSS_HEADING_SAMPLE_INTERVAL
	int "Compass Widget heading update interval in milliseconds"
	default 50
	range 20 1000
	help
	  Page-local electronic Compass acquisition or GNSS course-cache polling
	  interval while at least one Widget lease is active.

config MBS_GNSS_HEADING_PROVIDER_FAST_FREQUENCY
	int "Electronic Compass interactive frequency in Hz"
	default 104
	range 1 6660
	help
	  Volatile frequency requested from the DTS electronic Compass provider
	  while the Compass Widget is open. Providers may return -ENOTSUP and keep
	  their native output rate.

config MBS_GNSS_HEADING_PROVIDER_SETTLE_MS
	int "Electronic Compass settling delay in milliseconds"
	default 60
	range 0 $(UINT32_MAX)
	help
	  Delay before the first electronic heading sample after the provider is
	  powered and its interactive rate is requested.

config MBS_GNSS_HEADING_MIN_COURSE_SPEED
	int "Minimum GNSS course speed in millimeters per second"
	default 1000
	range 1 $(UINT32_MAX)
	help
	  GNSS course-over-ground is invalid below this speed because it does not
	  provide a stable direction while the device is nearly stationary.

config MBS_GNSS_HEADING_MAX_COURSE_AGE
	int "Maximum GNSS course age in milliseconds"
	default 5000
	range 100 $(UINT32_MAX)
	help
	  Cached GNSS course data older than this is reported stale.

config MBS_GNSS_TIME_SYNC_THRESHOLD_S
	int "GNSS time sync threshold (seconds)"
	default 2
	range 0 3600
	help
	  If GNSS time sync is enabled, update SYS_CLOCK_REALTIME only when the
	  absolute difference between GNSS UTC and system time exceeds this
	  threshold in seconds. Set to 0 to always sync on each time update.

config MBS_GNSS_TIME_SYNC_INIT_INTERVAL
	int "GNSS time sync initial poll interval (ms)"
	default 2000
	range 100 60000
	help
	  When GNSS time sync is enabled, the service will poll for the first
	  valid GNSS fix at this interval. Once a valid fix is observed, polling
	  switches to MBS_GNSS_TIME_SYNC_CAL_INTERVAL.

config MBS_GNSS_TIME_SYNC_CAL_INTERVAL
	int "GNSS time sync slow poll interval (ms)"
	default MBS_GNSS_DEFAULT_UPDATE_INTERVAL
	range 1000 86400000
	help
	  When GNSS time sync is enabled and at least one valid fix has been
	  observed, the service will poll at this interval and sync only when a
	  new valid-fix sample arrives.

config MBS_GNSS_SATELLITE_CACHE_SIZE
	int "Maximum number of satellites to cache"
	default 32
	range 12 64
	depends on GNSS_SATELLITES
	help
	  Maximum number of satellites to cache for satellite info API.
	  The cache stores satellites from all enabled GNSS systems
	  (GPS, GLONASS, Galileo, BeiDou, etc.) and handles deduplication
	  when multiple systems are enabled.
	  Typical values: 24 for single system, 32-48 for multi-system.

config MBS_GNSS_SHELL
	bool "Meshbus GNSS shell commands"
	depends on MBS_SHELL
	default y
	help
	  Enable shell commands for Meshbus GNSS subsystem.
	  Provides commands for GNSS configuration and diagnostics.

config MBS_GNSS_STATS
	bool "Meshbus GNSS statistics"
	depends on MBS_STATS
	select STATS
	select STATS_NAMES
	default y
	help
	  Enable statistics for Meshbus GNSS subsystem.

endif # MBS_GNSS
```
