## subsys/indicator/Kconfig
```kconfig
# Copyright (c) 2026 FoBE Studio
# SPDX-License-Identifier: Apache-2.0

menuconfig MBS_INDICATOR
	bool "Meshbus Indicator Subsystem"
	default n
	help
	  Enable the Meshbus indicator subsystem which provides:
	  - Light indicator control (GPIO/PWM/LED strip)
	  - Buzzer audio feedback (PWM)
	  - Simple request model (new requests replace current)
	  - Configuration persistence via Settings

if MBS_INDICATOR

module = MBS_INDICATOR
module-str = mbs_indicator
module-dep = MBS
module-help = Sets log level for Meshbus Indicator module
source "subsys/logging/Kconfig.template.log_config"

config MBS_INDICATOR_LIGHT
	bool "Enable Light indicator"
	default y
	help
	  Enable Light indicator support. The Light device is selected via
	  devicetree chosen node "meshbus,indicator-light-active".

config MBS_INDICATOR_BUZZER
	bool "Enable buzzer indicator"
	default y
	depends on PWM
	help
	  Enable buzzer indicator support. The buzzer PWM device is selected
	  via devicetree chosen node "meshbus,indicator-buzzer".

config MBS_INDICATOR_BUZZER_RTTTL_MAX_NOTES
	int "Maximum notes in RTTTL melody"
	default 128
	range 16 256
	depends on MBS_INDICATOR_BUZZER
	help
	  Maximum number of notes that can be parsed from an RTTTL string.
	  Each note uses 4 bytes of static memory.

config MBS_INDICATOR_INPUT_FEEDBACK
	bool "Play buzzer feedback for input actions"
	default y
	depends on MBS_INPUT && MBS_INDICATOR_BUZZER
	help
	  Play short system tones when Meshbus input publishes short-press or
	  long-press actions. Encoder scroll actions use the short-press tone.
	  Raw press/release actions are ignored.

config MBS_INDICATOR_MESSAGE_FEEDBACK
	bool "Play buzzer feedback for received messages"
	default y
	depends on MBS_MESSAGE
	help
	  Play a short buzzer melody when Meshbus Message publishes an inbound
	  message response. The indicator buzzer configuration decides whether
	  direct and channel message alerts are allowed.

config MBS_INDICATOR_DEFAULT_LIGHT_HEARTBEAT
	bool "Enable light heartbeat feedback by default"
	default y
	help
	  Enable idle heartbeat light feedback by default.

config MBS_INDICATOR_DEFAULT_BUZZER_DIRECT_MESSAGE
	bool "Enable direct message buzzer feedback by default"
	default y
	help
	  Enable buzzer feedback for received direct messages by default.

config MBS_INDICATOR_DEFAULT_BUZZER_CHANNEL_MESSAGE
	bool "Enable channel message buzzer feedback by default"
	default y
	help
	  Enable buzzer feedback for received channel messages by default.

config MBS_INDICATOR_DEFAULT_BUZZER_SYSTEM
	bool "Enable system buzzer feedback by default"
	default y
	help
	  Enable buzzer feedback for system events by default.

config MBS_INDICATOR_LIGHT_IDLE_OFF_DURATION
	int "Default idle heartbeat off duration (ms)"
	default 4990
	range 1000 10000
	help
	  Duration of the Light off phase during idle heartbeat.
	  Total period = on_duration + off_duration.

config MBS_INDICATOR_LIGHT_IDLE_ON_DURATION
	int "Default idle heartbeat on duration (ms)"
	default 10
	range 10 500
	help
	  Duration of the Light on phase during idle heartbeat blink.

config MBS_INDICATOR_LIGHT_DEFAULT_RED
	int "Default Light red component (0-255)"
	default 0
	range 0 255
	help
	  Default red color component for Light indicator.

config MBS_INDICATOR_LIGHT_DEFAULT_GREEN
	int "Default Light green component (0-255)"
	default 0
	range 0 255
	help
	  Default green color component for Light indicator.

config MBS_INDICATOR_LIGHT_DEFAULT_BLUE
	int "Default Light blue component (0-255)"
	default 16
	range 0 255
	help
	  Default blue color component for Light indicator.

config MBS_INDICATOR_INIT_PRIORITY
	int "Indicator subsystem init priority"
	default 90
	help
	  Initialization priority for the indicator subsystem.

config MBS_INDICATOR_SHELL
	bool "Meshbus Indicator shell commands"
	depends on MBS_SHELL
	default y
	help
	  Enable shell commands for Meshbus Indicator subsystem.
	  Provides commands for testing Light and buzzer patterns.

endif # MBS_INDICATOR
```

## subsys/input/Kconfig
```kconfig
# Copyright (c) 2026 FoBE Studio
# SPDX-License-Identifier: Apache-2.0

menuconfig MBS_INPUT
	bool "Meshbus input bridge"
	depends on INPUT
	default n
	help
      This option enables the Meshbus input bridge module.
      The input bridge module captures input events from
      various input devices (buttons, rotary encoders, keypads)
      and publishes them onto the Meshbus network via ZBUS.

if MBS_INPUT

module = MBS_INPUT
module-str = mbs_input
module-dep = MBS
module-help = Sets log level for Meshbus Input module
source "subsys/logging/Kconfig.template.log_config"

config MBS_INPUT_BUTTON
	bool "Enable button input (primary/secondary)"
	default y

config MBS_INPUT_BUTTON_MAX
	int "Maximum number of buttons to track"
	default 10
	depends on MBS_INPUT_BUTTON
	help
	  Maximum number of distinct button codes that can be tracked
	  simultaneously for gesture detection (short/long press).

config MBS_INPUT_ENCODER
	bool "Enable rotary encoder (scroll)"
	default y

config MBS_INPUT_KEYPAD
	bool "Enable keypad (e.g. IT8801)"
	default y

config MBS_INPUT_KEYPAD_MAX_KEYS
	int "Maximum number of keypad keys to track"
	default 16
	depends on MBS_INPUT_KEYPAD
	help
	  Maximum number of distinct keypad key codes that can be tracked
	  simultaneously for gesture detection (short/long press).

config MBS_INPUT_LONG_PRESS_MS
	int "Long press threshold (ms)"
	default 800
	depends on INPUT

config MBS_INPUT_REPEAT_DELAY_MS
	int "Directional key repeat start delay (ms)"
	default 350
	range 0 60000
	depends on INPUT
	help
	  Delay before held directional keys start publishing repeated short
	  actions. OK/BACK keys continue to use long-press detection.

config MBS_INPUT_REPEAT_INTERVAL_MS
	int "Directional key repeat interval (ms)"
	default 250
	range 1 60000
	depends on INPUT
	help
	  Interval between repeated short actions while a directional key remains
	  pressed. Set a positive value to keep navigation cadence predictable.

config MBS_INPUT_DEBOUNCE_MS
	int "Debounce time for key state changes (ms)"
	default 30
	depends on INPUT
	help
	  Debounce window applied to INPUT_EV_KEY state changes in Meshbus input
	  services (buttons and keypad). Events that toggle state within this
	  window are dropped. Set to 0 to disable.

config MBS_INPUT_ENCODER_STEP_THRESHOLD
	int "Encoder step aggregation threshold"
	default 1
	depends on INPUT

config MBS_INPUT_SHELL
	bool "Meshbus Input shell commands"
	depends on MBS_SHELL
	default y
	help
	  Enable shell commands for Meshbus Input subsystem.
	  Provides commands for basic diagnostics and event injection.

endif # MBS_INPUT
```

## subsys/llext/Kconfig
```kconfig
# Copyright (c) 2026 FoBE Studio
# SPDX-License-Identifier: Apache-2.0

menuconfig MBS_LLEXT
	bool "Meshbus LLEXT Extension Manager"
	depends on LLEXT && ZUI
	depends on FILE_SYSTEM
	select MBS_FS
	select LLEXT_HEAP_DYNAMIC
	default n
	help
	  Enable metadata inspection and loading of Desktop foreground apps
	  (.mba). Desktop owns execution; one app can be loaded at a time.

config MBS_LLEXT_BRIDGE
	bool "Meshbus LLEXT Bridge and exports"
	depends on LLEXT
	select LLEXT_EXPORT_DEVICES
	select LLEXT_EXPORT_DEV_IDS_BY_HASH
	select EVENTS
	select ZBUS_RUNTIME_OBSERVERS
	select ZBUS_PREFER_DYNAMIC_ALLOCATION
	default y
	help
	  Enable centralized Meshbus LLEXT bridge and EXPORT_SYMBOL tables.
	  This option keeps service LLEXT integration code in
	  subsys/llext while allowing it to be disabled
	  independently from the Desktop app loader.
	  Export host devicetree devices for native Zephyr driver APIs. Device
	  symbols use path hashes instead of dependency ordinals; this does not
	  replace the requirement to build against the target host's EDK.

if MBS_LLEXT

config MBS_LLEXT_LOG_LEVEL
	int "Log level for Meshbus LLEXT"
	default 3
	range 0 4
	help
	  Sets the log level for the Meshbus LLEXT extension manager.
	  0 = Off, 1 = Error, 2 = Warning, 3 = Info, 4 = Debug.

config MBS_LLEXT_APP_DEFAULT_PATH
	string "Default Desktop app extension path"
	default "/extra/apps"
	help
	  Default filesystem path where Desktop app extensions are stored.

config MBS_LLEXT_APP_MAX_HEAP_SIZE
	int "Maximum Desktop app LLEXT heap estimate"
	default 16384
	range 1024 1048576
	help
	  Maximum heap-size accepted from one Desktop app .mba metadata blob.
	  The value is generated by west meshbus llext and represents an estimate.

config MBS_LLEXT_APP_HEAP_RESERVE_SIZE
	int "Maximum dynamic LLEXT heap budget for one Desktop app"
	default 16384
	range 0 1048576
	help
	  Maximum dynamic LLEXT heap budget accepted for one foreground
	  Desktop app. The loader allocates this heap lazily when an
	  app is loaded; it is not reserved during firmware boot.

config MBS_LLEXT_APP_SYSTEM_HEAP_HEADROOM_SIZE
	int "System heap headroom beside a maximum Desktop app"
	default 4096
	range 0 1048576
	help
	  Minimum part of Zephyr's final system heap (K_HEAP_MEM_POOL_SIZE) that
	  must remain outside the maximum dynamic LLEXT heap allocation, including
	  its configured margin. The final size includes subsystem
	  HEAP_MEM_POOL_ADD_SIZE requirements as well as CONFIG_HEAP_MEM_POOL_SIZE.
	  This compile-time admission guard leaves room for allocator metadata and
	  concurrent system-heap users. It does not replace runtime heap-pressure
	  testing with the target app and services.

config MBS_LLEXT_DEFAULT_ENABLED
	bool "Default LLEXT app loading enabled"
	default y
	help
	  Default enable state for new app probe/load requests. Disabling the
	  loader does not interrupt an already loaded application.

config MBS_LLEXT_TOTAL_HEAP_MAX_SIZE
	int "Maximum total LLEXT heap reservation"
	default 131072
	range 1024 1048576
	help
	  Maximum dynamic LLEXT heap allocation for one app after adding
	  the configured margin to its heap-size estimate.

config MBS_LLEXT_DYNAMIC_HEAP_MARGIN_PERCENT
	int "Dynamic LLEXT heap margin percent"
	depends on LLEXT_HEAP_DYNAMIC
	default 5
	range 0 100
	help
	  Percent margin added to the heap-size value recorded in
	  app metadata before Meshbus allocates memory from the system
	  heap and initializes the Zephyr LLEXT heap.

config MBS_LLEXT_SHELL
	bool "Meshbus LLEXT shell commands"
	depends on MBS_SHELL
	default y
	help
	  Enable meshbus llext application configuration commands.

endif # MBS_LLEXT
```

## subsys/management/Kconfig
```kconfig
# Copyright (c) 2026 FoBE Studio
# SPDX-License-Identifier: Apache-2.0

menuconfig MBS_MANAGEMENT
	bool "Meshbus management service [EXPERIMENTAL]"
	default n
	depends on MBS
	depends on MCUMGR
	depends on SETTINGS
	depends on MBS_MESHCORE
	depends on MBS_MESHCORE_RUNTIME || ZTEST
	select ENTROPY_GENERATOR
	select EXPERIMENTAL
	select MCUMGR_MGMT_NOTIFICATION_HOOKS
	select MCUMGR_SMP_COMMAND_STATUS_HOOKS
	select PSA_CRYPTO
	select MBEDTLS_PSA_CRYPTO_C
	select PSA_WANT_ALG_CCM
	select PSA_WANT_ALG_SHA_256
	select PSA_WANT_KEY_TYPE_AES
	help
	  Enable authenticated SMP-over-LoRa remote management.

	  Product exchanges use Contact-targeted MeshCore anonymous encrypted
	  datagrams as the bearer backend. The management envelope remains
	  independent of the MeshCore application protocol, Bluetooth, and
	  Companion protocol.

if MBS_MANAGEMENT

module = MBS_MANAGEMENT
module-str = mbs_management
module-dep = MBS
module-help = Sets log level for Meshbus management service
source "subsys/logging/Kconfig.template.log_config"

config MBS_MANAGEMENT_OPERATOR
	bool "Management remote operator support"
	default y
	depends on MBS_CONTACT
	help
	  Enable initiating authenticated remote SMP exchanges toward managed
	  Contact targets.

config MBS_MANAGEMENT_ENDPOINT
	bool "Management endpoint responder support"
	default y
	help
	  Enable accepting authenticated remote SMP requests from management
	  operators. The endpoint remains unavailable until a management secret is
	  provisioned through a trusted local path.

config MBS_MANAGEMENT_ANON_FRAME_MAX_LEN
	int "Maximum anonymous management frame length"
	default 136
	range 40 136
	help
	  Maximum encrypted management frame length sent over MeshCore anonymous
	  data. The default uses the complete MeshCore anonymous-data payload so a
	  608-byte SMP packet needs no more than six authenticated fragments.

config MBS_MANAGEMENT_MAX_FRAGMENTS
	int "Maximum management fragments per SMP packet"
	default 6
	range 1 8
	help
	  Maximum number of authenticated DATA fragments accepted for one
	  reassembled SMP packet. Request and response fragments use authenticated
	  stop-and-wait acknowledgement, so only one fragment is queued at a time.

config MBS_MANAGEMENT_COMMAND_RETRY_COUNT
	int "Remote SMP whole-command retry count"
	default 1
	range 0 3
	help
	  Number of times an operator retransmits every DATA_REQUEST fragment with
	  the same sequence after a response timeout. The endpoint retains partial
	  reassembly state and caches the last completed response so retries do not
	  execute a state-changing SMP command twice.

config MBS_MANAGEMENT_SMP_TIMEOUT_MS
	int "Remote SMP command timeout in milliseconds"
	default 60000
	range 1000 300000
	help
	  Time an operator waits for progress after sending a DATA_REQUEST fragment.
	  When this expires, the complete command is retried according to
	  MBS_MANAGEMENT_COMMAND_RETRY_COUNT. Keep this comfortably above the
	  worst-case LoRa airtime and peer processing latency.

config MBS_MANAGEMENT_MGMT_RESULT_CACHE_SIZE
	int "MCUmgr remote-result cache entries"
	default 2
	range 1 16
	help
	  Number of completed remote SMP responses retained for tag-based MCUmgr
	  polling. Cache slots are reused when all entries are occupied.

config MBS_MANAGEMENT_REQUEST_FRAGMENT_DELAY_MS
	int "Delay between remote management request fragments"
	default 50
	range 1 1000
	help
	  Delay between encrypted DATA_REQUEST fragments sent over MeshCore
	  anonymous data. This lets the MeshCore request worker drain one large
	  bearer item before management queues the next request fragment.

config MBS_MANAGEMENT_RESPONSE_FRAGMENT_DELAY_MS
	int "Delay between remote management response fragments"
	default 50
	range 1 1000
	help
	  Delay between encrypted DATA_RESPONSE fragments sent over MeshCore
	  anonymous data. This lets the MeshCore request worker drain one large
	  bearer item before management queues the next response fragment.

config MBS_MANAGEMENT_REPLY_DELAY_MS
	int "Radio turn-around delay for management replies"
	default 300
	range 0 2000
	help
	  Delay SESSION_CHALLENGE, fragment acknowledgements, session rejects,
	  and DATA_RESPONSE frames after an incoming LoRa packet. The peer needs
	  time to leave transmit mode and resume receive mode before a direct
	  reply is placed on air.

config MBS_MANAGEMENT_SESSION_TIMEOUT_MS
	int "Management session timeout in milliseconds"
	default 300000
	range 10000 3600000
	help
	  Time after the last authenticated DATA fragment before the transient
	  session is discarded.

config MBS_MANAGEMENT_SESSION_INIT_COOLDOWN_MS
	int "Unauthenticated SESSION_INIT cooldown in milliseconds"
	default 1000
	range 0 60000
	help
	  Minimum time between accepted unauthenticated SESSION_INIT frames. Set to
	  0 only in tightly controlled test builds.

config MBS_MANAGEMENT_INIT_PRIORITY
	int "Management service init priority"
	default 96
	help
	  Init priority for remote management. The default runs after the MeshCore
	  runtime default, so the MeshCore-derived local target ID is available.

config MBS_MANAGEMENT_SHELL
	bool "Management shell commands"
	depends on MBS_SHELL
	depends on MBS_MANAGEMENT_OPERATOR
	default y
	help
	  Enable shell commands for local management diagnostics.

endif # MBS_MANAGEMENT
```
