## samples/subsys/zui/host/sample.yaml
```yaml
sample:
  description: ZUI host/router state-machine sample
  name: zui host sample
common:
  tags: zui host
  build_only: true
tests:
  sample.zui.host:
    integration_platforms:
      - idea_mesh_tracker_c2/nrf54l15/cpuapp
```

## subsys/Kconfig
```kconfig
# Copyright (c) 2026 FoBE Studio
# SPDX-License-Identifier: Apache-2.0

menu "Subsystems"

rsource "dfu/Kconfig"

menuconfig MBS
	bool "Meshbus support [EXPERIMENTAL]"
	select REBOOT
	select ENTROPY_GENERATOR
	select NANOPB
	select NANOPB_ENABLE_MALLOC
	select EXPERIMENTAL
	select ZBUS
	select ZBUS_MSG_SUBSCRIBER
	select SETTINGS
	help
	  This option enables Meshbus networking support.
	  Meshbus provides peer-to-peer mesh networking with
	  built-in encryption and multi-hop routing capabilities.

if MBS

module = MBS
module-str = meshbus
module-help = Sets log level for Meshbus support
source "subsys/logging/Kconfig.template.log_config"

config MBS_STATS
	bool "Meshbus statistics"
	select STATS
	select STATS_NAME
	default y
	help
	  Enable Meshbus statistics via Zephyr Stats subsystem.
	  Provides runtime statistics for Meshbus modules.

rsource "settings/Kconfig"
rsource "shell/Kconfig"
rsource "bluetooth/Kconfig"
rsource "display/Kconfig"
rsource "clock/Kconfig"
rsource "radio/Kconfig"
rsource "indicator/Kconfig"
rsource "power/Kconfig"
rsource "gnss/Kconfig"
rsource "input/Kconfig"
rsource "telemetry/Kconfig"
rsource "contact/Kconfig"
rsource "channel/Kconfig"
rsource "fs/Kconfig"
rsource "meshcore/Kconfig"
rsource "management/Kconfig"
rsource "firmware/Kconfig"
rsource "notify/Kconfig"
rsource "message/Kconfig"
rsource "llext/Kconfig"
rsource "desktop/Kconfig"

endif # MBS

rsource "u8g2/Kconfig"
rsource "zui/Kconfig"

endmenu
```

## subsys/bluetooth/Kconfig
```kconfig
# Copyright (c) 2026 FoBE Studio
# SPDX-License-Identifier: Apache-2.0

menuconfig MBS_BLUETOOTH
	bool "Meshbus Bluetooth Service (mcumgr over BLE)"
	default n
	depends on BT
	depends on BT_PERIPHERAL
	select BT_SMP
	select BT_SMP_SC_ONLY
	select BT_SMP_SC_PAIR_ONLY
	select BT_SMP_ENFORCE_MITM
	select BT_SETTINGS
	select BT_BONDABLE
	select BT_APP_PASSKEY
	select BT_DEVICE_NAME_DYNAMIC
	help
	  Enable Meshbus Bluetooth service.

	  This service manages secure BLE advertising and connection policy
	  for Meshbus Bluetooth features (for example MCUmgr SMP over BLE).

if MBS_BLUETOOTH

DT_CHOSEN_Z_DISPLAY := zephyr,display

module = MBS_BLUETOOTH
module-str = mbs_bluetooth
module-dep = MBS
module-help = Sets log level for Meshbus Bluetooth service
source "subsys/logging/Kconfig.template.log_config"

config MBS_BLUETOOTH_GATT_DIS
	bool "Enable Device Information Service (DIS)"
	default y
	select BT_DIS
	help
	  Enable Zephyr's standard Device Information Service (DIS).

config MBS_BLUETOOTH_GATT_BAS
	bool "Enable Battery Service (BAS)"
	default y
	select BT_BAS
	help
	  Enable Zephyr's standard Battery Service (BAS).

config MBS_BLUETOOTH_BATTERY_DEMO_LEVEL
	int "Battery demo level (0-100)"
	range 0 100
	default 50
	depends on MBS_BLUETOOTH_GATT_BAS
	help
	  Demo battery percentage reported by BAS. This is placeholder data
	  until the service is wired to real battery measurements.

config MBS_BLUETOOTH_GATT_TPS
	bool "Enable TX Power Service (TPS)"
	default y
	select BT_TPS
	help
	  Enable Zephyr's standard TX Power Service (TPS).

config MBS_BLUETOOTH_GATT_NOTIFY
	bool "Enable Meshbus notify GATT transport"
	default y
	depends on MBS_NOTIFY
	select ZBUS_RUNTIME_OBSERVERS
	help
	  Expose a vendor-specific GATT notify characteristic that forwards
	  Meshbus notify events as protobuf payloads.

config MBS_BLUETOOTH_INIT_PRIORITY
	int "Bluetooth service init priority"
	default 90
	help
	  Initialization priority for the Meshbus Bluetooth service.

config MBS_BLUETOOTH_ADV_INT_MIN_MS
	int "Advertising interval min (ms)"
	range 20 10240
	default 1000
	help
	  Minimum advertising interval in milliseconds when advertising is enabled.
	  The value is converted to BLE units (0.625 ms).

config MBS_BLUETOOTH_ADV_INT_MAX_MS
	int "Advertising interval max (ms)"
	range 20 10240
	default 1200
	help
	  Maximum advertising interval in milliseconds when advertising is enabled.
	  Must be greater than or equal to ADV_INT_MIN_MS. The implementation will
	  clamp MAX to MIN if misconfigured.

config MBS_BLUETOOTH_DEFAULT_ENABLED
	bool "Default enabled"
	default y
	help
	  Default enabled state when no persisted settings exist.

config MBS_BLUETOOTH_DEFAULT_PASSKEY_MODE
	int "Default passkey mode (0=random, 1=fixed)"
	range 0 1
	default 0 if $(dt_chosen_enabled,$(DT_CHOSEN_Z_DISPLAY))
	default 1
	help
	  Default passkey mode when no persisted settings exist.
	  0 = random passkey for each pairing attempt.
	  1 = fixed passkey from MBS_BLUETOOTH_DEFAULT_FIXED_PASSKEY.

config MBS_BLUETOOTH_DEFAULT_FIXED_PASSKEY
	int "Default fixed passkey (0-999999)"
	range 0 999999
	default 123456
	help
	  Fixed passkey used when passkey mode is fixed.

config MBS_BLUETOOTH_STATS
	bool "Meshbus Bluetooth statistics"
	depends on MBS_STATS
	depends on MBS_BLUETOOTH_GATT_NOTIFY
	default y
	help
	  Collect GATT notification attempt, delivery, and drop counters through
	  the Zephyr Stats subsystem.

config MBS_BLUETOOTH_SHELL
	bool "Meshbus Bluetooth shell commands"
	depends on MBS_SHELL
	default y
	help
	  Enable shell commands for Meshbus Bluetooth service.

endif # MBS_BLUETOOTH
```

## subsys/channel/Kconfig
```kconfig
# Copyright (c) 2026 FoBE Studio
# SPDX-License-Identifier: Apache-2.0

menuconfig MBS_CHANNEL
	bool "Meshbus channel management"
	depends on ZBUS
	depends on SETTINGS
	select PSA_CRYPTO
	select PSA_WANT_ALG_SHA_256
	default n
	help
	  Enable Meshbus channel management subsystem.
	  - Channel configuration
	  - Channel storage via settings

if MBS_CHANNEL
module = MBS_CHANNEL
module-str = mbs_channel
module-help = Sets log level for Meshbus channel management
source "subsys/logging/Kconfig.template.log_config"

config MBS_CHANNEL_MAX_CHANNELS
	int "Maximum number of channels"
	default 64
	range 1 128
	help
	  Maximum number of channels that can be stored.

config MBS_CHANNEL_SECRET_PREFIX_BYTES
	int "Channel secret prefix bytes"
	default 3
	range 3 5
	help
	  Number of bytes used to build the in-memory channel prefix index.

config MBS_CHANNEL_SHELL
	bool "Channel shell commands"
	depends on MBS_SHELL
	default y
	help
	  Enable shell commands for channel management.

endif # MBS_CHANNEL
```

## subsys/clock/Kconfig
```kconfig
# Copyright (c) 2026 FoBE Studio
# SPDX-License-Identifier: Apache-2.0

menuconfig MBS_CLOCK
	bool "Meshbus Clock Service"
	default n
	help
	  Enable Meshbus clock service.

	  This service provides runtime clock configuration persistence for
	  time format and UTC offset settings.

if MBS_CLOCK

module = MBS_CLOCK
module-str = mbs_clock
module-dep = MBS
module-help = Sets log level for Meshbus Clock service
source "subsys/logging/Kconfig.template.log_config"

config MBS_CLOCK_DEFAULT_TIME_FORMAT
	int "Default time format"
	range 0 1
	default 1
	help
	  Default clock time format.
	  0 = 12-hour format, 1 = 24-hour format.

config MBS_CLOCK_DEFAULT_UTC_OFFSET_MINUTES
	int "Default UTC offset (minutes)"
	range -720 840
	default 0
	help
	  Default UTC offset in minutes.

	  Runtime validation enforces:
	  - range -720..840 (UTC-12:00..UTC+14:00)
	  - multiples of 15 minutes only.

config MBS_CLOCK_INIT_PRIORITY
	int "Clock service init priority"
	default 90
	help
	  Initialization priority for the Meshbus Clock service.

config MBS_CLOCK_SHELL
	bool "Meshbus Clock shell commands"
	depends on MBS_SHELL
	default y
	help
	  Enable shell commands for Meshbus Clock service.

endif # MBS_CLOCK
```

## subsys/contact/Kconfig
```kconfig
# Copyright (c) 2026 FoBE Studio
# SPDX-License-Identifier: Apache-2.0

menuconfig MBS_CONTACT
	bool "Meshbus contact management"
	depends on SETTINGS
	default n
	help
	  Enable Meshbus contact management subsystem.
	  - Persistent remote contact records via Settings
	  - ZBus command channels for contact-directed MeshCore actions

if MBS_CONTACT

module = MBS_CONTACT
module-str = mbs_contact
module-help = Sets log level for Meshbus contact management
source "subsys/logging/Kconfig.template.log_config"

config MBS_CONTACT_PREFIX_BYTES
	int "Contact lookup prefix bytes"
	default 4
	range 3 5
	help
	  Number of public key bytes used for contact prefix lookup.
	  Higher values reduce collision probability at the cost of slightly
	  larger RAM usage in slot metadata.

config MBS_CONTACT_ADVERT_RAW_STORE
	bool "Persist raw contact adverts"
	default y
	help
	  Store raw contact advert payloads under meshbus/contact/advert_raw/<idx>
	  so cached contact adverts can be replayed later. Disable this on
	  storage-constrained boards to keep contact records without persisting raw
	  advert blobs. Disabled builds preserve existing raw advert settings
	  records without loading, exporting, saving, or deleting them.

config MBS_CONTACT_MAX_CONTACTS
	int "Maximum number of contacts"
	default 64
	range 8 128
	help
	  Maximum number of contacts that can be stored.
	  When the limit is reached, overwrite behavior is controlled at runtime
	  by MeshCore config add_contact_config bit0.

config MBS_CONTACT_REQUEST_TIMEOUT_MS
	int "Contact request timeout (ms)"
	default 10000
	range 10000 60000
	help
	  Timeout for discover_path/trace_path/get_telemetry single-flight control.
	  Requests are limited per type; when timed out, a new request of the same
	  type can be sent.

config MBS_CONTACT_SHELL
	bool "Contact shell commands"
	depends on MBS_SHELL
	default y
	help
	  Enable shell commands for contact management.
	  Provides commands for viewing/modifying contact records.

endif # MBS_CONTACT
```

## subsys/desktop/Kconfig
```kconfig
# Copyright (c) 2026 FoBE Studio
# SPDX-License-Identifier: Apache-2.0

config MBS_DESKTOP
	bool "Meshbus desktop UI"
	depends on MBS_INPUT
	depends on DISPLAY
	depends on U8G2
	depends on ZUI
	select THREAD_STACK_INFO
	select DYNAMIC_THREAD
	select DYNAMIC_THREAD_ALLOC
	select ZUI_COMMON_ICONS
	help
	  Enable the Meshbus desktop UI module.
	  This builds the new ZUI host/router based desktop runtime and built-in
	  apps as a reusable library for Meshbus-based projects.

if MBS_DESKTOP

module = MBS_DESKTOP
module-str = mbs_desktop
module-dep = MBS
source "subsys/logging/Kconfig.template.log_config"

config MBS_DESKTOP_BOOT_LOGO_DURATION_MS
	int "Desktop boot logo duration (ms)"
	default 1000
	range 0 5000
	help
	  Show the centered monochrome Meshbus logo once when the Desktop thread
	  starts, before entering the dashboard. Only the Desktop thread waits;
	  other firmware services continue running. Navigation queued during the
	  logo is discarded before entering the desktop.

	  Set to 0 to disable the logo and its delay. Displays smaller than the
	  84x56 logo, unavailable displays, and a suspended UI skip the delay.
	  The logo follows the display's configured output inversion.

config MBS_DESKTOP_THREAD_STACK_SIZE
	int "Desktop UI thread stack size"
	default 6144
	range 2048 16384
	help
	  Stack size (in bytes) of the desktop UI thread.

	  Desktop performs host/router dispatch, widget drawing, and app screen
	  callbacks on this thread, so complex detail screens need extra headroom.

config ZUI_INPUT_QUEUE_SIZE
	default 32

config ZUI_ROUTER_MAX_SCREENS
	default 18

config ZUI_HEAP_SIZE
	default 24576

config MBS_DESKTOP_LAUNCHER
	bool "Desktop launcher and external app runtime"
	depends on MBS_LLEXT
	select MBS_FS
	help
	  Enable the Desktop Launcher view. The Launcher opens a file picker rooted
	  at /extra/apps, probes selected .mba packages for metadata, and runs one
	  foreground external app session at a time.

config MBS_DESKTOP_LAUNCHER_MAX_APPS
	int "Maximum cached external Desktop app icons"
	depends on MBS_DESKTOP_LAUNCHER
	default 8
	range 1 8
	help
	  Maximum number of valid .mba app icon payloads cached by one Launcher
	  directory load. Extra valid apps still appear with the default LLEXT icon.

config MBS_DESKTOP_APP_SHARED_STACK_SIZE
	int "Desktop shared app thread stack size"
	default 4096
	range 1024 16384
	help
	  Stack size (in bytes) of the single runtime stack shared by desktop app
	  threads (built-in apps and optional external apps).

	  The stack is allocated once during desktop init and reused by each app.

config MBS_DESKTOP_DEVICE_NAME
	string "Desktop device name"
	default "Meshbus Device"
	help
	  Device name shown in the dashboard Info widget and the System app
	  Identity page. Keep this string short to avoid clipping on small
	  displays.

config MBS_DESKTOP_MANUFACTURER_NAME
	string "Desktop device manufacturer name"
	default "Unknown"
	help
	  Manufacturer shown on the System app Identity page. This identity is
	  independent of optional transports such as Bluetooth and its Device
	  Information Service.

config MBS_DESKTOP_MODEL_NAME
	string "Desktop device model name"
	default "Unknown"
	help
	  Product model shown on the System app Identity page. Keep this identity
	  independent of optional services and devicetree display descriptions.

config MBS_DESKTOP_MESSAGE_CACHE_COUNT
	int "Desktop message cache entries"
	depends on MBS_MESSAGE
	default MBS_MESSAGE_MAX_STORE_COUNT
	range 1 MBS_MESSAGE_MAX_STORE_COUNT
	help
	  Maximum number of recent received messages kept by Desktop UI caches.

	  This is intentionally separate from MBS_MESSAGE_MAX_STORE_COUNT:
	  the Meshbus message service can keep a larger backend queue while the
	  small-screen Desktop UI only mirrors the newest entries needed for
	  dashboard and inbox rendering.

config MBS_DESKTOP_PERF_LOG
	bool "Log Desktop frame timing statistics"
	depends on LOG
	default n
	help
	  Log low-rate timing statistics for the Desktop UI loop, including host
	  poll, draw, and display present costs. This is intended for hardware
	  frame-rate diagnosis and is disabled by default.

config MBS_DESKTOP_PERF_LOG_INTERVAL_MS
	int "Desktop timing log interval (ms)"
	depends on MBS_DESKTOP_PERF_LOG
	default 1000
	range 250 60000
	help
	  Interval used when printing aggregated Desktop timing statistics.

choice MBS_DESKTOP_TEXT_LANGUAGE
	prompt "Desktop text language"
	default MBS_DESKTOP_TEXT_LANG_EN
	help
	  Select compile-time desktop UI language pack.

config MBS_DESKTOP_TEXT_LANG_EN
	bool "English (en)"

config MBS_DESKTOP_TEXT_LANG_ZH_CN
	bool "Simplified Chinese (zh_CN)"
	select ZUI_FONT_CJK_WQY12_GB2312

endchoice

config MBS_DESKTOP_RADIO_NOISE_ANALYZER_DBM_MIN
	int "Radio noise analyzer graph min dBm"
	default -125
	range -160 -20
	help
	  Minimum dBm value used for Y-axis mapping in the radio noise analyzer
	  RSSI bar graph.

	  Samples below this value are clamped to the bottom of the graph.

config MBS_DESKTOP_RADIO_NOISE_ANALYZER_DBM_MAX
	int "Radio noise analyzer graph max dBm"
	default -40
	range -160 -20
	help
	  Maximum dBm value used for Y-axis mapping in the radio noise analyzer
	  RSSI bar graph.

	  Samples above this value are clamped to the top of the graph.

config MBS_DESKTOP_SHELL
	bool "Meshbus Desktop shell commands"
	depends on MBS_SHELL
	default y
	help
	  Enable shell commands for Meshbus Desktop service.
	  Provides `meshbus desktop meta <path>` to read one desktop app metadata
	  from a `.llext` file path.

endif # MBS_DESKTOP
```
