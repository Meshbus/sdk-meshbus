## subsys/meshbus/Kconfig
```kconfig
# Copyright (c) 2026 FoBE Studio
# SPDX-License-Identifier: Apache-2.0

menuconfig MESHBUS
	bool "Meshbus support [EXPERIMENTAL]"
	select REBOOT
	select ENTROPY_GENERATOR
	select NANOPB
	select NANOPB_ENABLE_MALLOC
	select EXPERIMENTAL
	select ZBUS
	select ZBUS_MSG_SUBSCRIBER
	select SETTINGS
	help
	  This option enables Meshbus networking support.
	  Meshbus provides peer-to-peer mesh networking with
	  built-in encryption and multi-hop routing capabilities.

if MESHBUS

module = MESHBUS
module-str = meshbus
module-help = Sets log level for Meshbus support
source "subsys/logging/Kconfig.template.log_config"

config MESHBUS_SHELL
	bool "Meshbus shell commands"
	depends on SHELL
	default y
	help
	  Enable shell commands for Meshbus subsystem.
	  Provides commands for radio configuration, status monitoring,
	  and diagnostics under the 'meshbus' command group.

config MESHBUS_STATS
	bool "Meshbus statistics"
	select STATS
	select STATS_NAME
	default y
	help
	  Enable Meshbus statistics via Zephyr Stats subsystem.
	  Provides runtime statistics for Meshbus modules.

config MESHBUS_SETTINGS_PERSISTENCE_DELAY
    int "Meshbus settings persistence delay (ms)"
    default 500
    help
      Time in milliseconds to wait after a settings change before
      persisting to non-volatile storage. This helps to reduce
      write cycles by batching multiple changes. If delay is set to 0,
      settings will be persisted immediately after each change.

rsource "services/Kconfig"

endif # MESHBUS
```

## subsys/meshbus/services/Kconfig
```kconfig
# Copyright (c) 2026 FoBE Studio
# SPDX-License-Identifier: Apache-2.0

rsource "bluetooth/Kconfig"
rsource "display/Kconfig"
rsource "clock/Kconfig"
rsource "radio/Kconfig"
rsource "indicator/Kconfig"
rsource "power/Kconfig"
rsource "gnss/Kconfig"
rsource "input/Kconfig"
rsource "telemetry/Kconfig"
rsource "contact/Kconfig"
rsource "channel/Kconfig"
rsource "fs/Kconfig"
rsource "meshcore/Kconfig"
rsource "management/Kconfig"
rsource "firmware/Kconfig"
rsource "notify/Kconfig"
rsource "message/Kconfig"
rsource "llext/Kconfig"
rsource "desktop/Kconfig"
```

## subsys/meshbus/services/channel/Kconfig
```kconfig
# Copyright (c) 2026 FoBE Studio
# SPDX-License-Identifier: Apache-2.0

menuconfig MESHBUS_CHANNEL
	bool "Meshbus channel management"
	depends on ZBUS
	depends on SETTINGS
	select PSA_CRYPTO
	select PSA_WANT_ALG_SHA_256
	default n
	help
	  Enable Meshbus channel management subsystem.
	  - Channel configuration
	  - Channel storage via settings

if MESHBUS_CHANNEL
module = MESHBUS_CHANNEL
module-str = meshbus_channel
module-help = Sets log level for Meshbus channel management
source "subsys/logging/Kconfig.template.log_config"

config MESHBUS_CHANNEL_MAX_CHANNELS
	int "Maximum number of channels"
	default 64
	range 8 128
	help
	  Maximum number of channels that can be stored.

config MESHBUS_CHANNEL_SECRET_PREFIX_BYTES
	int "Channel secret prefix bytes"
	default 3
	range 3 5
	help
	  Number of bytes used to build the in-memory channel prefix index.

config MESHBUS_CHANNEL_SHELL
	bool "Channel shell commands"
	depends on MESHBUS_SHELL
	default y
	help
	  Enable shell commands for channel management.

endif # MESHBUS_CHANNEL
```

## subsys/meshbus/services/clock/Kconfig
```kconfig
# Copyright (c) 2026 FoBE Studio
# SPDX-License-Identifier: Apache-2.0

menuconfig MESHBUS_CLOCK
	bool "Meshbus Clock Service"
	default n
	help
	  Enable Meshbus clock service.

	  This service provides runtime clock configuration persistence for
	  time format and UTC offset settings.

if MESHBUS_CLOCK

module = MESHBUS_CLOCK
module-str = meshbus_clock
module-dep = MESHBUS
module-help = Sets log level for Meshbus Clock service
source "subsys/logging/Kconfig.template.log_config"

config MESHBUS_CLOCK_DEFAULT_TIME_FORMAT
	int "Default time format"
	range 0 1
	default 1
	help
	  Default clock time format.
	  0 = 12-hour format, 1 = 24-hour format.

config MESHBUS_CLOCK_DEFAULT_UTC_OFFSET_MINUTES
	int "Default UTC offset (minutes)"
	range -720 840
	default 0
	help
	  Default UTC offset in minutes.

	  Runtime validation enforces:
	  - range -720..840 (UTC-12:00..UTC+14:00)
	  - multiples of 15 minutes only.

config MESHBUS_CLOCK_INIT_PRIORITY
	int "Clock service init priority"
	default 90
	help
	  Initialization priority for the Meshbus Clock service.

config MESHBUS_CLOCK_SHELL
	bool "Meshbus Clock shell commands"
	depends on MESHBUS_SHELL
	default y
	help
	  Enable shell commands for Meshbus Clock service.

endif # MESHBUS_CLOCK
```

## subsys/meshbus/services/contact/Kconfig
```kconfig
# Copyright (c) 2026 FoBE Studio
# SPDX-License-Identifier: Apache-2.0

menuconfig MESHBUS_CONTACT
	bool "Meshbus contact management"
	depends on SETTINGS
	default n
	help
	  Enable Meshbus contact management subsystem.
	  - Persistent remote contact records via Settings
	  - ZBus command channels for contact-directed MeshCore actions

if MESHBUS_CONTACT

module = MESHBUS_CONTACT
module-str = meshbus_contact
module-help = Sets log level for Meshbus contact management
source "subsys/logging/Kconfig.template.log_config"

config MESHBUS_CONTACT_PREFIX_BYTES
	int "Contact lookup prefix bytes"
	default 4
	range 3 5
	help
	  Number of public key bytes used for contact prefix lookup.
	  Higher values reduce collision probability at the cost of slightly
	  larger RAM usage in slot metadata.

config MESHBUS_CONTACT_ADVERT_RAW_STORE
	bool "Persist raw contact adverts"
	default y
	help
	  Store raw contact advert payloads under meshbus/contact/advert_raw/<idx>
	  so cached contact adverts can be replayed later. Disable this on
	  storage-constrained boards to keep contact records without persisting raw
	  advert blobs. Disabled builds preserve existing raw advert settings
	  records without loading, exporting, saving, or deleting them.

config MESHBUS_CONTACT_MAX_CONTACTS
	int "Maximum number of contacts"
	default 64
	range 8 128
	help
	  Maximum number of contacts that can be stored.
	  When the limit is reached, overwrite behavior is controlled at runtime
	  by MeshCore config add_contact_config bit0.

config MESHBUS_CONTACT_REQUEST_TIMEOUT_MS
	int "Contact request timeout (ms)"
	default 10000
	range 10000 60000
	help
	  Timeout for discover_path/trace_path/get_telemetry single-flight control.
	  Requests are limited per type; when timed out, a new request of the same
	  type can be sent.

config MESHBUS_CONTACT_SHELL
	bool "Contact shell commands"
	depends on MESHBUS_SHELL
	default y
	help
	  Enable shell commands for contact management.
	  Provides commands for viewing/modifying contact records.

endif # MESHBUS_CONTACT
```

## subsys/meshbus/services/desktop/Kconfig
```kconfig
# Copyright (c) 2026 FoBE Studio
# SPDX-License-Identifier: Apache-2.0

config MESHBUS_DESKTOP
	bool "Meshbus desktop UI"
	depends on MESHBUS_INPUT
	depends on DISPLAY
	depends on U8G2
	depends on ZUI
	select THREAD_STACK_INFO
	select DYNAMIC_THREAD
	select DYNAMIC_THREAD_ALLOC
	select ZUI_COMMON_ICONS
	help
	  Enable the Meshbus desktop UI module.
	  This builds the new ZUI host/router based desktop runtime and built-in
	  apps as a reusable library for Meshbus-based projects.

if MESHBUS_DESKTOP

module = MESHBUS_DESKTOP
module-str = meshbus_desktop
module-dep = MESHBUS
source "subsys/logging/Kconfig.template.log_config"

config MESHBUS_DESKTOP_THREAD_STACK_SIZE
	int "Desktop UI thread stack size"
	default 6144
	range 2048 16384
	help
	  Stack size (in bytes) of the desktop UI thread.

	  Desktop performs host/router dispatch, widget drawing, and app screen
	  callbacks on this thread, so complex detail screens need extra headroom.

config ZUI_INPUT_QUEUE_SIZE
	default 32

config ZUI_ROUTER_MAX_SCREENS
	default 18

config ZUI_HEAP_SIZE
	default 24576

config MESHBUS_DESKTOP_LAUNCHER
	bool "Desktop launcher and external app runtime"
	depends on MESHBUS_LLEXT
	select MESHBUS_FS
	help
	  Enable the Desktop Launcher view. The Launcher opens a file picker rooted
	  at /extra/apps, probes selected .mba packages for metadata, and runs one
	  foreground external app session at a time.

config MESHBUS_DESKTOP_LAUNCHER_MAX_APPS
	int "Maximum cached external Desktop app icons"
	depends on MESHBUS_DESKTOP_LAUNCHER
	default 8
	range 1 8
	help
	  Maximum number of valid .mba app icon payloads cached by one Launcher
	  directory load. Extra valid apps still appear with the default LLEXT icon.

config MESHBUS_DESKTOP_APP_SHARED_STACK_SIZE
	int "Desktop shared app thread stack size"
	default 4096
	range 1024 16384
	help
	  Stack size (in bytes) of the single runtime stack shared by desktop app
	  threads (built-in apps and optional external apps).

	  The stack is allocated once during desktop init and reused by each app.

config MESHBUS_DESKTOP_DEVICE_NAME
	string "Desktop device name"
	default "Meshbus Device"
	help
	  Device name shown in the dashboard Info widget and the System app
	  Identity page. Keep this string short to avoid clipping on small
	  displays.

config MESHBUS_DESKTOP_MANUFACTURER_NAME
	string "Desktop device manufacturer name"
	default "Unknown"
	help
	  Manufacturer shown on the System app Identity page. This identity is
	  independent of optional transports such as Bluetooth and its Device
	  Information Service.

config MESHBUS_DESKTOP_MODEL_NAME
	string "Desktop device model name"
	default "Unknown"
	help
	  Product model shown on the System app Identity page. Keep this identity
	  independent of optional services and devicetree display descriptions.

config MESHBUS_DESKTOP_MESSAGE_CACHE_COUNT
	int "Desktop message cache entries"
	depends on MESHBUS_MESSAGE
	default MESHBUS_MESSAGE_MAX_STORE_COUNT
	range 1 MESHBUS_MESSAGE_MAX_STORE_COUNT
	help
	  Maximum number of recent received messages kept by Desktop UI caches.

	  This is intentionally separate from MESHBUS_MESSAGE_MAX_STORE_COUNT:
	  the Meshbus message service can keep a larger backend queue while the
	  small-screen Desktop UI only mirrors the newest entries needed for
	  dashboard and inbox rendering.

config MESHBUS_DESKTOP_PERF_LOG
	bool "Log Desktop frame timing statistics"
	depends on LOG
	default n
	help
	  Log low-rate timing statistics for the Desktop UI loop, including host
	  poll, draw, and display present costs. This is intended for hardware
	  frame-rate diagnosis and is disabled by default.

config MESHBUS_DESKTOP_PERF_LOG_INTERVAL_MS
	int "Desktop timing log interval (ms)"
	depends on MESHBUS_DESKTOP_PERF_LOG
	default 1000
	range 250 60000
	help
	  Interval used when printing aggregated Desktop timing statistics.

choice MESHBUS_DESKTOP_TEXT_LANGUAGE
	prompt "Desktop text language"
	default MESHBUS_DESKTOP_TEXT_LANG_EN
	help
	  Select compile-time desktop UI language pack.

config MESHBUS_DESKTOP_TEXT_LANG_EN
	bool "English (en)"

config MESHBUS_DESKTOP_TEXT_LANG_ZH_CN
	bool "Simplified Chinese (zh_CN)"
	select ZUI_FONT_CJK_WQY12_GB2312

endchoice

config MESHBUS_DESKTOP_RADIO_NOISE_ANALYZER_DBM_MIN
	int "Radio noise analyzer graph min dBm"
	default -125
	range -160 -20
	help
	  Minimum dBm value used for Y-axis mapping in the radio noise analyzer
	  RSSI bar graph.

	  Samples below this value are clamped to the bottom of the graph.

config MESHBUS_DESKTOP_RADIO_NOISE_ANALYZER_DBM_MAX
	int "Radio noise analyzer graph max dBm"
	default -40
	range -160 -20
	help
	  Maximum dBm value used for Y-axis mapping in the radio noise analyzer
	  RSSI bar graph.

	  Samples above this value are clamped to the top of the graph.

config MESHBUS_DESKTOP_SHELL
	bool "Meshbus Desktop shell commands"
	depends on MESHBUS_SHELL
	default y
	help
	  Enable shell commands for Meshbus Desktop service.
	  Provides `meshbus desktop meta <path>` to read one desktop app metadata
	  from a `.llext` file path.

endif # MESHBUS_DESKTOP
```

## subsys/meshbus/services/fs/Kconfig
```kconfig
# Copyright (c) 2026 FoBE Studio
# SPDX-License-Identifier: Apache-2.0

menuconfig MESHBUS_FS
	bool "Meshbus filesystem control service"
	depends on MESHBUS
	default y if FILE_SYSTEM
	help
	  Enable the Meshbus-owned filesystem control plane. Standard Zephyr
	  fs_mgmt remains responsible for bulk upload/download; this service
	  owns path policy, directory management, file deletion, and guarded
	  known-volume lifecycle operations.

if MESHBUS_FS

module = MESHBUS_FS
module-str = meshbus_fs
module-dep = MESHBUS
module-help = Sets log level for Meshbus filesystem service
source "subsys/logging/Kconfig.template.log_config"

config MESHBUS_FS_INIT_PRIORITY
	int "Meshbus FS init priority"
	default 95
	help
	  Init priority for creating Meshbus product directories after fstab
	  automount has run.

config MESHBUS_FS_MGMT
	bool "Meshbus FS MCUmgr control group"
	depends on MCUMGR
	default y
	help
	  Expose Meshbus FS status, list, mkdir, stat, delete, and guarded format
	  control operations through a Meshbus-owned MCUmgr group. Runtime mount
	  and unmount are intentionally not exposed as remote operations; known
	  volumes are mounted by the product boot path and remounted internally
	  during format/recovery flows.

config MESHBUS_FS_FORMAT
	bool "Enable destructive Meshbus FS format command"
	depends on FILE_SYSTEM_MKFS
	default n
	help
	  Allow Meshbus FS format operations for known volumes. This is disabled
	  by default because it destroys all files on the target volume.

config MESHBUS_FS_REBOOT_AFTER_FORMAT
	bool "Reboot after successful Meshbus FS format"
	depends on MESHBUS_FS_FORMAT && REBOOT
	default y
	help
	  Reboot after a successful external format command so all services restart
	  from the newly formatted filesystem instead of keeping stale runtime
	  state or open handles.

endif # MESHBUS_FS
```
