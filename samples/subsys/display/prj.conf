## CMakeLists.txt
```
# SPDX-FileCopyrightText: FoBE Studio
# SPDX-License-Identifier: Apache-2.0

cmake_minimum_required(VERSION 3.20.0)

find_package(Zephyr REQUIRED HINTS $ENV{ZEPHYR_BASE})
project(display)

FILE(GLOB app_sources src/*.c)
target_sources(app PRIVATE ${app_sources})
```

## sample.yaml
```
# SPDX-FileCopyrightText: FoBE Studio
# SPDX-License-Identifier: Apache-2.0

sample:
  name: Meshbus display service
  description: Starts Meshbus display and logs display state events for board shell manual validation
common:
  tags:
    - meshbus
    - display
  harness: keyboard
tests:
  sample.subsys.meshbus.services.display:
    platform_allow:
      - mesh_probe_r2/nrf54l15/cpuapp
    integration_platforms:
      - mesh_probe_r2/nrf54l15/cpuapp
```

## prj.conf
```kconfig
# SPDX-FileCopyrightText: FoBE Studio
# SPDX-License-Identifier: Apache-2.0

# Logging Management
CONFIG_LOG=y
CONFIG_LOG_MODE_IMMEDIATE=y

# Kernel Management
CONFIG_KERNEL_SHELL=y
CONFIG_POLL=y
CONFIG_HEAP_MEM_POOL_SIZE=16384
CONFIG_ISR_STACK_SIZE=4096
CONFIG_MAIN_STACK_SIZE=4096
CONFIG_SYSTEM_WORKQUEUE_STACK_SIZE=4096

# Shell Management
CONFIG_SHELL=y
CONFIG_SHELL_STACK_SIZE=16384
CONFIG_SHELL_BACKEND_SERIAL=y

# Flash Management
CONFIG_FLASH=y
CONFIG_FLASH_MAP=y
CONFIG_FLASH_PAGE_LAYOUT=y
CONFIG_MPU_ALLOW_FLASH_WRITE=y

# ZMS Management
CONFIG_ZMS=y
CONFIG_ZMS_LOOKUP_CACHE=y
CONFIG_ZMS_LOOKUP_CACHE_SIZE=512
CONFIG_ZMS_LOOKUP_CACHE_FOR_SETTINGS=y

# Settings Management
CONFIG_SETTINGS=y
CONFIG_SETTINGS_ZMS=y
CONFIG_SETTINGS_ZMS_LL_CACHE=y
CONFIG_SETTINGS_ZMS_LL_CACHE_SIZE=512
CONFIG_SETTINGS_SHELL=y
CONFIG_SETTINGS_RUNTIME=y
CONFIG_SETTINGS_DYNAMIC_HANDLERS=y

# Stats
CONFIG_STATS=y
CONFIG_STATS_NAMES=y
CONFIG_STATS_SHELL=y

# Meshbus
CONFIG_MBS=y
CONFIG_MBS_SHELL=y
CONFIG_MBS_STATS=y
CONFIG_MBS_LOG_LEVEL_DBG=y
CONFIG_MBS_DISPLAY=y
CONFIG_MBS_DISPLAY_SHELL=y
CONFIG_MBS_DISPLAY_LOG_LEVEL_DBG=y

# ZBus
CONFIG_ZBUS=y
CONFIG_ZBUS_ASYNC_LISTENER=y
CONFIG_ZBUS_MSG_SUBSCRIBER=y
CONFIG_ZBUS_RUNTIME_OBSERVERS=y

# Display
CONFIG_DISPLAY=y
```

## boards/idea_mesh_tracker_c2_nrf54l15_cpuapp.conf
```kconfig
# Peripherals
CONFIG_I2C=y
CONFIG_PM_DEVICE=y
CONFIG_PM_DEVICE_RUNTIME=y
CONFIG_PM_DEVICE_SHELL=y
CONFIG_POWER_DOMAIN=y
CONFIG_PM_DEVICE_POWER_DOMAIN=y
CONFIG_PM_DEVICE_RUNTIME_ASYNC=y
```

## boards/mesh_probe_r2_nrf54l15_cpuapp.conf
```kconfig
# SPDX-FileCopyrightText: FoBE Studio
# SPDX-License-Identifier: Apache-2.0

# Peripherals
CONFIG_I2C=y
CONFIG_PM_DEVICE=y
CONFIG_PM_DEVICE_RUNTIME=y
CONFIG_PM_DEVICE_SHELL=y
CONFIG_POWER_DOMAIN=y
CONFIG_PM_DEVICE_POWER_DOMAIN=y
CONFIG_PM_DEVICE_RUNTIME_ASYNC=y
```

## src/main.c
```c
/*
 * Copyright (c) 2026 FoBE Studio
 *
 * SPDX-License-Identifier: Apache-2.0
 */

#include <zephyr/kernel.h>
#include <zephyr/logging/log.h>
#include <display/display.h>
#include <zephyr/zbus/zbus.h>

LOG_MODULE_REGISTER(mbs_display_sample, LOG_LEVEL_INF);

static void display_state_listener_cb(const struct zbus_channel *chan, const void *message)
{
	if (chan != &mbs_display_state_chan || message == NULL) {
		return;
	}

	const struct mbs_display_state_event *event = message;

	LOG_INF("display/state: active=%u", event->active ? 1U : 0U);
}

ZBUS_ASYNC_LISTENER_DEFINE(display_state_listener, display_state_listener_cb);

int main(void)
{
	mbs_display_config cfg;
	int rc;

	LOG_INF("Meshbus display sample started");
	LOG_INF("Build timestamp: " __DATE__ " " __TIME__);

	rc = mbs_display_config_get(&cfg);
	if (rc == 0) {
		LOG_INF("display/config: brightness=%u sleep_timeout=%u invert=%u active=%u",
			(unsigned int)cfg.brightness, (unsigned int)cfg.sleep_timeout,
			cfg.invert ? 1U : 0U, mbs_display_is_active() ? 1U : 0U);
	} else {
		LOG_ERR("Failed to read display config: %d", rc);
	}

	rc = zbus_chan_add_obs(&mbs_display_state_chan, &display_state_listener,
			       K_MSEC(100));
	if (rc != 0) {
		LOG_ERR("Failed to subscribe mbs_display_state_chan: %d", rc);
	} else {
		LOG_INF("Subscribed to mbs_display_state_chan");
	}

	return 0;
}
```
