/*
 * Copyright (c) 2026 FoBE Studio
 *
 * SPDX-License-Identifier: Apache-2.0
 *
 * This overlay binds the board hardware used by the power sample.
 */

/ {
	chosen {
		meshbus,fuel-gauge = &fuel_gauge;
		meshbus,power-button = &button0;
	};
};

&button0 {
	zephyr,code = <INPUT_BTN_SELECT>;
};

&buttons{
	wakeup-source;
};