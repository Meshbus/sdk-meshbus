## CMakeLists.txt
```
# SPDX-FileCopyrightText: FoBE Studio
# SPDX-License-Identifier: Apache-2.0

cmake_minimum_required(VERSION 3.20.0)

find_package(Zephyr REQUIRED HINTS $ENV{ZEPHYR_BASE})
project(message)

FILE(GLOB app_sources src/*.c)
target_sources(app PRIVATE ${app_sources})
```

## sample.yaml
```
# SPDX-FileCopyrightText: FoBE Studio
# SPDX-License-Identifier: Apache-2.0

sample:
  name: Meshbus message service
  description: Starts Meshbus message and logs request/response channels for board shell manual validation
common:
  tags:
    - meshbus
    - message
  harness: keyboard
tests:
  sample.subsys.meshbus.services.message:
    integration_platforms:
      - mesh_probe_r2/nrf54l15/cpuapp
```

## prj.conf
```kconfig
# SPDX-FileCopyrightText: FoBE Studio
# SPDX-License-Identifier: Apache-2.0

# Logging Management
CONFIG_LOG=y
CONFIG_LOG_MODE_IMMEDIATE=y

# Kernel Management
CONFIG_KERNEL_SHELL=y
CONFIG_POLL=y
CONFIG_HEAP_MEM_POOL_SIZE=16384
CONFIG_ISR_STACK_SIZE=4096
CONFIG_MAIN_STACK_SIZE=4096
CONFIG_SYSTEM_WORKQUEUE_STACK_SIZE=4096

# Shell Management
CONFIG_SHELL=y
CONFIG_SHELL_STACK_SIZE=16384
CONFIG_SHELL_BACKEND_SERIAL=y

# Flash Management
CONFIG_FLASH=y
CONFIG_FLASH_MAP=y
CONFIG_FLASH_PAGE_LAYOUT=y
CONFIG_MPU_ALLOW_FLASH_WRITE=y

# ZMS Management
CONFIG_ZMS=y
CONFIG_ZMS_LOOKUP_CACHE=y
CONFIG_ZMS_LOOKUP_CACHE_SIZE=512
CONFIG_ZMS_LOOKUP_CACHE_FOR_SETTINGS=y

# Settings Management
CONFIG_SETTINGS=y
CONFIG_SETTINGS_ZMS=y
CONFIG_SETTINGS_ZMS_LL_CACHE=y
CONFIG_SETTINGS_ZMS_LL_CACHE_SIZE=512
CONFIG_SETTINGS_SHELL=y
CONFIG_SETTINGS_RUNTIME=y
CONFIG_SETTINGS_DYNAMIC_HANDLERS=y

# Stats
CONFIG_STATS=y
CONFIG_STATS_NAMES=y
CONFIG_STATS_SHELL=y

# Meshbus
CONFIG_MBS=y
CONFIG_MBS_SHELL=y
CONFIG_MBS_STATS=y
CONFIG_MBS_LOG_LEVEL_DBG=y
CONFIG_MBS_MESHCORE=y
CONFIG_MBS_CONTACT=y
CONFIG_MBS_MESHCORE_SHELL=y
CONFIG_MBS_CHANNEL=y
CONFIG_MBS_CHANNEL_SHELL=y
CONFIG_MBS_MESSAGE=y
CONFIG_MBS_MESSAGE_SHELL=y
CONFIG_MBS_MESSAGE_LOG_LEVEL_DBG=y

# ZBus
CONFIG_ZBUS=y
CONFIG_ZBUS_ASYNC_LISTENER=y
CONFIG_ZBUS_MSG_SUBSCRIBER=y
CONFIG_ZBUS_RUNTIME_OBSERVERS=y
```

## src/main.c
```c
/*
 * Copyright (c) 2026 FoBE Studio
 *
 * SPDX-License-Identifier: Apache-2.0
 */

#include <zephyr/kernel.h>
#include <zephyr/logging/log.h>
#include <message/message.h>
#include <zephyr/zbus/zbus.h>

LOG_MODULE_REGISTER(mbs_message_sample, LOG_LEVEL_INF);

static void message_listener_cb(const struct zbus_channel *chan, const void *message)
{
	if (message == NULL) {
		return;
	}

	if (chan == &mbs_message_send_to_node_request_chan) {
		const struct mbs_message_send_to_node_request_event *event = message;

		LOG_INF("message/send-node: len=%u attempt=%u flood=%u",
			(unsigned int)event->payload_len, (unsigned int)event->attempt,
			event->flood ? 1U : 0U);
	} else if (chan == &mbs_message_send_to_channel_request_chan) {
		const struct mbs_message_send_to_channel_request_event *event = message;

		LOG_INF("message/send-channel: channel=%u len=%u",
			(unsigned int)event->channel_index, (unsigned int)event->payload_len);
	} else if (chan == &mbs_message_response_chan) {
		const struct mbs_message_response_event *event = message;

		LOG_INF("message/received: type=%d len=%u sender=\"%s\"", event->type,
			(unsigned int)event->payload_len, event->sender_name);
	} else if (chan == &mbs_message_ack_response_chan) {
		const struct mbs_message_ack_response_event *event = message;

		LOG_INF("message/ack: attempt=%u target=%02x%02x%02x%02x",
			(unsigned int)event->attempt, event->target[0], event->target[1],
			event->target[2], event->target[3]);
	}
}

ZBUS_ASYNC_LISTENER_DEFINE(message_listener, message_listener_cb);

static void subscribe_message_channel(const struct zbus_channel *chan, const char *name)
{
	int rc = zbus_chan_add_obs(chan, &message_listener, K_MSEC(100));

	if (rc != 0) {
		LOG_ERR("Failed to subscribe %s: %d", name, rc);
	} else {
		LOG_INF("Subscribed to %s", name);
	}
}

int main(void)
{
	LOG_INF("Meshbus message sample started");
	LOG_INF("Build timestamp: " __DATE__ " " __TIME__);

	subscribe_message_channel(&mbs_message_send_to_node_request_chan,
				  "mbs_message_send_to_node_request_chan");
	subscribe_message_channel(&mbs_message_send_to_channel_request_chan,
				  "mbs_message_send_to_channel_request_chan");
	subscribe_message_channel(&mbs_message_response_chan, "mbs_message_response_chan");
	subscribe_message_channel(&mbs_message_ack_response_chan,
				  "mbs_message_ack_response_chan");

	return 0;
}
```
