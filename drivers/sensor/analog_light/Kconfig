## dts/bindings/meshbus/fobe,meshbus-telemetry.yaml
```yaml
# Copyright (c) 2026 FoBE Studio
# SPDX-License-Identifier: Apache-2.0

description: |
  Meshbus Telemetry Configuration

  This virtual node configures which sensor channels should be monitored by
  the meshbus telemetry subsystem. The binding is intentionally device-agnostic:
  developers only update devicetree to choose which (sensor, channel) pairs are
  published periodically via ZBus.

  Channels are described using child nodes. Each child node binds exactly one
  sensor device and one common Zephyr sensor channel id (enum sensor_channel,
  below SENSOR_CHAN_ALL). Driver-private channels are not part of the Meshbus
  Telemetry protocol and cannot be listed here.

  A sensor selected as `meshbus,compass`, including the accelerometer,
  gyroscope, and magnetometer sources of a `zephyr,compass-composite`, is owned
  exclusively by the Compass runtime and must not be listed here.

  Example:
    / {
      mbs_telemetry: meshbus-telemetry {
        compatible = "fobe,meshbus-telemetry";

        ch0 { sensor = <&lps22>; channel = <SENSOR_CHAN_AMBIENT_TEMP>; };
        ch1 { sensor = <&lps22>; channel = <SENSOR_CHAN_PRESS>; };
      };

      chosen {
        meshbus,telemetry = &mbs_telemetry;
      };
    };

compatible: fobe,meshbus-telemetry

child-binding:
  description: Telemetry channel mapping entry
  properties:
    sensor:
      type: phandle
      required: true
      description: Sensor device which provides the channel data.

    channel:
      type: int
      required: true
      description: |
        Common sensor channel id. Use values from Zephyr's enum sensor_channel
        below SENSOR_CHAN_ALL; driver-private channel ids are not supported.
        In devicetree, include a dt-bindings header that defines channel ids
        (for example, <dt-bindings/sensor/sensor_channel.h>).
```

## dts/bindings/mfd/ti,tca8418.yaml
```yaml
# Copyright (c) 2025 FoBE Projects
# SPDX-License-Identifier: Apache-2.0

description: |
  Texas Instruments TCA8418 I2C-controlled keypad scan IC.

  This is the Multi-Function Device (MFD) parent driver that provides
  shared I2C bus access and interrupt handling for child devices.

  The TCA8418 supports up to 80 keys in an 8x10 matrix with integrated
  50μs debounce and 10-event FIFO. Unused keypad pins can be configured
  as GPIOs (GPIO child device support planned for future).

  Child devices:
    - ti,tca8418-kbd: Keyboard matrix controller

  Example configuration:

    #include <zephyr/dt-bindings/input/input-event-codes.h>
    #include <zephyr/dt-bindings/input/keymap.h>

    &i2c0 {
        tca8418: tca8418@34 {
            compatible = "ti,tca8418";
            reg = <0x34>;
            int-gpios = <&gpio0 5 (GPIO_ACTIVE_LOW | GPIO_PULL_UP)>;

            tca8418_kbd: kbd {
                compatible = "ti,tca8418-kbd";
                row-size = <4>;
                col-size = <4>;

                keymap {
                    compatible = "input-keymap";
                    keymap = <
                        MATRIX_KEY(0, 0, INPUT_KEY_1)
                        MATRIX_KEY(0, 1, INPUT_KEY_2)
                        MATRIX_KEY(0, 2, INPUT_KEY_3)
                        MATRIX_KEY(0, 3, INPUT_KEY_A)
                    >;
                    row-size = <4>;
                    col-size = <4>;
                };
            };
        };
    };

compatible: ti,tca8418

include: i2c-device.yaml

properties:
  int-gpios:
    type: phandle-array
    description: |
      GPIO connected to the INT pin (active-low, open-drain).
      If specified, the driver operates in interrupt mode.
      If not specified, child drivers may fall back to polling mode.

  reset-gpios:
    type: phandle-array
    description: |
      GPIO connected to the RESET pin (active-low).
      Optional. If specified, a hardware reset is performed during
      initialization.

child-binding:
  description: |
    Child devices for the TCA8418 MFD.
    Currently supported: ti,tca8418-kbd (keyboard controller)
```

## dts/bindings/sensor/ecsense,es4-ag1.yaml
```yaml
description: EC Sense ES4-AG1 electrochemical VOC sensor

compatible: "ecsense,es4-ag1"

include:
  - sensor-device.yaml

properties:

  io-channels:
    type: phandle-array
    required: true
    description: ADC channel connected to the TIA/amplifier voltage output.

  zero-offset-microvolt:
    type: int
    default: 0
    description: |
      Initial sensor zero offset in microvolts. This baseline is subtracted
      from each averaged sample before VOC conversion. This can be negative
      when the ADC channel is differential and clean-air baseline is below
      the ADC zero point.

  transimpedance-ohms:
    type: int
    required: true
    description: |
      Effective transimpedance (ohms) of the analog front-end.

  sensitivity-nanoamp-per-ppm:
    type: int
    default: 55
    description: |
      Sensor sensitivity in nanoamps per ppm. Default is ES4-AG1-200 VOC
      sensitivity calibrated with C4H8.

  inverted-polarity:
    type: boolean
    description: |
      Set this when the analog front-end is inverted and sensor concentration
      increase makes ADC voltage decrease. In this mode the driver uses
      (zero-offset - sample) for VOC conversion.

  averaging-samples:
    type: int
    default: 16
    description: |
      Number of ADC samples averaged per fetch.
```

## dts/bindings/sensor/fobe,lsm6ds3-family.yaml
```yaml
# SPDX-License-Identifier: Apache-2.0

description: |
  FoBE variant-aware integration for the register-compatible basic motion
  subset of LSM6DS3/LSM6DS3TR (WHO_AM_I 0x69) and LSM6DS3TR-C/LSM6DSL
  (WHO_AM_I 0x6a). Embedded interrupts, sensor-hub functions, and FIFO
  features that differ between variants are intentionally not exposed.

compatible: "fobe,lsm6ds3-family"

include: [sensor-device.yaml, i2c-device.yaml]
```

## dts/bindings/sensor/ion,mini-pid.yaml
```yaml
description: Ion Science MiniPID PPM Gas Sensor

compatible: "ion,mini-pid"

include:
  - sensor-device.yaml

properties:

  io-channels:
    type: phandle-array
    required: true
    description: ADC channel connected to the Sensor analog output

  baseline:
    type: int
    default: 52000
    description: |
      Baseline output voltage of the sensor in µV(microvolts). This value is
      subtracted from each averaged sample before scaling to VOC ppm, typical offset voltage is 52000 - 55000 µV.

  sensitivity:
    type: int
    default: 700
    description: |
      Conversion gain from µV(microvolts) above baseline to VOC concentration in
      parts-per-million. Typical responsivity is 700 µV/ppm. The driver reports
      SENSOR_CHAN_VOC as a ppm sensor_value.

  averaging-samples:
    type: int
    default: 16
    description: |
      Number of consecutive ADC samples to average for each reading.
```

## dts/bindings/sensor/qst,qma6100p.yaml
```yaml
# SPDX-License-Identifier: Apache-2.0

description: QST QMA6100P 3-axis accelerometer

compatible: "qst,qma6100p"

include: [sensor-device.yaml, i2c-device.yaml]

properties:
  irq-gpios:
    type: phandle-array
    description: Optional INT1 GPIO. The base driver does not enable interrupts yet.

  range-g:
    type: int
    default: 32
    enum: [2, 4, 8, 16, 32]
    description: Accelerometer full-scale range in g.
```

## dts/bindings/sensor/sensirion,sps30.yaml
```yaml
# SPDX-License-Identifier: Apache-2.0
description: Sensirion SPS30 particulate matter sensor on I2C
compatible: "sensirion,sps30"
include: [sensor-device.yaml, i2c-device.yaml]
```

## dts/bindings/sensor/zephyr,analog-light.yaml
```yaml
# SPDX-License-Identifier: Apache-2.0

description: Generic ADC-backed analog light sensor

compatible: "zephyr,analog-light"

include:
  - sensor-device.yaml

properties:
  io-channels:
    type: phandle-array
    required: true
    description: ADC channel connected to the analog light sensor.

  low-threshold-mv:
    type: int
    default: 80
    description: ADC voltage in millivolts mapped to light level 0.

  high-threshold-mv:
    type: int
    default: 2480
    description: ADC voltage in millivolts mapped to light level 100.

  averaging-samples:
    type: int
    default: 15
    description: Number of ADC samples averaged for each reading.
```
