## drivers/sensor/analog_light/Kconfig
```kconfig
# SPDX-License-Identifier: Apache-2.0

config ANALOG_LIGHT
	bool "Generic analog light sensor"
	depends on DT_HAS_ZEPHYR_ANALOG_LIGHT_ENABLED
	select ADC
	help
	  Enable a generic ADC-backed light sensor. The driver samples an ADC
	  input and maps the configured voltage range to SENSOR_CHAN_LIGHT as a
	  0-100 relative light level.
```

## drivers/sensor/composite/Kconfig
```kconfig
# Copyright (c) 2026 FoBE Studio
# SPDX-License-Identifier: Apache-2.0

config COMPASS_COMPOSITE
	bool "Zephyr composite compass sensor driver"
	default y
	depends on SENSOR
	depends on DT_HAS_ZEPHYR_COMPASS_COMPOSITE_ENABLED
	help
	  Enable compass composite driver that fuses accel, gyro, and magnetometer
	  data to provide heading through SENSOR_CHAN_COMPASS_HEADING.
```

## drivers/sensor/ecsense/es4_ag1/Kconfig
```kconfig
# EC Sense ES4-AG1 VOC sensor configuration options

config ES4_AG1
	bool "EC Sense ES4-AG1 VOC sensor"
	depends on DT_HAS_ECSENSE_ES4_AG1_ENABLED
	select ADC
	help
	  Enable support for the EC Sense ES4-AG1 electrochemical VOC sensor.
	  The driver samples a TIA/amplifier output through ADC io-channels and
	  reports SENSOR_CHAN_VOLTAGE and SENSOR_CHAN_VOC.
```

## drivers/sensor/ion/mini_pid/Kconfig
```kconfig
# Ion Science MiniPID A1 VOC sensor configuration options

config MINI_PID
	bool "Ion Science MiniPID PPM Gas Sensor"
	depends on DT_HAS_ION_MINI_PID_ENABLED
	select ADC
	help
	  Enable support for the Ion Science MiniPID PPM Gas Sensor.
	  The driver samples the analog output through an ADC channel and exposes
	  the readings using the Zephyr sensor API on SENSOR_CHAN_VOLTAGE and
	  SENSOR_CHAN_VOC.
```

## drivers/sensor/qst/qma6100p/Kconfig
```kconfig
# SPDX-FileCopyrightText: FoBE Studio
# SPDX-License-Identifier: Apache-2.0

menuconfig QMA6100P
	bool "QST QMA6100P accelerometer driver"
	default y
	depends on DT_HAS_QST_QMA6100P_ENABLED
	depends on I2C
	help
	  Enable the QST QMA6100P 3-axis accelerometer driver.
```

## drivers/sensor/sps30/Kconfig
```kconfig
# SPDX-License-Identifier: Apache-2.0
config SPS30
	bool "Sensirion SPS30 particulate matter sensor"
	default y
	depends on DT_HAS_SENSIRION_SPS30_ENABLED
	depends on I2C
	select CRC
	help
	  Read PM1.0, PM2.5 and PM10 mass concentrations over I2C.
```

## drivers/sensor/st/lsm6ds3_family/Kconfig
```kconfig
# SPDX-License-Identifier: Apache-2.0

menuconfig FOBE_LSM6DS3_FAMILY
	bool "FoBE LSM6DS3 family motion sensor driver"
	default y
	depends on DT_HAS_FOBE_LSM6DS3_FAMILY_ENABLED
	depends on I2C
	help
	  Enable the variant-aware LSM6DS3 family driver. It distinguishes the
	  LSM6DS3/LSM6DS3TR (WHO_AM_I 0x69) from the LSM6DS3TR-C/LSM6DSL
	  register family (WHO_AM_I 0x6a) and uses their common basic motion
	  sampling register subset.

if FOBE_LSM6DS3_FAMILY

config FOBE_LSM6DS3_FAMILY_ACCEL_ODR
	int "Accelerometer ODR register value"
	range 1 10
	default 1
	help
	  Common CTRL1_XL ODR encoding: 1=12.5 Hz, 2=26 Hz, 3=52 Hz,
	  4=104 Hz, 5=208 Hz, 6=416 Hz, 7=833 Hz, 8=1.66 kHz,
	  9=3.33 kHz, and 10=6.66 kHz.

config FOBE_LSM6DS3_FAMILY_GYRO_ODR
	int "Gyroscope ODR register value"
	range 1 10
	default 1
	help
	  Common CTRL2_G ODR encoding. Values have the same frequencies as the
	  accelerometer ODR setting.

config FOBE_LSM6DS3_FAMILY_ACCEL_FS
	int "Accelerometer full scale in g"
	range 2 16
	default 2
	help
	  Supported values are 2, 4, 8, and 16 g.

config FOBE_LSM6DS3_FAMILY_GYRO_FS
	int "Gyroscope full scale in degrees per second"
	range 125 2000
	default 250
	help
	  Supported values are 125, 250, 500, 1000, and 2000 dps.

endif # FOBE_LSM6DS3_FAMILY
```

## dts/bindings/adc/ti,ads1110.yaml
```yaml
description: |
  Texas Instruments ADS1110 I2C ADC.

  The device supports single-ended VIN+ and differential VIN+ - VIN- channel 0
  with hardware gains ADC_GAIN_1, ADC_GAIN_2, ADC_GAIN_4, and ADC_GAIN_8.
  Conversion resolution is tied to data rate: 12 bit = 240 SPS,
  14 bit = 60 SPS, 15 bit = 30 SPS, and 16 bit = 15 SPS. If
  zephyr,acquisition-time is used to encode an ADS1110 data rate, it must match
  the resolution requested in adc_sequence.

compatible: "ti,ads1110"

include: ti,ads1x1x-base.yaml
```

## dts/bindings/charger/zephyr,charger-composite.yaml
```yaml
# Copyright (c) 2025 FoBE Projects
# SPDX-License-Identifier: Apache-2.0

description: |
  Composite charger constructed from sensor/fuel-gauge devices and GPIO signals.

  This driver combines voltage readings from a sensor or fuel-gauge device with
  GPIO-based charging status detection to provide a complete charger interface.

  Charging status logic:
  - If online-gpios is provided and inactive: CHARGER_STATUS_NOT_CHARGING
  - If charging-gpios is active: CHARGER_STATUS_CHARGING
  - If charging-gpios is inactive and voltage >= constant-charge-voltage-max-microvolt:
    CHARGER_STATUS_FULL
  - If charging-gpios is not provided, infer charging from voltage trend
    (rise/fall thresholds with hold timeout)
  - Otherwise: CHARGER_STATUS_NOT_CHARGING

  Online status logic:
  - If online-gpios is provided, use it directly
  - If online-gpios is not provided and a voltage source exists, infer ONLINE_FIXED
    while charging/FULL and keep a short hold timeout
  - If neither online-gpios nor voltage source is available, ONLINE is not supported

  CHARGER_PROP_ONLINE_NOTIFICATION is available when online-gpios directly
  determines ONLINE. CHARGER_PROP_STATUS_NOTIFICATION is available for
  GPIO-only status configurations without voltage or Nordic VBUS-derived
  state. Statuses derived from voltage, VBUS, or hold timeouts must be read
  periodically by the consumer.

  Supported GPIO notifications use edge interrupts and the configured
  debounce interval when possible. Other GPIOs are checked at
  gpio-poll-interval-ms. Consumers use the same notification API without
  depending on the selected backend.

compatible: zephyr,charger-composite

include: [base.yaml, battery.yaml]

properties:
  source-primary:
    type: phandle
    description: |
      Primary device to read voltage data from.
      Device may implement either:
      - Fuel gauge API (FUEL_GAUGE_VOLTAGE), or
      - Sensor API (SENSOR_CHAN_VOLTAGE)
      The driver will attempt fuel gauge API first, then sensor API.

      If not specified, the driver will only use GPIO-based charging
      detection without voltage-based FULL state detection.

  source-secondary:
    type: phandle
    description: |
      Secondary device to read voltage data from.
      This device will be used if source-primary does not expose
      the voltage channel.

      Device may implement sensor API or fuel gauge API.

  charge-full-hysteresis-microvolt:
    type: int
    default: 50000
    description: |
      Hysteresis voltage in microvolts for FULL state detection.
      To prevent oscillation between FULL and NOT_CHARGING states:
      - Enter FULL: voltage >= constant-charge-voltage-max-microvolt
      - Exit FULL: voltage < (constant-charge-voltage-max-microvolt - hysteresis)
      Default is 50mV (50000 uV).

  charge-detect-rise-threshold-microvolt:
    type: int
    default: 8000
    description: |
      Minimum voltage increase (uV) between inference samples to count as
      charging evidence when charging-gpios is not provided.

  charge-detect-fall-threshold-microvolt:
    type: int
    default: 12000
    description: |
      Minimum voltage decrease (uV) between inference samples to count as
      discharge evidence and exit inferred charging state.

  charge-detect-sample-interval-ms:
    type: int
    default: 5000
    description: |
      Minimum elapsed time between two voltage points used for trend inference.
      Status calls within this interval reuse the last trend evidence.

  charge-detect-enter-count:
    type: int
    default: 2
    description: |
      Number of consecutive rise evidences required to enter inferred
      CHARGING state.

  charge-detect-exit-count:
    type: int
    default: 2
    description: |
      Number of consecutive fall evidences required to leave inferred
      CHARGING state.

  charge-detect-hold-ms:
    type: int
    default: 45000
    description: |
      Maximum time to keep inferred CHARGING after the last rise evidence.
      If this timeout expires, status falls back to NOT_CHARGING.

  online-infer-hold-ms:
    type: int
    default: 120000
    description: |
      Hold timeout used by ONLINE weak inference when online-gpios is not
      provided. ONLINE remains FIXED for this duration after charging/FULL
      evidence.

  gpio-debounce-ms:
    type: int
    default: 30
    description: |
      Delay in milliseconds used to debounce charging-gpios and online-gpios
      edges before charger notification callbacks run.

  gpio-poll-interval-ms:
    type: int
    default: 1000
    min: 1
    description: |
      Interval in milliseconds used to check charging-gpios and online-gpios
      when their GPIO controller does not support interrupts. Polling starts
      only while a charger status or online notifier is registered.

  charging-gpios:
    type: phandle-array
    description: |
      GPIO indicating charging status.
      When this GPIO is active (according to the flags specified),
      the charger is considered to be charging.

  online-gpios:
    type: phandle-array
    description: |
      GPIO indicating external power is connected.
      When this GPIO is active (according to the flags specified),
      external power supply is considered to be present.

  nordic,vbus-detect:
    type: boolean
    description: |
      Use the Nordic POWER USBREGSTATUS VBUSDETECT bit as an external power
      source indicator. When VBUS is present, ONLINE is reported as FIXED and
      STATUS is reported as CHARGING unless the voltage source is already at
      the configured full-charge threshold. When VBUS is absent, ONLINE is
      reported as OFFLINE and STATUS is reported as NOT_CHARGING without
      voltage-trend inference or hold timeouts.
```

## dts/bindings/display/arduino,modulino-led-matrix.yaml
```yaml
# Copyright (c) 2026 FoBE Studio
# SPDX-License-Identifier: Apache-2.0

description: |
  Arduino Modulino LED Matrix with a 12x8 panel and STM32 I2C controller
  running node_modulino_firmware with MON and GS4 mode reporting.
  The default 7-bit address is 0x39 (the firmware uses shifted address 0x72).

compatible: "arduino,modulino-led-matrix"

include: [i2c-device.yaml, display-controller.yaml]

properties:
  width:
    const: 12

  height:
    const: 8

  command-delay-ms:
    type: int
    default: 1
    description: |
      Minimum settling time after each I2C write. Firmware processes received
      data in its main loop and shares the receive and status buffers. The
      default follows the Arduino library's mode-switch delay; increase it if
      required by the installed firmware. Must be greater than zero.
```

## dts/bindings/ethernet/wch,ch390.yaml
```yaml
# Copyright (c) 2026 FoBE Studio
# SPDX-License-Identifier: Apache-2.0

description: WCH CH390D/H standalone 10/100BASE-T Ethernet controller with SPI interface

compatible: "wch,ch390"
on-bus: spi

include: [spi-device.yaml, ethernet-controller.yaml]

properties:
  int-gpios:
    type: phandle-array
    required: true
    description: |
      Interrupt pin of CH390. The default chip polarity is active high.
      If connected directly, the MCU pin should be configured as active high.

  reset-gpios:
    type: phandle-array
    required: true
    description: |
      Reset pin of CH390. The reset pin is active low.
      If connected directly, the MCU pin should be configured as active low.
```

## dts/bindings/gnss/quectel,l76k.yaml
```yaml
# Copyright (c) 2026 FoBE Studio
# SPDX-License-Identifier: Apache-2.0

description: |
  Quectel L76K GNSS modem based on CASIC AT6558R chipset.
  Supports GPS, GLONASS, BeiDou, and QZSS constellations.

compatible: quectel,l76k

include:
  - uart-device.yaml

properties:
  pps-gpios:
    type: phandle-array
    description: |
      GPIO connected to the PPS (Pulse Per Second) output pin.
      Used for precise time synchronization.

  reset-gpios:
    type: phandle-array
    description: |
      GPIO connected to the RESET pin.
      Used for hardware reset of the module.

  wakeup-gpios:
    type: phandle-array
    description: |
      GPIO connected to the WAKEUP pin.
      Used to wake the module from low power mode.
```

## dts/bindings/input/ti,tca8418-kbd.yaml
```yaml
# Copyright (c) 2025 FoBE Projects
# SPDX-License-Identifier: Apache-2.0

description: |
  Texas Instruments TCA8418 keyboard matrix scan controller.

  This is a child device of the TCA8418 MFD (ti,tca8418) and provides
  keyboard matrix scanning functionality for up to 80 keys (8x10 matrix).

  Key events are reported as INPUT_ABS_X (column), INPUT_ABS_Y (row), and
  INPUT_BTN_TOUCH (press/release). Use an input-keymap child node to map
  row/column positions to specific key codes.

  Example configuration:

    #include <zephyr/dt-bindings/input/input-event-codes.h>
    #include <zephyr/dt-bindings/input/keymap.h>

    &i2c0 {
        tca8418: tca8418@34 {
            compatible = "ti,tca8418";
            reg = <0x34>;
            int-gpios = <&gpio0 5 (GPIO_ACTIVE_LOW | GPIO_PULL_UP)>;

            tca8418_kbd: kbd {
                compatible = "ti,tca8418-kbd";
                row-size = <4>;
                col-size = <4>;

                keymap {
                    compatible = "input-keymap";
                    keymap = <
                        MATRIX_KEY(0, 0, INPUT_KEY_1)
                        MATRIX_KEY(0, 1, INPUT_KEY_2)
                        MATRIX_KEY(0, 2, INPUT_KEY_3)
                        MATRIX_KEY(0, 3, INPUT_KEY_A)
                    >;
                    row-size = <4>;
                    col-size = <4>;
                };
            };
        };
    };

compatible: "ti,tca8418-kbd"

properties:
  row-size:
    type: int
    required: true
    description: |
      Number of rows used in the keypad matrix (1-8).
      Configures ROW0 to ROW(row-size-1) pins for keypad scanning.

  col-size:
    type: int
    required: true
    description: |
      Number of columns used in the keypad matrix (1-10).
      Configures COL0 to COL(col-size-1) pins for keypad scanning.

  poll-interval-ms:
    type: int
    default: 10
    description: |
      Polling interval in milliseconds when using polling mode
      as a fallback. Default is 10ms.
```

## dts/bindings/led/fobe,lp5024-mono.yaml
```yaml
# Copyright (c) 2026 FoBE Studio
# SPDX-License-Identifier: Apache-2.0

description: TI LP5024 single-channel LED controller modeled as mono outputs

compatible: "fobe,lp5024-mono"

include: ["i2c-device.yaml", "led-controller.yaml"]

properties:
  enable-gpios:
    type: phandle-array
    description: GPIO used to enable or disable the controller.

  max-curr-opt:
    type: boolean
    description: Enable the LP5024 high current output setting.

  log-scale-en:
    type: boolean
    description: Enable the LP5024 logarithmic dimming curve.

child-binding:
  description: LP5024 mono LED output

  properties:
    label:
      required: true

    index:
      type: int
      required: true
      description: Physical LP5024 output number in the range 0..23.
```
