## Kconfig
```kconfig
rsource "bootloader/Kconfig"
rsource "modules/Kconfig"
rsource "drivers/Kconfig"
rsource "subsys/Kconfig"
```

## apps/meshbus/boards/fobe/devkit_nrf54l15/Kconfig.defconfig
```kconfig
# Copyright (c) 2026 FoBE Studio
# SPDX-License-Identifier: Apache-2.0

config HW_STACK_PROTECTION
	default ARCH_HAS_STACK_PROTECTION

if BOARD_DEVKIT_NRF54L15_NRF54L15_CPUAPP || \
	BOARD_DEVKIT_NRF54L15_NRF54L15_CPUAPP_MB_CLIENT || \
	BOARD_DEVKIT_NRF54L15_NRF54L15_CPUAPP_MB_REPEATER || \
	BOARD_DEVKIT_NRF54L15_NRF54L15_CPUAPP_MB_ROOM || \
	BOARD_DEVKIT_NRF54L15_NRF54L15_CPUAPP_MB_SENSOR

config HAS_BT_CTLR
	default BT

config ROM_START_OFFSET
	default 0 if PARTITION_MANAGER_ENABLED
	default 0x800 if BOOTLOADER_MCUBOOT

endif # CPUAPP targets
```

## apps/meshbus/boards/fobe/devkit_nrf54l15/Kconfig.devkit_nrf54l15
```kconfig
# Copyright (c) 2026 FoBE Studio
# SPDX-License-Identifier: Apache-2.0

config BOARD_DEVKIT_NRF54L15
	select SOC_NRF54L15_CPUAPP if BOARD_DEVKIT_NRF54L15_NRF54L15_CPUAPP || \
		BOARD_DEVKIT_NRF54L15_NRF54L15_CPUAPP_MB_CLIENT || \
		BOARD_DEVKIT_NRF54L15_NRF54L15_CPUAPP_MB_REPEATER || \
		BOARD_DEVKIT_NRF54L15_NRF54L15_CPUAPP_MB_ROOM || \
		BOARD_DEVKIT_NRF54L15_NRF54L15_CPUAPP_MB_SENSOR
	select SOC_NRF54L15_CPUFLPR if \
		BOARD_DEVKIT_NRF54L15_NRF54L15_CPUFLPR
```

## apps/meshbus/boards/fobe/devkit_nrf54l15/board.yml
```yaml
# SPDX-License-Identifier: Apache-2.0

board:
  extend: devkit_nrf54l15
  variants:
    - name: mb_client
      qualifier: nrf54l15/cpuapp
    - name: mb_repeater
      qualifier: nrf54l15/cpuapp
    - name: mb_room
      qualifier: nrf54l15/cpuapp
    - name: mb_sensor
      qualifier: nrf54l15/cpuapp
```

## boards/fobe/devkit_esp32c6/Kconfig.devkit_esp32c6
```kconfig
# Copyright (c) 2026 FoBE Studio
# SPDX-License-Identifier: Apache-2.0

config BOARD_DEVKIT_ESP32C6
	select SOC_ESP32C6
	select SOC_ESP32C6_HPCORE if BOARD_DEVKIT_ESP32C6_ESP32C6_HPCORE
	select SOC_ESP32C6_LPCORE if BOARD_DEVKIT_ESP32C6_ESP32C6_LPCORE
```

## boards/fobe/devkit_esp32c6/board.yml
```yaml
# SPDX-FileCopyrightText: FoBE Studio
# SPDX-License-Identifier: Apache-2.0

board:
  name: devkit_esp32c6
  full_name: FoBE DevKit ESP32C6
  vendor: fobe
  socs:
    - name: esp32c6
```

## boards/fobe/devkit_esp32s3/Kconfig
```kconfig
# Copyright (c) 2026 FoBE Studio
# SPDX-License-Identifier: Apache-2.0

config HEAP_MEM_POOL_ADD_SIZE_BOARD
	int
	default 4096 if BOARD_DEVKIT_ESP32S3_ESP32S3_PROCPU
	default 256 if BOARD_DEVKIT_ESP32S3_ESP32S3_APPCPU
```

## boards/fobe/devkit_esp32s3/board.yml
```yaml
# SPDX-FileCopyrightText: FoBE Studio
# SPDX-License-Identifier: Apache-2.0

board:
  name: devkit_esp32s3
  full_name: DevKit ESP32S3
  vendor: fobe
  socs:
  - name: esp32s3
```

## boards/fobe/devkit_nrf54l15/Kconfig.defconfig
```kconfig
# Copyright (c) 2026 FoBE Studio
# SPDX-License-Identifier: Apache-2.0

config HW_STACK_PROTECTION
	default ARCH_HAS_STACK_PROTECTION

if BOARD_DEVKIT_NRF54L15_NRF54L15_CPUAPP

config HAS_BT_CTLR
	default BT

config ROM_START_OFFSET
	default 0 if PARTITION_MANAGER_ENABLED
	default 0x800 if BOOTLOADER_MCUBOOT

endif # BOARD_DEVKIT_NRF54L15_NRF54L15_CPUAPP
```

## boards/fobe/devkit_nrf54l15/Kconfig.devkit_nrf54l15
```kconfig
# Copyright (c) 2026 FoBE Studio
# SPDX-License-Identifier: Apache-2.0

config BOARD_DEVKIT_NRF54L15
	select SOC_NRF54L15_CPUAPP if BOARD_DEVKIT_NRF54L15_NRF54L15_CPUAPP
	select SOC_NRF54L15_CPUFLPR if \
		BOARD_DEVKIT_NRF54L15_NRF54L15_CPUFLPR || \
		BOARD_DEVKIT_NRF54L15_NRF54L15_CPUFLPR_XIP
```

## boards/fobe/devkit_nrf54l15/board.yml
```yaml
board:
  name: devkit_nrf54l15
  full_name: FoBE DevKit nRF54L15
  vendor: fobe
  socs:
  - name: nrf54l15
    variants:
    - name: xip
      cpucluster: cpuflpr
```

## boards/fobe/devkit_nrf54l15/devkit_nrf54l15_nrf54l15_cpuapp_defconfig
```kconfig
# Copyright (c) 2026 FoBE Studio
# SPDX-License-Identifier: Apache-2.0

# Enable UART driver
CONFIG_SERIAL=y

# Enable console
CONFIG_CONSOLE=y
CONFIG_UART_CONSOLE=y

# Enable GPIO
CONFIG_GPIO=y

# Enable MPU
CONFIG_ARM_MPU=y

CONFIG_PINCTRL_KEEP_SLEEP_STATE=y
```

## boards/fobe/idea_mesh_tracker_c1/Kconfig.defconfig
```kconfig
# IDEA MESH TRACKER C1 board configuration

# Copyright (c) 2025 Chiho Sin
# SPDX-License-Identifier: Apache-2.0

if BOARD_IDEA_MESH_TRACKER_C1

config HW_STACK_PROTECTION
	default ARCH_HAS_STACK_PROTECTION

source "boards/common/usb/Kconfig.cdc_acm_serial.defconfig"

endif # BOARD_IDEA_MESH_TRACKER_C1
```

## boards/fobe/idea_mesh_tracker_c1/board.yml
```yaml
board:
  name: idea_mesh_tracker_c1
  full_name: IDEA Mesh Tracker C1
  vendor: fobe
  socs:
  - name: nrf52840
```

## boards/fobe/idea_mesh_tracker_c2/Kconfig
```kconfig
# Copyright (c) 2026 FoBE Studio
# SPDX-License-Identifier: Apache-2.0

# FoBE IDEA Mesh Tracker C2 board configuration

if BOARD_IDEA_MESH_TRACKER_C2_NRF54L15_CPUAPP_NS

DT_NRF_MPC := $(dt_nodelabel_path,nrf_mpc)

config NRF_TRUSTZONE_FLASH_REGION_SIZE
	hex
	default $(dt_node_int_prop_hex,$(DT_NRF_MPC),override-granularity)
	help
	  This defines the flash region size from the TrustZone perspective.
	  It is used when configuring the TrustZone and when setting alignments
	  requirements for the partitions.
	  This abstraction allows us to configure TrustZone without depending
	  on peripheral-specific symbols.

config NRF_TRUSTZONE_RAM_REGION_SIZE
	hex
	default $(dt_node_int_prop_hex,$(DT_NRF_MPC),override-granularity)
	help
	  This defines the RAM region size from the TrustZone perspective.
	  It is used when configuring the TrustZone and when setting alignments
	  requirements for the partitions.
	  This abstraction allows us to configure TrustZone without depending
	  on peripheral specific symbols.

endif # BOARD_IDEA_MESH_TRACKER_C2_NRF54L15_CPUAPP_NS
```

## boards/fobe/idea_mesh_tracker_c2/Kconfig.idea_mesh_tracker_c2
```kconfig
# Copyright (c) 2026 FoBE Studio
# SPDX-License-Identifier: Apache-2.0

config BOARD_IDEA_MESH_TRACKER_C2
	select SOC_NRF54L15_CPUAPP if BOARD_IDEA_MESH_TRACKER_C2_NRF54L15_CPUAPP || BOARD_IDEA_MESH_TRACKER_C2_NRF54L15_CPUAPP_NS
	select SOC_NRF54L15_CPUFLPR if BOARD_IDEA_MESH_TRACKER_C2_NRF54L15_CPUFLPR || \
					    BOARD_IDEA_MESH_TRACKER_C2_NRF54L15_CPUFLPR_XIP
```

## boards/fobe/idea_mesh_tracker_c2/board.yml
```yaml
board:
  name: idea_mesh_tracker_c2
  full_name: FoBE IDEA Mesh Tracker C2
  vendor: fobe
  socs:
  - name: nrf54l15
    variants:
      - name: xip
        cpucluster: cpuflpr
      - name: ns
        cpucluster: cpuapp
```

## boards/fobe/mesh_probe_r1/Kconfig.defconfig
```kconfig
# Mesh Probe R1 board configuration

# Copyright (c) 2025 Chiho Sin
# SPDX-License-Identifier: Apache-2.0

if BOARD_MESH_PROBE_R1

config HW_STACK_PROTECTION
	default ARCH_HAS_STACK_PROTECTION

source "boards/common/usb/Kconfig.cdc_acm_serial.defconfig"

endif # BOARD_MESH_PROBE_R1
```

## boards/fobe/mesh_probe_r1/Kconfig.mesh_probe_r1
```kconfig
# Mesh Probe R1 board configuration

# Copyright (c) 2025 Chiho Sin
# SPDX-License-Identifier: Apache-2.0

config BOARD_MESH_PROBE_R1
	select SOC_NRF52840_QIAA
```

## boards/fobe/mesh_probe_r1/board.yml
```yaml
# SPDX-FileCopyrightText: FoBE Studio
# SPDX-License-Identifier: Apache-2.0

board:
  name: mesh_probe_r1
  full_name: Mesh Probe R1
  vendor: fobe
  socs:
  - name: nrf52840
```

## boards/fobe/mesh_probe_r2/Kconfig.defconfig
```kconfig
# Copyright (c) 2026 FoBE Studio
# SPDX-License-Identifier: Apache-2.0

config HW_STACK_PROTECTION
	default ARCH_HAS_STACK_PROTECTION

if BOARD_MESH_PROBE_R2

config GPIO_PCA953X_INIT_PRIORITY
	default 85 if GPIO_PCA953X

config GPIO_PCA_SERIES_INIT_PRIORITY
	default 85 if GPIO_PCA_SERIES

endif # BOARD_MESH_PROBE_R2

if BOARD_MESH_PROBE_R2_NRF54L15_CPUAPP

config ROM_START_OFFSET
	default 0 if PARTITION_MANAGER_ENABLED
	default 0x800 if BOOTLOADER_MCUBOOT

endif # BOARD_MESH_PROBE_R2_NRF54L15_CPUAPP

if BOARD_MESH_PROBE_R2_NRF54L15_CPUAPP_NS

config BOARD_MESH_PROBE_R2
	select USE_DT_CODE_PARTITION if BOARD_MESH_PROBE_R2_NRF54L15_CPUAPP_NS

config HAS_BT_CTLR
	default BT

# By default, if we build for a Non-Secure version of the board,
# enable building with TF-M as the Secure Execution Environment.
config BUILD_WITH_TFM
	default y

endif # BOARD_MESH_PROBE_R2_NRF54L15_CPUAPP_NS
```

## boards/fobe/mesh_probe_r2/Kconfig.mesh_probe_r2
```kconfig
# Copyright (c) 2026 FoBE Studio
# SPDX-License-Identifier: Apache-2.0

config BOARD_MESH_PROBE_R2
	select SOC_NRF54L15_CPUAPP if BOARD_MESH_PROBE_R2_NRF54L15_CPUAPP || BOARD_MESH_PROBE_R2_NRF54L15_CPUAPP_NS
	select SOC_NRF54L15_CPUFLPR if BOARD_MESH_PROBE_R2_NRF54L15_CPUFLPR || \
					    BOARD_MESH_PROBE_R2_NRF54L15_CPUFLPR_XIP
```

## boards/fobe/mesh_probe_r2/board.yml
```yaml
# SPDX-FileCopyrightText: FoBE Studio
# SPDX-License-Identifier: Apache-2.0

board:
  name: mesh_probe_r2
  full_name: Mesh Probe R2
  vendor: fobe
  socs:
  - name: nrf54l15
    variants:
      - name: xip
        cpucluster: cpuflpr
      - name: ns
        cpucluster: cpuapp
```
