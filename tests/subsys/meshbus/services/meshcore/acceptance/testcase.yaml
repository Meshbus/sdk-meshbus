## tests/subsys/meshbus/services/meshcore/acceptance/testcase.yaml
```yaml
tests:
  subsys.meshbus.meshcore.integration.request_acceptance:
    tags:
      - meshbus
      - meshcore
      - integration
    harness: ztest
    platform_allow:
      - qemu_x86
    integration_platforms:
      - qemu_x86
```

## tests/subsys/meshbus/services/message/testcase.yaml
```yaml
tests:
  subsys.meshbus.message.contract:
    tags:
      - meshbus
      - message
      - contract
      - ztest
    harness: ztest
    platform_allow:
      - qemu_x86
    integration_platforms:
      - qemu_x86

  subsys.meshbus.message.service_dut.c2:
    tags:
      - meshbus
      - message
      - service_dut
      - ztest
    harness: ztest
    harness_config:
      fixture: c2
    timeout: 30
    platform_allow:
      - idea_mesh_tracker_c2/nrf54l15/cpuapp
    integration_platforms:
      - idea_mesh_tracker_c2/nrf54l15/cpuapp
    extra_conf_files:
      - configs/service_dut.conf
```

## tests/subsys/meshbus/services/radio/testcase.yaml
```yaml
tests:
  subsys.meshbus.radio.contract:
    tags:
      - meshbus
      - radio
      - contract
    harness: ztest
    platform_allow:
      - qemu_x86
    integration_platforms:
      - qemu_x86

  subsys.meshbus.radio.service_dut.c2:
    tags:
      - meshbus
      - radio
      - service_dut
    harness: ztest
    harness_config:
      fixture:
        - c2
        - radio
        - test-storage
    timeout: 30
    platform_allow:
      - idea_mesh_tracker_c2/nrf54l15/cpuapp
    integration_platforms:
      - idea_mesh_tracker_c2/nrf54l15/cpuapp
    extra_conf_files:
      - configs/service_dut.conf
```

## tests/subsys/meshcore/role_lifecycle/testcase.yaml
```yaml
common:
  tags: [meshbus, meshcore, contract]
  harness: ztest
  platform_allow: mps2/an385
  integration_platforms: [mps2/an385]
  expect_reboot: true
  timeout: 90
tests:
  subsys.meshbus.meshcore.contract.role_lifecycle.one_channel: {}
  subsys.meshbus.meshcore.contract.role_lifecycle.two_channels:
    extra_configs:
      - CONFIG_MBS_CHANNEL_MAX_CHANNELS=2
  subsys.meshbus.meshcore.contract.role_lifecycle.no_chat:
    extra_configs:
      - CONFIG_MBS_CONTACT=n
      - CONFIG_MBS_CHANNEL=n
      - CONFIG_MBS_MESSAGE=n
  subsys.meshbus.meshcore.integration.role_lifecycle.runtime:
    tags: [meshbus, meshcore, integration]
    extra_args: [ROLE_RUNTIME_TEST=ON]
    extra_dtc_overlay_files: [boards/mps2_an385.overlay, runtime.overlay]
    extra_configs:
      - CONFIG_LORA_SX126X=n
      - CONFIG_MBS_MESHCORE_RUNTIME=y
      - CONFIG_MBS_RADIO=y
      - CONFIG_LORA=y
      - CONFIG_LORA_MODULE_BACKEND_LORAMAC_NODE=n
      - CONFIG_LORA_MODULE_BACKEND_LORA_BASICS_MODEM=y
  subsys.meshbus.meshcore.integration.role_lifecycle.subscriber:
    tags: [meshbus, meshcore, integration]
    extra_args: [ROLE_RUNTIME_TEST=ON]
    extra_dtc_overlay_files: [boards/mps2_an385.overlay, runtime.overlay]
    extra_configs:
      - CONFIG_LORA_SX126X=n
      - CONFIG_MBS_MESHCORE_RUNTIME=y
      - CONFIG_MBS_RADIO=y
      - CONFIG_LORA=y
      - CONFIG_LORA_MODULE_BACKEND_LORAMAC_NODE=n
      - CONFIG_LORA_MODULE_BACKEND_LORA_BASICS_MODEM=y
      - CONFIG_ZBUS_MSG_SUBSCRIBER=y
      - CONFIG_MBS_MESHCORE_RADIO_RX_ZBUS_SUBSCRIBER=y
  subsys.meshbus.meshcore.integration.role_lifecycle.runtime_no_chat:
    tags: [meshbus, meshcore, integration]
    extra_args: [ROLE_RUNTIME_TEST=ON]
    extra_dtc_overlay_files: [boards/mps2_an385.overlay, runtime.overlay]
    extra_configs:
      - CONFIG_LORA_SX126X=n
      - CONFIG_MBS_MESHCORE_RUNTIME=y
      - CONFIG_MBS_RADIO=y
      - CONFIG_LORA=y
      - CONFIG_LORA_MODULE_BACKEND_LORAMAC_NODE=n
      - CONFIG_LORA_MODULE_BACKEND_LORA_BASICS_MODEM=y
      - CONFIG_MBS_CONTACT=n
      - CONFIG_MBS_CHANNEL=n
      - CONFIG_MBS_MESSAGE=n
```

## tests/subsys/meshcore/service_dut/testcase.yaml
```yaml
tests:
  subsys.meshbus.meshcore.service_dut.mesh_probe_r2.receive_only:
    tags:
      - meshbus
      - meshcore
      - radio
      - service_dut
    harness: ztest
    harness_config:
      fixture:
        - mesh_probe_r2
        - radio
        - test-storage
    timeout: 30
    platform_allow:
      - mesh_probe_r2/nrf54l15/cpuapp
    integration_platforms:
      - mesh_probe_r2/nrf54l15/cpuapp
```

## tests/subsys/meshcore/testcase.yaml
```yaml
tests:
  subsys.meshbus.meshcore.contract.companion_protocol:
    tags:
      - meshbus
      - meshcore
      - contract
    harness: ztest
    platform_allow:
      - qemu_cortex_m3
    integration_platforms:
      - qemu_cortex_m3
```

## tests/subsys/message/system/testcase.yaml
```yaml
tests:
  subsys.meshbus.system.message.endpoint.mesh_probe_r2:
    tags:
      - meshbus
      - message
      - system
    build_only: true
    platform_allow:
      - mesh_probe_r2/nrf54l15/cpuapp
    integration_platforms:
      - mesh_probe_r2/nrf54l15/cpuapp
  subsys.meshbus.system.message.endpoint.devkit_nrf54l15:
    tags:
      - meshbus
      - meshcore
      - message
      - system
    build_only: true
    platform_allow:
      - devkit_nrf54l15/nrf54l15/cpuapp
    integration_platforms:
      - devkit_nrf54l15/nrf54l15/cpuapp
```

## tests/subsys/message/testcase.yaml
```yaml
tests:
  subsys.meshbus.message.contract:
    tags:
      - meshbus
      - message
      - contract
      - ztest
    harness: ztest
    platform_allow:
      - qemu_x86
    integration_platforms:
      - qemu_x86

  subsys.meshbus.message.service_dut.mesh_probe_r2:
    tags:
      - meshbus
      - message
      - service_dut
      - ztest
    harness: ztest
    harness_config:
      fixture: mesh_probe_r2
    timeout: 30
    platform_allow:
      - mesh_probe_r2/nrf54l15/cpuapp
    integration_platforms:
      - mesh_probe_r2/nrf54l15/cpuapp
    extra_conf_files:
      - configs/service_dut.conf
```

## tests/subsys/mgmt/access_policy/testcase.yaml
```yaml
tests:
  subsys.meshbus.management.integration.access_policy:
    tags:
      - meshbus
      - management
      - mcumgr
      - integration
    harness: ztest
    platform_allow:
      - qemu_x86
    integration_platforms:
      - qemu_x86
```

## tests/subsys/mgmt/config_handlers/testcase.yaml
```yaml
tests:
  subsys.meshbus.management.config_handlers.integration:
    tags:
      - meshbus
      - management
      - integration
      - ztest
    harness: ztest
    platform_allow:
      - qemu_x86
    integration_platforms:
      - qemu_x86
```

## tests/subsys/notify/testcase.yaml
```yaml
tests:
  subsys.meshbus.notify.contract:
    tags:
      - meshbus
      - notify
      - contract
      - ztest
    harness: ztest
    platform_allow:
      - qemu_x86
    integration_platforms:
      - qemu_x86
```

## tests/subsys/power/testcase.yaml
```yaml
tests:
  subsys.meshbus.power.contract:
    tags:
      - meshbus
      - power
      - contract
      - ztest
    harness: ztest
    platform_allow:
      - qemu_x86
    integration_platforms:
      - qemu_x86
  subsys.meshbus.power.contract.fuel_gauge:
    tags:
      - meshbus
      - power
      - contract
      - ztest
    harness: ztest
    platform_allow:
      - qemu_x86
    integration_platforms:
      - qemu_x86
    extra_dtc_overlay_files:
      - boards/qemu_x86_fuel_gauge.overlay
    extra_conf_files:
      - configs/fuel_gauge.conf
  subsys.meshbus.power.contract.meshcore_shutdown_flush:
    tags:
      - meshbus
      - power
      - meshcore
      - contract
      - ztest
    harness: ztest
    platform_allow:
      - qemu_x86
    integration_platforms:
      - qemu_x86
    extra_conf_files:
      - configs/meshcore_shutdown_flush.conf
```

## tests/subsys/radio/health/testcase.yaml
```yaml
# SPDX-FileCopyrightText: 2026 FoBE Studio
# SPDX-License-Identifier: Apache-2.0
tests:
  subsys.meshbus.radio.health:
    tags: [meshbus, radio, contract, ztest]
    harness: ztest
    platform_allow: [qemu_x86]
    integration_platforms: [qemu_x86]
```

## tests/subsys/radio/testcase.yaml
```yaml
tests:
  subsys.meshbus.radio.contract:
    tags:
      - meshbus
      - radio
      - contract
    harness: ztest
    platform_allow:
      - qemu_x86
    integration_platforms:
      - qemu_x86

  subsys.meshbus.radio.service_dut.mesh_probe_r2:
    tags:
      - meshbus
      - radio
      - service_dut
    harness: ztest
    harness_config:
      fixture:
        - mesh_probe_r2
        - radio
        - test-storage
    timeout: 30
    platform_allow:
      - mesh_probe_r2/nrf54l15/cpuapp
    integration_platforms:
      - mesh_probe_r2/nrf54l15/cpuapp
    extra_conf_files:
      - configs/service_dut.conf
```

## tests/subsys/settings/performance/testcase.yaml
```yaml
tests:
  subsys.meshbus.performance.settings.zms_blob.cached:
    tags:
      - meshbus
      - settings
      - zms
      - performance
    harness: ztest
    platform_allow:
      - qemu_x86
    integration_platforms:
      - qemu_x86
    extra_conf_files:
      - cached.conf
  subsys.meshbus.performance.settings.zms_blob.release_uncached:
    tags:
      - meshbus
      - settings
      - zms
      - performance
    harness: ztest
    platform_allow:
      - qemu_x86
    integration_platforms:
      - qemu_x86
    extra_conf_files:
      - release-uncached.conf
  subsys.meshbus.performance.settings.zms_blob.cached.c2_build:
    tags:
      - meshbus
      - settings
      - zms
      - performance
      - build_only
    build_only: true
    platform_allow:
      - mesh_probe_r2/nrf54l15/cpuapp
    integration_platforms:
      - mesh_probe_r2/nrf54l15/cpuapp
    extra_conf_files:
      - cached.conf
  subsys.meshbus.performance.settings.zms_blob.release_uncached.c2_build:
    tags:
      - meshbus
      - settings
      - zms
      - performance
      - build_only
    build_only: true
    platform_allow:
      - mesh_probe_r2/nrf54l15/cpuapp
    integration_platforms:
      - mesh_probe_r2/nrf54l15/cpuapp
    extra_conf_files:
      - release-uncached.conf
```

## tests/subsys/telemetry/testcase.yaml
```yaml
tests:
  subsys.meshbus.telemetry.contract:
    tags:
      - meshbus
      - telemetry
      - contract
      - ztest
    harness: ztest
    platform_allow:
      - qemu_x86
    integration_platforms:
      - qemu_x86
```

## tests/subsys/zui/assets/testcase.yaml
```yaml
tests:
  zui.assets:
    platform_allow: qemu_x86
    tags:
      - zui
      - assets
```

## tests/subsys/zui/component/testcase.yaml
```yaml
tests:
  zui.component:
    platform_allow: qemu_x86
    tags:
      - zui
      - component
  zui.component.keypad_disabled:
    platform_allow: qemu_x86
    extra_args: CONF_FILE=prj_keypad_disabled.conf
    tags:
      - zui
      - component
  zui.component.predictive_only:
    platform_allow: qemu_x86
    extra_args: CONF_FILE=prj_predictive_only.conf
    tags:
      - zui
      - component
```

## tests/subsys/zui/input/testcase.yaml
```yaml
tests:
  zui.input:
    platform_allow: qemu_x86
    tags:
      - zui
      - input
```

## tests/subsys/zui/predictive/testcase.yaml
```yaml
tests:
  zui.predictive.empty:
    platform_allow: qemu_x86
    extra_configs:
      - CONFIG_ZUI_TEXT_EDITOR_PREDICTIVE_BUILTIN_ENGLISH_DICT=n
    tags:
      - zui
      - predictive
  zui.predictive.fixture:
    platform_allow: qemu_x86
    extra_configs:
      - CONFIG_ZUI_TEXT_EDITOR_PREDICTIVE_DICT_SOURCE="words.txt"
      - CONFIG_ZUI_TEXT_EDITOR_PREDICTIVE_SOURCE_LICENSE="FoBE test fixture"
    tags:
      - zui
      - predictive
  zui.predictive.fixture_small_budget:
    platform_allow: qemu_x86
    extra_configs:
      - CONFIG_ZUI_TEXT_EDITOR_PREDICTIVE_DICT_SOURCE="words.txt"
      - CONFIG_ZUI_TEXT_EDITOR_PREDICTIVE_SOURCE_LICENSE="FoBE test fixture"
      - CONFIG_ZUI_TEXT_EDITOR_PREDICTIVE_DICT_SIZE=64
    tags:
      - zui
      - predictive
```

## tests/subsys/zui/screen/testcase.yaml
```yaml
tests:
  subsys.zui.screen:
    tags:
      - zui
      - screen
      - ztest
    harness: ztest
    platform_allow:
      - qemu_x86
    integration_platforms:
      - qemu_x86
```

## west.yml
```yaml
manifest:
  remotes:
    - name: meshbus
      url-base: https://github.com/Meshbus
    - name: zephyrproject
      url-base: https://github.com/zephyrproject-rtos

  defaults:
    remote: meshbus

  projects:
    - name: zephyr
      repo-path: sdk-zephyr
      revision: 4adceb2f861d6a6de67e348c329e12735c21e8f0
      import: true
    - name: meshbus-protobufs
      path: modules/lib/meshbus-protobufs
      repo-path: meshbus-protobufs
      revision: bcd91e626174b2a2a83105c2f43fc96a35ad7fa3
    - name: meshcore
      path: modules/lib/meshcore
      repo-path: sdk-meshcore
      revision: b14b2ca5d7d15c3aa1770400b7b66fa4d28fd5e3
    - name: u8g2
      path: modules/lib/u8g2
      repo-path: sdk-u8g2
      revision: c0a719566c1f3a8284c15d2603d70ca6d3f17573
    - name: zui
      path: modules/lib/zui
      repo-path: sdk-zui
      revision: 68794bd65b8d1dde5583a30b2b22d601faff794e
      west-commands: scripts/west-commands.yml
    - name: arduboy
      path: modules/lib/arduboy
      repo-path: sdk-arduboy
      revision: 016162db40cdf64f58a229a7a75f176bda90b805
    - name: detools
      path: modules/lib/detools
      repo-path: sdk-detools
      revision: fe0f40c323438c4945794780277724397481c6d6
    - name: heatshrink
      path: modules/lib/heatshrink
      repo-path: sdk-heatshrink
      revision: 8c98cde55c7bde2947064ff70eba30ab1c7dda7c

  self:
    path: meshbus
    west-commands: scripts/west-commands.yml
```
