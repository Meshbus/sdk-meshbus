## CMakeLists.txt
```
# Copyright (c) 2026 FoBE Studio
# SPDX-License-Identifier: Apache-2.0

cmake_minimum_required(VERSION 3.20.0)
find_package(Zephyr REQUIRED HINTS $ENV{ZEPHYR_BASE})
project(meshbus_firmware_manifest_test)

target_sources(app PRIVATE
  src/main.c
  ${CMAKE_CURRENT_SOURCE_DIR}/../../../../../../subsys/meshbus/services/firmware/manifest.c
)
target_compile_definitions(app PRIVATE
  CONFIG_MESHBUS_FIRMWARE_ROLE=1
  CONFIG_MESHBUS_FIRMWARE_BOARD_ID="unit_board"
  CONFIG_MESHBUS_FIRMWARE_SOC_ID="nrf54l15"
  CONFIG_MESHBUS_FIRMWARE_HARDWARE_REVISION=1
  CONFIG_MESHBUS_FIRMWARE_IMAGE_KEY_ID=1
  CONFIG_MESHBUS_FIRMWARE_MANIFEST_KEY_ID=1
  CONFIG_MESHBUS_FIRMWARE_SECURITY_COUNTER=1
  CONFIG_MESHBUS_FIRMWARE_MANIFEST_PUBLIC_KEY_HEX="d4b31ba49a3add3f825d10ca7f31b50b0de87f37ccc49f1a403a5c1320ffb4e0"
)
```

## prj.conf
```kconfig
CONFIG_ZTEST=y
CONFIG_ASSERT=y
CONFIG_PSA_CRYPTO=y
CONFIG_PSA_WANT_ALG_SHA_256=y
CONFIG_MAIN_STACK_SIZE=4096
CONFIG_ZTEST_STACK_SIZE=4096
```

## src/main.c
```c
/*
 * Copyright (c) 2026 FoBE Studio
 * SPDX-License-Identifier: Apache-2.0
 */

#include <errno.h>
#include <string.h>

#include <zephyr/meshbus/firmware.h>
#include <zephyr/sys/util.h>
#include <zephyr/ztest.h>

static bool signature_valid = true;

int crypto_ed25519_check(const uint8_t signature[64],
			 const uint8_t public_key[32],
			 const uint8_t *message, size_t message_size)
{
	zassert_not_null(signature);
	zassert_not_null(public_key);
	zassert_not_null(message);
	zassert_true(message_size > 0U);
	return signature_valid ? 0 : -1;
}

extern int meshbus_firmware_manifest_admit(
	const uint8_t *encoded, size_t encoded_size,
	const uint8_t signature[MESHBUS_FIRMWARE_SIGNATURE_SIZE],
	struct meshbus_firmware_manifest *manifest,
	uint8_t transfer_id[MESHBUS_FIRMWARE_TRANSFER_ID_SIZE],
	enum meshbus_firmware_result *result);

static const uint8_t valid_manifest[] = {
	0xb4, 0x01, 0x01, 0x02, 0x50, 0x00, 0x01, 0x02, 0x03, 0x04, 0x05, 0x06,
	0x07, 0x08, 0x09, 0x0a, 0x0b, 0x0c, 0x0d, 0x0e, 0x0f, 0x03, 0x01, 0x04,
	0x6a, 0x75, 0x6e, 0x69, 0x74, 0x5f, 0x62, 0x6f, 0x61, 0x72, 0x64, 0x05,
	0x68, 0x6e, 0x72, 0x66, 0x35, 0x34, 0x6c, 0x31, 0x35, 0x06, 0x01, 0x07,
	0x01, 0x08, 0x01, 0x09, 0x84, 0x01, 0x02, 0x03, 0x00, 0x0a, 0x84, 0x01,
	0x02, 0x04, 0x00, 0x0b, 0x58, 0x20, 0x00, 0x01, 0x02, 0x03, 0x04, 0x05,
	0x06, 0x07, 0x08, 0x09, 0x0a, 0x0b, 0x0c, 0x0d, 0x0e, 0x0f, 0x10, 0x11,
	0x12, 0x13, 0x14, 0x15, 0x16, 0x17, 0x18, 0x19, 0x1a, 0x1b, 0x1c, 0x1d,
	0x1e, 0x1f, 0x0c, 0x58, 0x20, 0x20, 0x21, 0x22, 0x23, 0x24, 0x25, 0x26,
	0x27, 0x28, 0x29, 0x2a, 0x2b, 0x2c, 0x2d, 0x2e, 0x2f, 0x30, 0x31, 0x32,
	0x33, 0x34, 0x35, 0x36, 0x37, 0x38, 0x39, 0x3a, 0x3b, 0x3c, 0x3d, 0x3e,
	0x3f, 0x0d, 0x58, 0x20, 0x40, 0x41, 0x42, 0x43, 0x44, 0x45, 0x46, 0x47,
	0x48, 0x49, 0x4a, 0x4b, 0x4c, 0x4d, 0x4e, 0x4f, 0x50, 0x51, 0x52, 0x53,
	0x54, 0x55, 0x56, 0x57, 0x58, 0x59, 0x5a, 0x5b, 0x5c, 0x5d, 0x5e, 0x5f,
	0x0e, 0x19, 0x03, 0xe8, 0x0f, 0x19, 0x01, 0xc0, 0x10, 0x01, 0x11, 0x01,
	0x12, 0x01, 0x13, 0xf4, 0x14, 0x01,
};

static const uint8_t expected_transfer_id[32] = {
	0x6b, 0xa2, 0xab, 0x6c, 0x1a, 0xe4, 0xbb, 0x7b,
	0xb8, 0x07, 0xaf, 0xc5, 0xf3, 0x62, 0x48, 0x33,
	0x5e, 0xee, 0x1e, 0xd3, 0x79, 0xea, 0x35, 0x96,
	0x7b, 0xf8, 0x3b, 0xf6, 0xec, 0x95, 0xab, 0xa6,
};

static int admit(const uint8_t *encoded, size_t size,
		 enum meshbus_firmware_result *result)
{
	uint8_t signature[64] = {0};
	uint8_t transfer_id[32];
	struct meshbus_firmware_manifest manifest;
	int rc = meshbus_firmware_manifest_admit(encoded, size, signature,
					      &manifest, transfer_id, result);

	if (rc == 0) {
		zassert_mem_equal(transfer_id, expected_transfer_id,
				  sizeof(transfer_id));
		zassert_equal(manifest.patch_size, 1000U);
		zassert_equal(manifest.chunk_size, 448U);
	}
	return rc;
}

ZTEST(firmware_manifest, test_accepts_canonical_role_bound_manifest)
{
	enum meshbus_firmware_result result;

	signature_valid = true;
	zassert_ok(admit(valid_manifest, sizeof(valid_manifest), &result));
	zassert_equal(result, MESHBUS_FIRMWARE_RESULT_OK);
}

ZTEST(firmware_manifest, test_rejects_bad_signature)
{
	enum meshbus_firmware_result result;

	signature_valid = false;
	zassert_equal(admit(valid_manifest, sizeof(valid_manifest), &result),
		      -EKEYREJECTED);
	zassert_equal(result, MESHBUS_FIRMWARE_RESULT_BAD_SIGNATURE);
}

ZTEST(firmware_manifest, test_rejects_noncanonical_integer)
{
	uint8_t encoded[sizeof(valid_manifest) + 1U];
	enum meshbus_firmware_result result;

	/* Replace canonical key 1 (0x01) with non-minimal 0x18 0x01. */
	encoded[0] = valid_manifest[0];
	encoded[1] = 0x18;
	encoded[2] = 0x01;
	memcpy(&encoded[3], &valid_manifest[2], sizeof(valid_manifest) - 2U);
	signature_valid = true;
	zassert_equal(admit(encoded, sizeof(encoded), &result), -EINVAL);
	zassert_equal(result, MESHBUS_FIRMWARE_RESULT_INVALID);
}

ZTEST(firmware_manifest, test_rejects_wrong_role_after_signature)
{
	uint8_t encoded[sizeof(valid_manifest)];
	enum meshbus_firmware_result result;

	memcpy(encoded, valid_manifest, sizeof(encoded));
	encoded[22] = 3U;
	signature_valid = true;
	zassert_equal(admit(encoded, sizeof(encoded), &result), -EXDEV);
	zassert_equal(result, MESHBUS_FIRMWARE_RESULT_WRONG_TARGET);
}

ZTEST_SUITE(firmware_manifest, NULL, NULL, NULL, NULL, NULL);
```
