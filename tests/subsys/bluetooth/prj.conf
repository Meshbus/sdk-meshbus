## CMakeLists.txt
```
# SPDX-FileCopyrightText: FoBE Studio
# SPDX-License-Identifier: Apache-2.0

cmake_minimum_required(VERSION 3.20.0)

list(APPEND DTS_ROOT ${CMAKE_CURRENT_SOURCE_DIR})

find_package(Zephyr REQUIRED HINTS $ENV{ZEPHYR_BASE})
project(mbs_bluetooth_contract_test)

target_sources(app PRIVATE
  src/fake_bt_hci.c
  src/test_api.c
)

target_include_directories(app PRIVATE
  ${ZEPHYR_MESHBUS_MODULE_DIR}/subsys/bluetooth
  ${ZEPHYR_MESHBUS_MODULE_DIR}/subsys/meshcore
)

target_link_libraries(zephyr_interface INTERFACE
  "-Wl,--wrap=bt_is_ready"
  "-Wl,--wrap=bt_enable"
  "-Wl,--wrap=bt_conn_auth_cb_register"
  "-Wl,--wrap=bt_conn_auth_info_cb_register"
  "-Wl,--wrap=bt_le_adv_start"
  "-Wl,--wrap=bt_le_adv_update_data"
  "-Wl,--wrap=bt_le_adv_stop"
  "-Wl,--wrap=bt_set_name"
  "-Wl,--wrap=bt_get_name"
  "-Wl,--wrap=settings_load_subtree"
  "-Wl,--wrap=bt_conn_ref"
  "-Wl,--wrap=bt_conn_unref"
  "-Wl,--wrap=bt_conn_get_dst"
  "-Wl,--wrap=bt_conn_set_security"
  "-Wl,--wrap=bt_conn_get_security"
  "-Wl,--wrap=bt_conn_disconnect"
  "-Wl,--wrap=bt_unpair"
  "-Wl,--wrap=bt_conn_foreach"
  "-Wl,--wrap=bt_conn_get_info"
  "-Wl,--wrap=bt_gatt_get_mtu"
  "-Wl,--wrap=bt_gatt_is_subscribed"
  "-Wl,--wrap=bt_gatt_notify_cb"
  "-Wl,--wrap=bt_nus_inst_send"
  "-Wl,--wrap=meshcore_companion_adapter_disconnected"
)
```

## prj.conf
```kconfig
# SPDX-FileCopyrightText: FoBE Studio
# SPDX-License-Identifier: Apache-2.0

CONFIG_ZTEST=y
CONFIG_ASSERT=y
CONFIG_LOG=y

CONFIG_BT=y
CONFIG_BT_PERIPHERAL=y
CONFIG_BT_H4=n
CONFIG_BT_LL_SW_SPLIT=n
CONFIG_BT_DEVICE_NAME="MeshCore-Test"
CONFIG_BT_DEVICE_NAME_MAX=24
CONFIG_BT_MAX_CONN=1
CONFIG_BT_L2CAP_TX_MTU=247

CONFIG_MBS=y
CONFIG_MBS_SHELL=n
CONFIG_MBS_STATS=y
CONFIG_MBS_NOTIFY=y
CONFIG_MBS_NOTIFY_SHELL=n
CONFIG_MBS_MESHCORE=y
CONFIG_MBS_CONTACT=y
CONFIG_MBS_MESHCORE_SHELL=n
CONFIG_MBS_CHANNEL=y
CONFIG_MBS_CHANNEL_SHELL=n
CONFIG_MBS_MESSAGE=y
CONFIG_MBS_MESSAGE_SHELL=n
CONFIG_MBS_MESSAGE_MAX_STORE_COUNT=5
CONFIG_MBS_BLUETOOTH=y
CONFIG_MBS_BLUETOOTH_SHELL=n
CONFIG_MBS_BLUETOOTH_STATS=y
CONFIG_MBS_BLUETOOTH_DEFAULT_ENABLED=n

CONFIG_MBS_MESHCORE=y
CONFIG_MBS_MESHCORE_RUNTIME=n
CONFIG_MBS_MESHCORE_COMPANION_BLUETOOTH=y

# Keep the Companion command dispatch complete for Bluetooth/NUS transport
# coverage so Twister's warning-as-error build remains valid.
CONFIG_MCUMGR=y
CONFIG_MBS_MANAGEMENT=y
CONFIG_MBS_MANAGEMENT_ENDPOINT=n
CONFIG_MBS_MANAGEMENT_OPERATOR=y

CONFIG_ZBUS_RUNTIME_OBSERVERS=y
CONFIG_ZCBOR=y
CONFIG_SETTINGS_NONE=y

CONFIG_MAIN_STACK_SIZE=4096
CONFIG_SYSTEM_WORKQUEUE_STACK_SIZE=4096
CONFIG_ZTEST_STACK_SIZE=4096
```

## boards/qemu_x86.overlay
```dts
/* SPDX-FileCopyrightText: FoBE Studio */
/* SPDX-License-Identifier: Apache-2.0 */

/ {
	chosen {
		zephyr,bt-hci = &bt_hci_test;
	};

	bt_hci_test: bt_hci_test {
		compatible = "zephyr,bt-hci-test";
		status = "okay";
	};
};
```

## dts/bindings/zephyr,bt-hci-test.yaml
```yaml
description: Bluetooth HCI test device

compatible: "zephyr,bt-hci-test"

include: bt-hci.yaml

properties:
  bt-hci-name:
    default: "test"
  bt-hci-bus:
    default: "virtual"
  bt-hci-quirks:
    default: ["no-reset"]
```

## src/fake_bt_hci.c
```c
/* SPDX-License-Identifier: Apache-2.0 */
/*
 * Copyright (c) 2026 FoBE Studio
 */

#define DT_DRV_COMPAT zephyr_bt_hci_test

#include <errno.h>

#include <zephyr/bluetooth/hci_types.h>
#include <zephyr/device.h>
#include <zephyr/drivers/bluetooth.h>
#include <zephyr/net_buf.h>

struct fake_bt_hci_data {
	struct bt_hci_driver_data common;
};

static int fake_bt_hci_open(const struct device *dev)
{
	ARG_UNUSED(dev);
	return 0;
}

static int fake_bt_hci_send(const struct device *dev, struct net_buf *buf)
{
	ARG_UNUSED(dev);
	net_buf_unref(buf);
	return -ENOTSUP;
}

static DEVICE_API(bt_hci, fake_bt_hci_api) = {
	.open = fake_bt_hci_open,
	.close = NULL,
	.send = fake_bt_hci_send,
};

#define FAKE_BT_HCI_DEFINE(inst)                                                                  \
	static struct fake_bt_hci_data fake_bt_hci_data_##inst;                                   \
	DEVICE_DT_INST_DEFINE(inst, NULL, NULL, &fake_bt_hci_data_##inst, NULL, POST_KERNEL,      \
			      CONFIG_KERNEL_INIT_PRIORITY_DEVICE, &fake_bt_hci_api)

DT_INST_FOREACH_STATUS_OKAY(FAKE_BT_HCI_DEFINE)
```
