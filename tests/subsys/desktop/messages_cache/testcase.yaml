## tests/subsys/desktop/messages_cache/testcase.yaml
```yaml
tests:
  subsys.meshbus.desktop.integration.messages_cache:
    tags:
      - meshbus
      - desktop
      - integration
    harness: ztest
    platform_allow:
      - qemu_x86
    integration_platforms:
      - qemu_x86
```

## tests/subsys/dfu/flash_delta/testcase.yaml
```yaml
tests:
  subsys.dfu.flash_delta:
    tags:
      - dfu
      - flash_delta
      - ztest
    harness: ztest
    platform_allow:
      - qemu_x86
    integration_platforms:
      - qemu_x86
```

## tests/subsys/display/dump/testcase.yaml
```yaml
tests:
  subsys.meshbus.display.dump.integration:
    tags: [meshbus, display, integration, ztest]
    harness: ztest
    platform_allow: [qemu_x86]
    integration_platforms: [qemu_x86]
```

## tests/subsys/display/testcase.yaml
```yaml
tests:
  subsys.meshbus.display.contract:
    tags:
      - meshbus
      - display
      - contract
      - ztest
    harness: ztest
    platform_allow:
      - qemu_x86
    integration_platforms:
      - qemu_x86
```

## tests/subsys/firmware/testcase.yaml
```yaml
tests:
  subsys.meshbus.firmware.contract:
    tags:
      - meshbus
      - firmware
      - contract
    harness: ztest
    platform_allow:
      - qemu_x86
    integration_platforms:
      - qemu_x86
```

## tests/subsys/fs/service_dut/testcase.yaml
```yaml
tests:
  subsys.meshbus.fs.service_dut.mesh_probe_r2:
    tags:
      - meshbus
      - fs
      - littlefs
      - service_dut
    harness: ztest
    harness_config:
      fixture:
        - mesh_probe_r2
        - test-filesystem
    expect_reboot: true
    timeout: 30
    platform_allow:
      - mesh_probe_r2/nrf54l15/cpuapp
    integration_platforms:
      - mesh_probe_r2/nrf54l15/cpuapp
```

## tests/subsys/gnss/heading/testcase.yaml
```yaml
# Copyright (c) 2026 FoBE Studio
# SPDX-License-Identifier: Apache-2.0

tests:
  subsys.meshbus.gnss.heading.composite_contract:
    tags:
      - meshbus
      - compass
      - contract
      - ztest
    extra_configs:
      - CONFIG_COMPASS_COMPOSITE=y
    harness: ztest
    platform_allow:
      - qemu_x86
    integration_platforms:
      - qemu_x86
  subsys.meshbus.gnss.heading.direct_provider_contract:
    tags:
      - meshbus
      - compass
      - contract
      - ztest
    extra_configs:
      - CONFIG_COMPASS_COMPOSITE=n
      - CONFIG_GNSS_EMUL=n
    extra_args:
      - DTC_OVERLAY_FILE=boards/qemu_x86_direct.overlay
    harness: ztest
    platform_allow:
      - qemu_x86
    integration_platforms:
      - qemu_x86
```

## tests/subsys/indicator/audio/testcase.yaml
```yaml
# SPDX-License-Identifier: Apache-2.0
tests:
  subsys.meshbus.indicator.audio:
    tags: [meshbus, indicator, contract, ztest]
    harness: ztest
    platform_allow: [qemu_x86]
    integration_platforms: [qemu_x86]
    timeout: 45
```

## tests/subsys/indicator/feedback/testcase.yaml
```yaml
# SPDX-FileCopyrightText: 2026 FoBE Studio
# SPDX-License-Identifier: Apache-2.0
tests:
  subsys.meshbus.indicator.feedback:
    tags: [meshbus, indicator, contract, ztest]
    harness: ztest
    platform_allow: [qemu_x86]
    integration_platforms: [qemu_x86]
    timeout: 45
```

## tests/subsys/indicator/playback/testcase.yaml
```yaml
tests:
  subsys.meshbus.indicator.playback:
    tags: [meshbus, indicator, contract, ztest]
    harness: ztest
    platform_allow: [qemu_x86]
    integration_platforms: [qemu_x86]
```

## tests/subsys/indicator/testcase.yaml
```yaml
tests:
  subsys.meshbus.indicator.contract:
    tags:
      - meshbus
      - indicator
      - contract
      - ztest
    harness: ztest
    platform_allow:
      - qemu_x86
    integration_platforms:
      - qemu_x86
  subsys.meshbus.indicator.minimal:
    tags: [meshbus, indicator, contract, ztest]
    harness: ztest
    platform_allow: [qemu_x86]
    integration_platforms: [qemu_x86]
    extra_args:
      - CONF_FILE=minimal.conf
      - INDICATOR_MINIMAL_TEST=ON
```

## tests/subsys/input/testcase.yaml
```yaml
tests:
  subsys.meshbus.input.contract:
    tags:
      - meshbus
      - input
      - contract
      - ztest
    harness: ztest
    platform_allow:
      - qemu_x86
    integration_platforms:
      - qemu_x86
```

## tests/subsys/llext/service_dut/testcase.yaml
```yaml
tests:
  subsys.meshbus.llext.service_dut.mesh_probe_r2.app:
    tags:
      - meshbus
      - llext
      - littlefs
      - service_dut
    harness: ztest
    harness_config:
      fixture:
        - mesh_probe_r2
        - test-filesystem
    extra_configs:
      - CONFIG_DISPLAY=y
      - CONFIG_U8G2=y
      - CONFIG_ZUI=y
      - CONFIG_MBS_LLEXT_APP_HEAP_RESERVE_SIZE=32768
      - CONFIG_MBS_LLEXT_APP_MAX_HEAP_SIZE=32768
    timeout: 30
    platform_allow:
      - mesh_probe_r2/nrf54l15/cpuapp
    integration_platforms:
      - mesh_probe_r2/nrf54l15/cpuapp
```

## tests/subsys/llext/testcase.yaml
```yaml
tests:
  subsys.meshbus.llext.contract.app:
    tags:
      - meshbus
      - llext
      - contract
      - compatibility
    harness: ztest
    extra_configs:
      - CONFIG_DISPLAY=y
      - CONFIG_U8G2=y
      - CONFIG_ZUI=y
      - CONFIG_MBS_LLEXT_APP_HEAP_RESERVE_SIZE=32768
      - CONFIG_MBS_LLEXT_APP_MAX_HEAP_SIZE=65536
    platform_allow:
      - qemu_x86
    integration_platforms:
      - qemu_x86
  subsys.meshbus.llext.contract.app_shuffled:
    tags:
      - meshbus
      - llext
      - contract
      - shuffle
    harness: ztest
    extra_configs:
      - CONFIG_DISPLAY=y
      - CONFIG_U8G2=y
      - CONFIG_ZUI=y
      - CONFIG_MBS_LLEXT_APP_HEAP_RESERVE_SIZE=32768
      - CONFIG_MBS_LLEXT_APP_MAX_HEAP_SIZE=65536
      - CONFIG_ZTEST_SHUFFLE=y
      - CONFIG_TIMER_RANDOM_INITIAL_STATE=324508639
    platform_allow:
      - qemu_x86
    integration_platforms:
      - qemu_x86
  subsys.meshbus.llext.contract.app_added_heap:
    tags:
      - meshbus
      - llext
      - contract
      - heap
    harness: ztest
    extra_configs:
      - CONFIG_DISPLAY=y
      - CONFIG_U8G2=y
      - CONFIG_ZUI=y
      - CONFIG_MBS_LLEXT_APP_HEAP_RESERVE_SIZE=32768
      - CONFIG_MBS_LLEXT_APP_MAX_HEAP_SIZE=65536
      - CONFIG_HEAP_MEM_POOL_SIZE=0
      - CONFIG_MBS_LLEXT_TEST_ADD_SYSTEM_HEAP=y
    platform_allow:
      - qemu_x86
    integration_platforms:
      - qemu_x86
```

## tests/subsys/management/service_dut/testcase.yaml
```yaml
tests:
  subsys.meshbus.management.service_dut.mesh_probe_r2.settings_contention:
    tags:
      - meshbus
      - management
      - meshcore
      - contact
      - zms
      - concurrency
      - service_dut
    harness: ztest
    harness_config:
      fixture:
        - mesh_probe_r2
        - radio
        - test-storage
    expect_reboot: true
    timeout: 30
    platform_allow:
      - mesh_probe_r2/nrf54l15/cpuapp
    integration_platforms:
      - mesh_probe_r2/nrf54l15/cpuapp
```

## tests/subsys/meshbus/performance/settings/testcase.yaml
```yaml
tests:
  subsys.meshbus.performance.settings.zms_blob.cached:
    tags:
      - meshbus
      - settings
      - zms
      - performance
    harness: ztest
    platform_allow:
      - qemu_x86
    integration_platforms:
      - qemu_x86
    extra_conf_files:
      - cached.conf
  subsys.meshbus.performance.settings.zms_blob.release_uncached:
    tags:
      - meshbus
      - settings
      - zms
      - performance
    harness: ztest
    platform_allow:
      - qemu_x86
    integration_platforms:
      - qemu_x86
    extra_conf_files:
      - release-uncached.conf
  subsys.meshbus.performance.settings.zms_blob.cached.c2_build:
    tags:
      - meshbus
      - settings
      - zms
      - performance
      - build_only
    build_only: true
    platform_allow:
      - idea_mesh_tracker_c2/nrf54l15/cpuapp
    integration_platforms:
      - idea_mesh_tracker_c2/nrf54l15/cpuapp
    extra_conf_files:
      - cached.conf
  subsys.meshbus.performance.settings.zms_blob.release_uncached.c2_build:
    tags:
      - meshbus
      - settings
      - zms
      - performance
      - build_only
    build_only: true
    platform_allow:
      - idea_mesh_tracker_c2/nrf54l15/cpuapp
    integration_platforms:
      - idea_mesh_tracker_c2/nrf54l15/cpuapp
    extra_conf_files:
      - release-uncached.conf
```

## tests/subsys/meshbus/services/channel/testcase.yaml
```yaml
tests:
  subsys.meshbus.channel.contract:
    tags:
      - meshbus
      - channel
      - contract
      - ztest
    harness: ztest
    platform_allow:
      - qemu_x86
    integration_platforms:
      - qemu_x86
```

## tests/subsys/meshbus/services/clock/testcase.yaml
```yaml
tests:
  subsys.meshbus.clock.contract:
    tags:
      - meshbus
      - clock
      - contract
      - ztest
    harness: ztest
    platform_allow:
      - qemu_x86
    integration_platforms:
      - qemu_x86
```

## tests/subsys/meshbus/services/firmware/manifest/testcase.yaml
```yaml
tests:
  subsys.meshbus.firmware.manifest:
    tags:
      - meshbus
      - firmware
      - security
      - ztest
    harness: ztest
    platform_allow:
      - qemu_x86
    integration_platforms:
      - qemu_x86
```

## tests/subsys/meshbus/services/fs/service_dut/testcase.yaml
```yaml
tests:
  subsys.meshbus.fs.service_dut.c2:
    tags:
      - meshbus
      - fs
      - littlefs
      - service_dut
    harness: ztest
    harness_config:
      fixture:
        - c2
        - test-filesystem
    expect_reboot: true
    timeout: 30
    platform_allow:
      - idea_mesh_tracker_c2/nrf54l15/cpuapp
    integration_platforms:
      - idea_mesh_tracker_c2/nrf54l15/cpuapp
```

## tests/subsys/meshbus/services/fs/testcase.yaml
```yaml
tests:
  subsys.meshbus.fs.contract:
    tags:
      - meshbus
      - fs
      - contract
      - ztest
    harness: ztest
    platform_allow:
      - qemu_x86
    integration_platforms:
      - qemu_x86
```

## tests/subsys/meshbus/services/indicator/testcase.yaml
```yaml
tests:
  subsys.meshbus.indicator.contract:
    tags:
      - meshbus
      - indicator
      - contract
      - ztest
    harness: ztest
    platform_allow:
      - qemu_x86
    integration_platforms:
      - qemu_x86
```

## tests/subsys/meshbus/services/llext/service_dut/testcase.yaml
```yaml
tests:
  subsys.meshbus.llext.service_dut.c2.boot_services:
    tags:
      - meshbus
      - llext
      - littlefs
      - service_dut
    harness: ztest
    harness_config:
      fixture:
        - c2
        - test-filesystem
    extra_configs:
      - CONFIG_MESHBUS_LLEXT_BOOT_SERVICES=y
      - CONFIG_MESHBUS_LLEXT_MAX_SERVICES=2
      - CONFIG_MESHBUS_LLEXT_DEFAULT_BOOT_DELAY=3000
    timeout: 30
    platform_allow:
      - idea_mesh_tracker_c2/nrf54l15/cpuapp
    integration_platforms:
      - idea_mesh_tracker_c2/nrf54l15/cpuapp
  subsys.meshbus.llext.service_dut.c2.app:
    tags:
      - meshbus
      - llext
      - littlefs
      - service_dut
    harness: ztest
    harness_config:
      fixture:
        - c2
        - test-filesystem
    extra_configs:
      - CONFIG_DISPLAY=y
      - CONFIG_U8G2=y
      - CONFIG_ZUI=y
      - CONFIG_MESHBUS_LLEXT_APP_SERVICES=y
      - CONFIG_MESHBUS_LLEXT_APP_HEAP_RESERVE_SIZE=32768
      - CONFIG_MESHBUS_LLEXT_APP_MAX_HEAP_SIZE=32768
    timeout: 30
    platform_allow:
      - idea_mesh_tracker_c2/nrf54l15/cpuapp
    integration_platforms:
      - idea_mesh_tracker_c2/nrf54l15/cpuapp
```

## tests/subsys/meshbus/services/llext/testcase.yaml
```yaml
tests:
  subsys.meshbus.llext.contract.boot_services:
    tags:
      - meshbus
      - llext
      - contract
    harness: ztest
    extra_configs:
      - CONFIG_MESHBUS_LLEXT_BOOT_SERVICES=y
      - CONFIG_MESHBUS_LLEXT_MAX_SERVICES=4
      - CONFIG_SENSOR=y
      - CONFIG_MESHBUS_TELEMETRY=y
      - CONFIG_MESHBUS_TELEMETRY_DEFAULT_ENABLED=n
      - CONFIG_MESHBUS_TELEMETRY_SHELL=n
      - CONFIG_MESHBUS_TELEMETRY_STATS=n
      - CONFIG_MESHBUS_NOTIFY=y
      - CONFIG_MESHBUS_NOTIFY_SHELL=n
    platform_allow:
      - qemu_x86
    integration_platforms:
      - qemu_x86
  subsys.meshbus.llext.contract.app_services:
    tags:
      - meshbus
      - llext
      - contract
    harness: ztest
    extra_configs:
      - CONFIG_DISPLAY=y
      - CONFIG_U8G2=y
      - CONFIG_ZUI=y
      - CONFIG_MESHBUS_LLEXT_APP_SERVICES=y
      - CONFIG_MESHBUS_LLEXT_APP_HEAP_RESERVE_SIZE=32768
      - CONFIG_MESHBUS_LLEXT_APP_MAX_HEAP_SIZE=65536
    platform_allow:
      - qemu_x86
    integration_platforms:
      - qemu_x86
  subsys.meshbus.llext.contract.edk_provenance:
    tags:
      - meshbus
      - llext
      - contract
      - compatibility
    harness: ztest
    extra_configs:
      - CONFIG_DISPLAY=y
      - CONFIG_U8G2=y
      - CONFIG_ZUI=y
      - CONFIG_MESHBUS_LLEXT_APP_SERVICES=y
      - CONFIG_MESHBUS_LLEXT_APP_HEAP_RESERVE_SIZE=32768
      - CONFIG_MESHBUS_LLEXT_APP_MAX_HEAP_SIZE=65536
    platform_allow:
      - qemu_x86
    integration_platforms:
      - qemu_x86
  subsys.meshbus.llext.contract.app_services_shuffled:
    tags:
      - meshbus
      - llext
      - contract
      - shuffle
    harness: ztest
    extra_configs:
      - CONFIG_DISPLAY=y
      - CONFIG_U8G2=y
      - CONFIG_ZUI=y
      - CONFIG_MESHBUS_LLEXT_APP_SERVICES=y
      - CONFIG_MESHBUS_LLEXT_APP_HEAP_RESERVE_SIZE=32768
      - CONFIG_MESHBUS_LLEXT_APP_MAX_HEAP_SIZE=65536
      - CONFIG_ZTEST_SHUFFLE=y
      - CONFIG_TIMER_RANDOM_INITIAL_STATE=324508639
    platform_allow:
      - qemu_x86
    integration_platforms:
      - qemu_x86
  subsys.meshbus.llext.contract.app_services_added_heap:
    tags:
      - meshbus
      - llext
      - contract
      - heap
    harness: ztest
    extra_configs:
      - CONFIG_DISPLAY=y
      - CONFIG_U8G2=y
      - CONFIG_ZUI=y
      - CONFIG_MESHBUS_LLEXT_APP_SERVICES=y
      - CONFIG_MESHBUS_LLEXT_APP_HEAP_RESERVE_SIZE=32768
      - CONFIG_MESHBUS_LLEXT_APP_MAX_HEAP_SIZE=65536
      - CONFIG_HEAP_MEM_POOL_SIZE=0
      - CONFIG_MESHBUS_LLEXT_TEST_ADD_SYSTEM_HEAP=y
    platform_allow:
      - qemu_x86
    integration_platforms:
      - qemu_x86
```

## tests/subsys/meshbus/services/management/testcase.yaml
```yaml
tests:
  subsys.meshbus.management.contract:
    tags:
      - meshbus
      - management
      - mcumgr
      - contract
    harness: ztest
    platform_allow:
      - qemu_x86
    integration_platforms:
      - qemu_x86
  subsys.meshbus.management.contract.max_capacity:
    tags:
      - meshbus
      - management
      - mcumgr
      - contract
    harness: ztest
    platform_allow:
      - qemu_x86
    integration_platforms:
      - qemu_x86
    extra_configs:
      - CONFIG_MESHBUS_MANAGEMENT_MAX_FRAGMENTS=8
```
