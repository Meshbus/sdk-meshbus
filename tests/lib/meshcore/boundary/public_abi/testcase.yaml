## tests/lib/meshcore/boundary/public_abi/testcase.yaml
```yaml
tests:
  lib.meshcore.boundary.public_abi:
    tags:
      - meshcore
      - boundary
      - public_abi
      - ztest
    harness: ztest
    platform_allow:
      - qemu_x86
    integration_platforms:
      - qemu_x86
```

## tests/lib/meshcore/protocol/advert_data/testcase.yaml
```yaml
tests:
  lib.meshcore.advert_data.tdd:
    tags:
      - meshcore
      - advert_data
      - ztest
    harness: ztest
    platform_allow:
      - qemu_x86
    integration_platforms:
      - qemu_x86
```

## tests/lib/meshcore/protocol/api_map/testcase.yaml
```yaml
tests:
  lib.meshcore.protocol.api_map:
    tags:
      - meshcore
      - protocol
      - ztest
    harness: ztest
    platform_allow:
      - qemu_x86
    integration_platforms:
      - qemu_x86
```

## tests/lib/meshcore/protocol/cayenne_lpp_compat/testcase.yaml
```yaml
tests:
  lib.meshcore.cayenne_lpp_compat.tdd:
    tags:
      - meshcore
      - cayenne_lpp_compat
      - ztest
    harness: ztest
    platform_allow:
      - qemu_x86
    integration_platforms:
      - qemu_x86
```

## tests/lib/meshcore/protocol/dispatcher/testcase.yaml
```yaml
tests:
  lib.meshcore.dispatcher.tdd:
    tags:
      - meshcore
      - dispatcher
      - ztest
    harness: ztest
    platform_allow:
      - qemu_x86
    integration_platforms:
      - qemu_x86
```

## tests/lib/meshcore/protocol/dispatcher_mesh/testcase.yaml
```yaml
tests:
  lib.meshcore.dispatcher_mesh.tdd:
    tags:
      - meshcore
      - dispatcher
      - mesh
      - ztest
    harness: ztest
    platform_allow:
      - qemu_x86
    integration_platforms:
      - qemu_x86
```

## tests/lib/meshcore/protocol/identity/testcase.yaml
```yaml
tests:
  lib.meshcore.identity.tdd:
    tags:
      - meshcore
      - identity
      - ztest
    harness: ztest
    platform_allow:
      - qemu_x86
    integration_platforms:
      - qemu_x86
```

## tests/lib/meshcore/protocol/packet/testcase.yaml
```yaml
tests:
  lib.meshcore.packet.tdd:
    tags:
      - meshcore
      - packet
      - ztest
    harness: ztest
    platform_allow:
      - qemu_x86
    integration_platforms:
      - qemu_x86
```

## tests/lib/meshcore/protocol/packet_manager/testcase.yaml
```yaml
tests:
  lib.meshcore.packet_manager.tdd:
    tags:
      - meshcore
      - packet_manager
      - ztest
    harness: ztest
    platform_allow:
      - qemu_x86
    integration_platforms:
      - qemu_x86
```

## tests/lib/meshcore/protocol/tables/testcase.yaml
```yaml
tests:
  lib.meshcore.tables.tdd:
    tags:
      - meshcore
      - tables
      - ztest
    harness: ztest
    platform_allow:
      - qemu_x86
    integration_platforms:
      - qemu_x86
```

## tests/lib/meshcore/protocol/utils/testcase.yaml
```yaml
tests:
  lib.meshcore.utils.tdd:
    tags:
      - meshcore
      - utils
      - ztest
    harness: ztest
    platform_allow:
      - qemu_x86
    integration_platforms:
      - qemu_x86
```

## tests/lib/meshcore/runtime/oracle/testcase.yaml
```yaml
tests:
  lib.meshcore.oracle_parity:
    tags:
      - meshcore
      - oracle
      - parity
      - ztest
    harness: ztest
    platform_allow:
      - qemu_x86
    integration_platforms:
      - qemu_x86
```

## tests/lib/meshcore/runtime/requests/testcase.yaml
```yaml
tests:
  lib.meshcore.runtime.requests:
    tags:
      - meshcore
      - runtime
      - ztest
    harness: ztest
    platform_allow:
      - qemu_x86
    integration_platforms:
      - qemu_x86
```

## tests/lib/meshcore/runtime/topology/testcase.yaml
```yaml
tests:
  lib.meshcore.runtime.topology:
    tags:
      - meshcore
      - runtime
      - topology
      - ztest
    harness: ztest
    platform_allow:
      - qemu_x86
    integration_platforms:
      - qemu_x86
```

## tests/samples/weather_station/testcase.yaml
```yaml
tests:
  sample.weather_station.ble_packets:
    tags: [bluetooth, sensor]
    platform_allow: [qemu_x86]
    integration_platforms: [qemu_x86]
    harness: ztest
```

## tests/subsys/bluetooth/testcase.yaml
```yaml
tests:
  subsys.meshbus.bluetooth.contract:
    tags:
      - meshbus
      - bluetooth
      - contract
      - ztest
    harness: ztest
    platform_allow:
      - qemu_x86
    integration_platforms:
      - qemu_x86
```

## tests/subsys/channel/service_dut/testcase.yaml
```yaml
tests:
  subsys.meshbus.channel.service_dut.mesh_probe_r2:
    tags:
      - meshbus
      - channel
      - zms
      - service_dut
    harness: ztest
    harness_config:
      fixture:
        - mesh_probe_r2
        - test-storage
    expect_reboot: true
    timeout: 30
    platform_allow:
      - mesh_probe_r2/nrf54l15/cpuapp
    integration_platforms:
      - mesh_probe_r2/nrf54l15/cpuapp
```

## tests/subsys/clock/service_dut/testcase.yaml
```yaml
tests:
  subsys.meshbus.clock.service_dut.mesh_probe_r2:
    tags:
      - meshbus
      - clock
      - service_dut
    harness: ztest
    harness_config:
      fixture: mesh_probe_r2
    expect_reboot: true
    timeout: 30
    platform_allow:
      - mesh_probe_r2/nrf54l15/cpuapp
    integration_platforms:
      - mesh_probe_r2/nrf54l15/cpuapp
```

## tests/subsys/clock/testcase.yaml
```yaml
# SPDX-FileCopyrightText: 2026 FoBE Studio
# SPDX-License-Identifier: Apache-2.0
tests:
  subsys.meshbus.clock.contract:
    tags:
      - meshbus
      - clock
      - contract
      - ztest
    harness: ztest
    platform_allow:
      - qemu_x86
      - native_sim
    integration_platforms:
      - native_sim
  subsys.meshbus.clock.timestamps_only:
    tags: [meshbus, clock, contract, ztest]
    harness: ztest
    platform_allow: [qemu_x86, native_sim]
    integration_platforms: [native_sim]
    extra_args: CONF_FILE=basic.conf
  subsys.meshbus.clock.shell:
    tags: [meshbus, clock, shell, integration, ztest]
    harness: ztest
    platform_allow: [qemu_x86, native_sim]
    integration_platforms: [native_sim]
    extra_args: EXTRA_CONF_FILE=shell.conf
```

## tests/subsys/contact/service_dut/testcase.yaml
```yaml
tests:
  subsys.meshbus.contact.service_dut.mesh_probe_r2:
    tags:
      - meshbus
      - contact
      - zms
      - service_dut
    harness: ztest
    harness_config:
      fixture:
        - mesh_probe_r2
        - test-storage
    expect_reboot: true
    timeout: 30
    platform_allow:
      - mesh_probe_r2/nrf54l15/cpuapp
    integration_platforms:
      - mesh_probe_r2/nrf54l15/cpuapp
```

## tests/subsys/contact/testcase.yaml
```yaml
tests:
  subsys.meshbus.contact.contract:
    tags:
      - meshbus
      - contact
      - contract
      - ztest
    harness: ztest
    platform_allow:
      - qemu_x86
    integration_platforms:
      - qemu_x86

  subsys.meshbus.contact.contract.raw_advert_store_disabled:
    tags:
      - meshbus
      - contact
      - contract
      - ztest
    harness: ztest
    platform_allow:
      - qemu_x86
    integration_platforms:
      - qemu_x86
    extra_configs:
      - CONFIG_MBS_CONTACT_ADVERT_RAW_STORE=n
```

## tests/subsys/desktop/boot_logo/testcase.yaml
```yaml
common:
  tags:
    - meshbus
    - desktop
    - integration
  harness: ztest
  platform_allow:
    - qemu_x86
  integration_platforms:
    - qemu_x86
tests:
  subsys.meshbus.desktop.boot_logo.integration:
    extra_args:
      - BOOT_LOGO_DURATION_MS=1000
  subsys.meshbus.desktop.boot_logo.disabled.integration:
    extra_args:
      - BOOT_LOGO_DURATION_MS=0
```

## tests/subsys/desktop/integration/testcase.yaml
```yaml
tests:
  subsys.meshbus.desktop.integration:
    tags:
      - meshbus
      - desktop
      - integration
    harness: ztest
    platform_allow:
      - qemu_x86
    integration_platforms:
      - qemu_x86
  subsys.meshbus.desktop.integration.shuffled:
    tags:
      - meshbus
      - desktop
      - integration
      - shuffle
    harness: ztest
    extra_configs:
      - CONFIG_ZTEST_SHUFFLE=y
      - CONFIG_TIMER_RANDOM_INITIAL_STATE=610839776
    platform_allow:
      - qemu_x86
    integration_platforms:
      - qemu_x86
```

## tests/subsys/desktop/mba_lifecycle/service_dut/testcase.yaml
```yaml
tests:
  subsys.meshbus.desktop.mba_lifecycle.service_dut:
    tags: [meshbus, desktop, llext, service_dut]
    harness: ztest
    harness_config:
      fixture: mbs_mba_devkit_test_storage
    platform_allow: [devkit_nrf54l15/nrf54l15/cpuapp]
  subsys.meshbus.desktop.mba_lifecycle.service_dut.shuffled:
    tags: [meshbus, desktop, llext, service_dut, shuffle]
    harness: ztest
    harness_config:
      fixture: mbs_mba_devkit_test_storage
    extra_configs:
      - CONFIG_ZTEST_SHUFFLE=y
      - CONFIG_TIMER_RANDOM_INITIAL_STATE=826366246
    platform_allow: [devkit_nrf54l15/nrf54l15/cpuapp]
```

## tests/subsys/desktop/mba_lifecycle/testcase.yaml
```yaml
tests:
  subsys.meshbus.desktop.mba_lifecycle.integration:
    tags:
      - meshbus
      - desktop
      - llext
      - integration
    harness: ztest
    platform_allow:
      - qemu_x86
    integration_platforms:
      - qemu_x86
  subsys.meshbus.desktop.mba_lifecycle.integration.shuffled:
    tags:
      - meshbus
      - desktop
      - llext
      - integration
      - shuffle
    harness: ztest
    extra_configs:
      - CONFIG_ZTEST_SHUFFLE=y
      - CONFIG_TIMER_RANDOM_INITIAL_STATE=826366246
    platform_allow:
      - qemu_x86
    integration_platforms:
      - qemu_x86
```
