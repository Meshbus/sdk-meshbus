## CMakeLists.txt
```
cmake_minimum_required(VERSION 3.20.0)

find_package(Zephyr REQUIRED HINTS $ENV{ZEPHYR_BASE})
project(meshcore_mesh_tdd_test)

include(${CMAKE_CURRENT_LIST_DIR}/../../common/reference_meshcore.cmake)

zephyr_include_directories(
  ${MESHCORE_REFERENCE_INCLUDE_DIRS}
  ${MESHCORE_INTERNAL_INCLUDE_DIRS}
  ${MESHCORE_TEST_COMMON_DIR}/include
  ${MESHCORE_TEST_COMMON_DIR}/lib/Crypto
  ${MESHCORE_TEST_COMMON_DIR}/lib/ed25519
)

target_sources(app PRIVATE
  src/main.cpp
  src/test_interop.cpp
  src/test_support.cpp
  src/test_reference_env.cpp
  src/test_target_env.cpp
  ${MESHCORE_TEST_COMMON_DIR}/src/meshcore_hal_zephyr.c
  ${MESHCORE_PLATFORM_BRIDGE_SOURCES}
  ${MESHCORE_PROTOCOL_CLOCK_SOURCES}
  ${MESHCORE_PROTOCOL_RNG_SOURCES}
  ${MESHCORE_PROTOCOL_UTILS_SOURCES}
  ${MESHCORE_PROTOCOL_PACKET_SOURCES}
  ${MESHCORE_PROTOCOL_PACKET_MANAGER_SOURCES}
  ${MESHCORE_PROTOCOL_RADIO_SOURCES}
  ${MESHCORE_SUPPORT_ADVERT_DATA_SOURCES}
  ${MESHCORE_SUPPORT_UTF8_SOURCES}
  ${MESHCORE_PROTOCOL_DISPATCHER_SOURCES}
  ${MESHCORE_PROTOCOL_TABLES_SOURCES}
  ${MESHCORE_PROTOCOL_IDENTITY_SOURCES}
  ${MESHCORE_PROTOCOL_MESH_SOURCES}
  ${MESHCORE_PROTOCOL_CRYPTO_SOURCES}
  ${MESHCORE_REFERENCE_STATIC_POOL_PACKET_MANAGER_SOURCES}
  ${MESHCORE_REFERENCE_DISPATCHER_SOURCES}
  ${MESHCORE_REFERENCE_PACKET_SOURCES}
  ${MESHCORE_REFERENCE_UTILS_SOURCES}
  ${MESHCORE_REFERENCE_IDENTITY_SOURCES}
  ${MESHCORE_REFERENCE_MESH_SOURCES}
  ${MESHCORE_TEST_COMMON_DIR}/lib/Crypto/Crypto.cpp
  ${MESHCORE_TEST_COMMON_DIR}/lib/Crypto/Hash.cpp
  ${MESHCORE_TEST_COMMON_DIR}/lib/Crypto/SHA256.cpp
  ${MESHCORE_TEST_COMMON_DIR}/lib/Crypto/SHA512.cpp
  ${MESHCORE_TEST_COMMON_DIR}/lib/Crypto/BlockCipher.cpp
  ${MESHCORE_TEST_COMMON_DIR}/lib/Crypto/AESCommon.cpp
  ${MESHCORE_TEST_COMMON_DIR}/lib/Crypto/AES128.cpp
  ${MESHCORE_TEST_COMMON_DIR}/lib/Crypto/BigNumberUtil.cpp
  ${MESHCORE_TEST_COMMON_DIR}/lib/Crypto/Curve25519.cpp
  ${MESHCORE_TEST_COMMON_DIR}/lib/Crypto/Ed25519.cpp
  ${MESHCORE_TEST_COMMON_DIR}/lib/ed25519/add_scalar.c
  ${MESHCORE_TEST_COMMON_DIR}/lib/ed25519/fe.c
  ${MESHCORE_TEST_COMMON_DIR}/lib/ed25519/ge.c
  ${MESHCORE_TEST_COMMON_DIR}/lib/ed25519/key_exchange.c
  ${MESHCORE_TEST_COMMON_DIR}/lib/ed25519/keypair.c
  ${MESHCORE_TEST_COMMON_DIR}/lib/ed25519/sc.c
  ${MESHCORE_TEST_COMMON_DIR}/lib/ed25519/seed.c
  ${MESHCORE_TEST_COMMON_DIR}/lib/ed25519/sha512.c
  ${MESHCORE_TEST_COMMON_DIR}/lib/ed25519/sign.c
  ${MESHCORE_TEST_COMMON_DIR}/lib/ed25519/verify.c
)

zephyr_library_compile_options(
  -Wno-unused-parameter
  -Wno-unused-variable
  $<$<COMPILE_LANGUAGE:CXX>:-Wno-sign-compare>
  $<$<COMPILE_LANGUAGE:CXX>:-Wno-reorder>
)
```

## prj.conf
```kconfig
CONFIG_ZTEST=y
CONFIG_ASSERT=y
CONFIG_LOG=y

CONFIG_CPP=y
CONFIG_STD_CPP11=y

CONFIG_PSA_CRYPTO=y
CONFIG_PSA_CRYPTO_PROVIDER_MBEDTLS=y
CONFIG_MBEDTLS_PSA_CRYPTO_C=y
CONFIG_PSA_WANT_ALG_SHA_256=y
CONFIG_PSA_WANT_KEY_TYPE_AES=y
CONFIG_PSA_WANT_ALG_ECB_NO_PADDING=y
CONFIG_PSA_WANT_KEY_TYPE_HMAC=y
CONFIG_PSA_WANT_ALG_HMAC=y
CONFIG_ENTROPY_GENERATOR=y

CONFIG_MAIN_STACK_SIZE=6144
CONFIG_SYSTEM_WORKQUEUE_STACK_SIZE=4096
CONFIG_ZTEST_STACK_SIZE=6144
CONFIG_HEAP_MEM_POOL_SIZE=16384
```

## src/test_packet_bridge.h
```c
// SPDX-License-Identifier: Apache-2.0
/*
 * Copyright (c) 2026 FoBE Studio
 */

#ifndef FOBE_TESTS_LIB_MESHCORE_MODULE_MESH_SRC_PACKET_BRIDGE_H_
#define FOBE_TESTS_LIB_MESHCORE_MODULE_MESH_SRC_PACKET_BRIDGE_H_

#include <zephyr/ztest.h>

extern "C" {
#include "meshcore_clock.h"
#include "meshcore_mesh.h"
#include "meshcore_packet.h"
#include "meshcore_packet_manager.h"
#include "meshcore_rng.h"
#include "meshcore_tables.h"
#include "meshcore_test_runtime.h"
#include "meshcore_utils.h"
#include "meshcore/types.h"
}

#undef PH_ROUTE_MASK
#undef PH_TYPE_SHIFT
#undef PH_TYPE_MASK
#undef PH_VER_SHIFT
#undef PH_VER_MASK
#undef ROUTE_TYPE_TRANSPORT_FLOOD
#undef ROUTE_TYPE_FLOOD
#undef ROUTE_TYPE_DIRECT
#undef ROUTE_TYPE_TRANSPORT_DIRECT
#undef PAYLOAD_TYPE_REQ
#undef PAYLOAD_TYPE_RESPONSE
#undef PAYLOAD_TYPE_TXT_MSG
#undef PAYLOAD_TYPE_ACK
#undef PAYLOAD_TYPE_ADVERT
#undef PAYLOAD_TYPE_GRP_TXT
#undef PAYLOAD_TYPE_GRP_DATA
#undef PAYLOAD_TYPE_ANON_REQ
#undef PAYLOAD_TYPE_PATH
#undef PAYLOAD_TYPE_TRACE
#undef PAYLOAD_TYPE_MULTIPART
#undef PAYLOAD_TYPE_CONTROL
#undef PAYLOAD_TYPE_RAW_CUSTOM
#undef PAYLOAD_VER_1
#undef PAYLOAD_VER_2
#undef PAYLOAD_VER_3
#undef PAYLOAD_VER_4

#include "Mesh.h"
#include "Packet.h"
#include "SimpleMeshTables.h"
#include "StaticPoolPacketManager.h"

#endif /* FOBE_TESTS_LIB_MESHCORE_MODULE_MESH_SRC_PACKET_BRIDGE_H_ */
```

## src/test_reference_env.cpp
```c
// SPDX-License-Identifier: Apache-2.0
/*
 * Copyright (c) 2026 FoBE Studio
 */

#include "test_reference_env.h"

#include <stddef.h>
#include <string.h>

inline void *operator new(size_t, void *ptr) noexcept
{
	return ptr;
}

namespace meshcore_mesh_tdd {

static ReferenceEnv *g_reference_env;
static bool g_reference_env_inited;
alignas(ReferenceEnv) static unsigned char g_reference_env_storage[sizeof(ReferenceEnv)];

unsigned long CommonMillisecondClock::getMillis()
{
	return meshcore_hal_millis_get();
}

void CommonFakeRadio::begin()
{
	meshcore_hal_radio_begin();
}

int CommonFakeRadio::recvRaw(uint8_t *bytes, int sz)
{
	return meshcore_hal_test_radio_recv_raw(bytes, (size_t)sz);
}

uint32_t CommonFakeRadio::getEstAirtimeFor(int len_bytes)
{
	return meshcore_hal_radio_airtime((size_t)len_bytes);
}

float CommonFakeRadio::packetScore(float snr, int packet_len)
{
	return meshcore_hal_radio_packet_score((int8_t)(snr * 4.0f),
					       (size_t)packet_len);
}

bool CommonFakeRadio::startSendRaw(const uint8_t *bytes, int len)
{
	return meshcore_hal_radio_packet_send(bytes, (size_t)len) != 0;
}

bool CommonFakeRadio::isSendComplete()
{
	return meshcore_hal_test_radio_tx_complete_get();
}

void CommonFakeRadio::onSendFinished()
{
	meshcore_hal_test_radio_on_send_finished();
}

void CommonFakeRadio::loop()
{
	meshcore_hal_test_radio_loop();
}

void CommonFakeRadio::triggerNoiseFloorCalibrate(int threshold)
{
	meshcore_hal_radio_noise_floor_calibrate(threshold);
}

void CommonFakeRadio::resetAGC()
{
	meshcore_hal_radio_agc_reset();
}

bool CommonFakeRadio::isInRecvMode() const
{
	return meshcore_hal_radio_in_rx_mode_get();
}

bool CommonFakeRadio::isReceiving()
{
	return meshcore_hal_radio_receiving_get();
}

float CommonFakeRadio::getLastRSSI() const
{
	return meshcore_hal_test_radio_last_rssi_get();
}

float CommonFakeRadio::getLastSNR() const
{
	return meshcore_hal_test_radio_last_snr_get();
}

void CommonRng::random(uint8_t *dest, size_t sz)
{
	meshcore_hal_rng_random(dest, sz);
}

uint32_t CommonRtcClock::getCurrentTime()
{
	return meshcore_hal_rtc_get_current_time();
}

void CommonRtcClock::setCurrentTime(uint32_t time)
{
	meshcore_hal_test_rtc_set_current_time(time);
}

ReferenceHarness::ReferenceHarness(mesh::Radio &radio,
				   mesh::MillisecondClock &clock,
				   mesh::RNG &rng, mesh::RTCClock &rtc,
				   mesh::PacketManager &manager,
				   mesh::MeshTables &tables, MeshScript *script)
	: mesh::Mesh(radio, clock, rng, rtc, manager, tables), script_(script)
{
}

MeshPolicySnapshot ReferenceHarness::capturePolicySnapshot(mesh::Packet *packet,
							   const uint8_t *hash)
{
	MeshPolicySnapshot snapshot = {};
	mesh::GroupChannel channels[4] = {};

	snapshot.filter_recv_flood_packet = filterRecvFloodPacket(packet);
	snapshot.allow_packet_forward = allowPacketForward(packet);
	snapshot.retransmit_delay = getRetransmitDelay(packet);
	snapshot.direct_retransmit_delay = getDirectRetransmitDelay(packet);
	snapshot.extra_ack_transmit_count = getExtraAckTransmitCount();
	snapshot.cad_fail_retry_delay = getCADFailRetryDelay();
	snapshot.search_peers_by_hash = searchPeersByHash(hash);
	snapshot.search_channels_by_hash =
		searchChannelsByHash(hash, channels, 4);
	return snapshot;
}

mesh::DispatcherAction ReferenceHarness::onRecvForTest(mesh::Packet *packet)
{
	return onRecvPacket(packet);
}

mesh::DispatcherAction ReferenceHarness::routeRecvForTest(mesh::Packet *packet)
{
	return routeRecvPacket(packet);
}

bool ReferenceHarness::filterRecvFloodPacket(mesh::Packet *packet)
{
	if (script_->override_filter_recv_flood_packet) {
		return script_->filter_recv_flood_packet_value;
	}
	return mesh::Mesh::filterRecvFloodPacket(packet);
}

bool ReferenceHarness::allowPacketForward(const mesh::Packet *packet)
{
	if (script_->override_allow_packet_forward) {
		return script_->allow_packet_forward_value;
	}
	return mesh::Mesh::allowPacketForward(packet);
}

uint32_t ReferenceHarness::getRetransmitDelay(const mesh::Packet *packet)
{
	if (script_->override_get_retransmit_delay) {
		return script_->get_retransmit_delay_value;
	}
	return mesh::Mesh::getRetransmitDelay(packet);
}

uint32_t ReferenceHarness::getDirectRetransmitDelay(const mesh::Packet *packet)
{
	if (script_->override_get_direct_retransmit_delay) {
		return script_->get_direct_retransmit_delay_value;
	}
	return mesh::Mesh::getDirectRetransmitDelay(packet);
}

uint8_t ReferenceHarness::getExtraAckTransmitCount() const
{
	if (script_->override_get_extra_ack_transmit_count) {
		return script_->get_extra_ack_transmit_count_value;
	}
	return mesh::Mesh::getExtraAckTransmitCount();
}

uint32_t ReferenceHarness::getCADFailRetryDelay() const
{
	if (script_->override_get_cad_fail_retry_delay) {
		return script_->get_cad_fail_retry_delay_value;
	}
	return mesh::Mesh::getCADFailRetryDelay();
}

int ReferenceHarness::searchPeersByHash(const uint8_t *hash)
{
	if (script_->override_search_peers_by_hash) {
		(void)hash;
		return script_->search_peers_by_hash_value;
	}
	return mesh::Mesh::searchPeersByHash(hash);
}

void ReferenceHarness::getPeerSharedSecret(uint8_t *dest_secret, int peer_idx)
{
	(void)peer_idx;
	if (script_->override_get_peer_shared_secret) {
		memcpy(dest_secret, script_->peer_shared_secret,
		       sizeof(script_->peer_shared_secret));
		return;
	}
	mesh::Mesh::getPeerSharedSecret(dest_secret, peer_idx);
}

void ReferenceHarness::onPeerDataRecv(mesh::Packet *packet, uint8_t type,
				      int sender_idx, const uint8_t *secret,
				      uint8_t *data, size_t len)
{
	(void)packet;
	(void)sender_idx;
	(void)secret;
	(void)data;
	script_->on_peer_data_recv_count++;
	script_->last_peer_data_type = type;
	script_->last_peer_data_len = (uint16_t)len;
}

void ReferenceHarness::onTraceRecv(mesh::Packet *packet, uint32_t tag,
				   uint32_t auth_code, uint8_t flags,
				   const uint8_t *path_snrs,
				   const uint8_t *path_hashes, uint8_t path_len)
{
	(void)packet;
	(void)path_snrs;
	(void)path_hashes;
	(void)path_len;
	script_->on_trace_recv_count++;
	script_->last_trace_tag = tag;
	script_->last_trace_auth_code = auth_code;
	script_->last_trace_flags = flags;
}

bool ReferenceHarness::onPeerPathRecv(mesh::Packet *packet, int sender_idx,
				      const uint8_t *secret, uint8_t *path,
				      uint8_t path_len, uint8_t extra_type,
				      uint8_t *extra, uint8_t extra_len)
{
	(void)packet;
	(void)sender_idx;
	(void)secret;
	(void)path;
	(void)extra;
	script_->on_peer_path_recv_count++;
	script_->last_peer_path_len = path_len;
	script_->last_peer_path_extra_type = extra_type;
	script_->last_peer_path_extra_len = extra_len;
	if (script_->override_on_peer_path_recv) {
		return script_->on_peer_path_recv_value;
	}
	return mesh::Mesh::onPeerPathRecv(packet, sender_idx, secret, path, path_len,
					  extra_type, extra, extra_len);
}

void ReferenceHarness::onAdvertRecv(mesh::Packet *packet, const mesh::Identity &id,
				    uint32_t timestamp, const uint8_t *app_data,
				    size_t app_data_len)
{
	(void)packet;
	(void)id;
	(void)timestamp;
	(void)app_data;
	(void)app_data_len;
	script_->on_advert_recv_count++;
}

void ReferenceHarness::onAnonDataRecv(mesh::Packet *packet, const uint8_t *secret,
				      const mesh::Identity &sender, uint8_t *data,
				      size_t len)
{
	(void)packet;
	(void)secret;
	(void)sender;
	(void)data;
	script_->on_anon_data_recv_count++;
	script_->last_anon_data_len = (uint16_t)len;
}

void ReferenceHarness::onControlDataRecv(mesh::Packet *packet)
{
	(void)packet;
	script_->on_control_data_recv_count++;
}

void ReferenceHarness::onRawDataRecv(mesh::Packet *packet)
{
	(void)packet;
	script_->on_raw_data_recv_count++;
}

int ReferenceHarness::searchChannelsByHash(const uint8_t *hash,
					   mesh::GroupChannel channels[],
					   int max_matches)
{
	if (script_->override_search_channels_by_hash) {
		(void)hash;
		if (script_->override_search_channels_fill && max_matches > 0) {
			memcpy(channels[0].hash, script_->search_channel_hash,
			       sizeof(channels[0].hash));
			memcpy(channels[0].secret, script_->search_channel_secret,
			       sizeof(channels[0].secret));
		}
		return script_->search_channels_by_hash_value;
	}
	return mesh::Mesh::searchChannelsByHash(hash, channels, max_matches);
}

void ReferenceHarness::onGroupDataRecv(mesh::Packet *packet, uint8_t type,
				       const mesh::GroupChannel &channel,
				       uint8_t *data, size_t len)
{
	(void)packet;
	(void)channel;
	(void)data;
	script_->on_group_data_recv_count++;
	script_->last_group_data_type = type;
	script_->last_group_data_len = (uint16_t)len;
}

void ReferenceHarness::onAckRecv(mesh::Packet *packet, uint32_t ack_crc)
{
	(void)packet;
	script_->on_ack_recv_count++;
	script_->last_ack_crc = ack_crc;
}

ReferenceEnv::ReferenceEnv()
	: script(default_script()),
	  manager(kPoolSize),
	  mesh(radio, clock, rng, rtc, manager, tables, &script)
{
}

static void reference_env_settle_and_drain(ReferenceEnv &env)
{
	env.script = default_script();

	meshcore_hal_test_radio_set_send_result(true);
	meshcore_hal_test_radio_set_send_never_complete(false);
	meshcore_hal_test_radio_force_in_rx_mode(false, false);
	meshcore_hal_test_radio_force_receiving(false, false);
	meshcore_hal_test_radio_set_send_delay_per_byte(1U);

	for (int i = 0; i < kPoolSize * 4; i++) {
		env.mesh.loop();
		meshcore_hal_test_millis_advance(100000U);
		env.mesh.loop();
	}

	for (;;) {
		mesh::Packet *packet = env.manager.removeOutboundByIdx(0);

		if (packet == nullptr) {
			break;
		}
		env.manager.free(packet);
	}

	for (int i = 0; i < kPoolSize * 4; i++) {
		mesh::Packet *packet =
			env.manager.getNextInbound(meshcore_hal_millis_get());

		if (packet != nullptr) {
			env.manager.free(packet);
			continue;
		}
		meshcore_hal_test_millis_advance(100000U);
	}
}

void *reference_env_suite_setup(void)
{
	if (!g_reference_env_inited) {
		g_reference_env = ::new (static_cast<void *>(g_reference_env_storage))
			ReferenceEnv();
		g_reference_env_inited = true;
	}

	return g_reference_env;
}

void reference_env_before_each(void *fixture)
{
	ReferenceEnv *env = static_cast<ReferenceEnv *>(fixture);

	reset_fake_runtime();
	reference_env_settle_and_drain(*env);
	reset_fake_runtime();
	env->script = default_script();
	env->tables = SimpleMeshTables();
	env->mesh.~ReferenceHarness();
	::new (static_cast<void *>(&env->mesh))
		ReferenceHarness(env->radio, env->clock, env->rng, env->rtc,
				 env->manager, env->tables, &env->script);

	zassert_equal(env->manager.getOutboundTotal(), 0,
		      "reference outbound queue not empty after reset");
	zassert_equal(env->manager.getFreeCount(), kPoolSize,
		      "reference pool not fully restored after reset");
}

ReferenceEnv &reference_env_get(void)
{
	zassert_not_null(g_reference_env, "reference env not initialized");
	return *g_reference_env;
}

MeshPolicySnapshot capture_reference_snapshot(ReferenceEnv &env,
					      mesh::Packet *packet,
					      const uint8_t *hash)
{
	return env.mesh.capturePolicySnapshot(packet, hash);
}

} // namespace meshcore_mesh_tdd
```

## src/test_reference_env.h
```c
// SPDX-License-Identifier: Apache-2.0
/*
 * Copyright (c) 2026 FoBE Studio
 */

#ifndef FOBE_TESTS_LIB_MESHCORE_MODULE_MESH_SRC_TEST_REFERENCE_ENV_H_
#define FOBE_TESTS_LIB_MESHCORE_MODULE_MESH_SRC_TEST_REFERENCE_ENV_H_

#include "test_support.h"

namespace meshcore_mesh_tdd {

class CommonMillisecondClock : public mesh::MillisecondClock {
public:
	unsigned long getMillis() override;
};

class CommonFakeRadio : public mesh::Radio {
public:
	void begin() override;
	int recvRaw(uint8_t *bytes, int sz) override;
	uint32_t getEstAirtimeFor(int len_bytes) override;
	float packetScore(float snr, int packet_len) override;
	bool startSendRaw(const uint8_t *bytes, int len) override;
	bool isSendComplete() override;
	void onSendFinished() override;
	void loop() override;
	void triggerNoiseFloorCalibrate(int threshold) override;
	void resetAGC() override;
	bool isInRecvMode() const override;
	bool isReceiving() override;
	float getLastRSSI() const override;
	float getLastSNR() const override;
};

class CommonRng : public mesh::RNG {
public:
	void random(uint8_t *dest, size_t sz) override;
};

class CommonRtcClock : public mesh::RTCClock {
public:
	uint32_t getCurrentTime() override;
	void setCurrentTime(uint32_t time) override;
};

class ReferenceHarness : public mesh::Mesh {
public:
	ReferenceHarness(mesh::Radio &radio, mesh::MillisecondClock &clock,
			 mesh::RNG &rng, mesh::RTCClock &rtc,
			 mesh::PacketManager &manager, mesh::MeshTables &tables,
			 MeshScript *script);

	MeshPolicySnapshot capturePolicySnapshot(mesh::Packet *packet,
						 const uint8_t *hash);
	mesh::DispatcherAction onRecvForTest(mesh::Packet *packet);
	mesh::DispatcherAction routeRecvForTest(mesh::Packet *packet);

protected:
	bool filterRecvFloodPacket(mesh::Packet *packet) override;
	bool allowPacketForward(const mesh::Packet *packet) override;
	uint32_t getRetransmitDelay(const mesh::Packet *packet) override;
	uint32_t getDirectRetransmitDelay(const mesh::Packet *packet) override;
	uint8_t getExtraAckTransmitCount() const override;
	uint32_t getCADFailRetryDelay() const override;
	int searchPeersByHash(const uint8_t *hash) override;
	void getPeerSharedSecret(uint8_t *dest_secret, int peer_idx) override;
	void onPeerDataRecv(mesh::Packet *packet, uint8_t type, int sender_idx,
			    const uint8_t *secret, uint8_t *data,
			    size_t len) override;
	void onTraceRecv(mesh::Packet *packet, uint32_t tag, uint32_t auth_code,
			 uint8_t flags, const uint8_t *path_snrs,
			 const uint8_t *path_hashes, uint8_t path_len) override;
	bool onPeerPathRecv(mesh::Packet *packet, int sender_idx,
			    const uint8_t *secret, uint8_t *path,
			    uint8_t path_len, uint8_t extra_type, uint8_t *extra,
			    uint8_t extra_len) override;
	void onAdvertRecv(mesh::Packet *packet, const mesh::Identity &id,
			  uint32_t timestamp, const uint8_t *app_data,
			  size_t app_data_len) override;
	void onAnonDataRecv(mesh::Packet *packet, const uint8_t *secret,
			    const mesh::Identity &sender, uint8_t *data,
			    size_t len) override;
	void onControlDataRecv(mesh::Packet *packet) override;
	void onRawDataRecv(mesh::Packet *packet) override;
	int searchChannelsByHash(const uint8_t *hash, mesh::GroupChannel channels[],
				 int max_matches) override;
	void onGroupDataRecv(mesh::Packet *packet, uint8_t type,
			     const mesh::GroupChannel &channel, uint8_t *data,
			     size_t len) override;
	void onAckRecv(mesh::Packet *packet, uint32_t ack_crc) override;

private:
	MeshScript *script_;
};

struct ReferenceEnv {
	MeshScript script;
	CommonFakeRadio radio;
	CommonMillisecondClock clock;
	CommonRng rng;
	CommonRtcClock rtc;
	StaticPoolPacketManager manager;
	SimpleMeshTables tables;
	ReferenceHarness mesh;

	ReferenceEnv();
};

void *reference_env_suite_setup(void);
void reference_env_before_each(void *fixture);
ReferenceEnv &reference_env_get(void);

MeshPolicySnapshot capture_reference_snapshot(ReferenceEnv &env,
					      mesh::Packet *packet,
					      const uint8_t *hash);

} // namespace meshcore_mesh_tdd

#endif /* FOBE_TESTS_LIB_MESHCORE_MODULE_MESH_SRC_TEST_REFERENCE_ENV_H_ */
```

## src/test_support.cpp
```c
// SPDX-License-Identifier: Apache-2.0
/*
 * Copyright (c) 2026 FoBE Studio
 */

#include "test_support.h"

#include <string.h>

#include "test_reference_env.h"
#include "test_target_env.h"

namespace meshcore_mesh_tdd {

class FixedRNG : public mesh::RNG {
public:
	FixedRNG(const uint8_t *src, size_t len) : data_(src), len_(len), idx_(0U)
	{
	}

	void random(uint8_t *dest, size_t sz) override
	{
		for (size_t i = 0; i < sz; i++) {
			dest[i] = data_[idx_ % len_];
			idx_++;
		}
	}

private:
	const uint8_t *data_;
	size_t len_;
	size_t idx_;
};

MeshScript default_script(void)
{
	MeshScript script = {};

	script.override_filter_recv_flood_packet = false;
	script.filter_recv_flood_packet_value = false;
	script.override_allow_packet_forward = false;
	script.allow_packet_forward_value = false;
	script.override_get_retransmit_delay = false;
	script.get_retransmit_delay_value = 0U;
	script.override_get_direct_retransmit_delay = false;
	script.get_direct_retransmit_delay_value = 0U;
	script.override_get_extra_ack_transmit_count = false;
	script.get_extra_ack_transmit_count_value = 0U;
	script.override_get_cad_fail_retry_delay = false;
	script.get_cad_fail_retry_delay_value = 0U;
	script.override_search_peers_by_hash = false;
	script.search_peers_by_hash_value = 0;
	script.override_search_channels_by_hash = false;
	script.search_channels_by_hash_value = 0;
	script.override_get_peer_shared_secret = false;
	memset(script.peer_shared_secret, 0, sizeof(script.peer_shared_secret));
	script.override_search_channels_fill = false;
	memset(script.search_channel_hash, 0, sizeof(script.search_channel_hash));
	memset(script.search_channel_secret, 0, sizeof(script.search_channel_secret));
	script.override_on_peer_path_recv = false;
	script.on_peer_path_recv_value = false;
	script.on_peer_data_recv_count = 0U;
	script.on_trace_recv_count = 0U;
	script.on_peer_path_recv_count = 0U;
	script.on_advert_recv_count = 0U;
	script.on_anon_data_recv_count = 0U;
	script.on_control_data_recv_count = 0U;
	script.on_raw_data_recv_count = 0U;
	script.on_group_data_recv_count = 0U;
	script.on_ack_recv_count = 0U;
	script.last_ack_crc = 0U;
	script.last_peer_data_type = 0U;
	script.last_peer_data_len = 0U;
	script.last_group_data_type = 0U;
	script.last_group_data_len = 0U;
	script.last_anon_data_len = 0U;
	script.last_peer_path_len = 0U;
	script.last_peer_path_extra_type = 0U;
	script.last_peer_path_extra_len = 0U;
	script.last_trace_tag = 0U;
	script.last_trace_auth_code = 0U;
	script.last_trace_flags = 0U;
	return script;
}

void reset_fake_runtime(void)
{
	meshcore_hal_test_host_state_reset();
	meshcore_hal_test_radio_reset();
	meshcore_hal_test_millis_clear();
	meshcore_hal_test_millis_set(kStartMillis);
	meshcore_hal_test_rtc_set_current_time(kStartRtc);
	meshcore_hal_test_rng_clear();
}

void init_reference_packet(mesh::Packet *packet, uint8_t route_type, uint8_t seed,
			   uint8_t payload_len)
{
	*packet = mesh::Packet();
	packet->header = (PAYLOAD_VER_1 << PH_VER_SHIFT) |
			 (PAYLOAD_TYPE_TXT_MSG << PH_TYPE_SHIFT) | route_type;
	packet->path_len = 0U;
	packet->payload_len = payload_len;
	for (uint8_t i = 0; i < payload_len; i++) {
		packet->payload[i] = (uint8_t)(seed + i);
	}
}

void init_target_packet(struct meshcore_packet *packet, uint8_t route_type,
			uint8_t seed, uint8_t payload_len)
{
	memset(packet, 0, sizeof(*packet));
	packet->header = (PAYLOAD_VER_1 << PH_VER_SHIFT) |
			 (PAYLOAD_TYPE_TXT_MSG << PH_TYPE_SHIFT) | route_type;
	packet->path_len = 0U;
	packet->payload_len = payload_len;
	for (uint8_t i = 0; i < payload_len; i++) {
		packet->payload[i] = (uint8_t)(seed + i);
	}
}

void make_reference_local_identity(mesh::LocalIdentity *dest,
				   const uint8_t *rng_data, size_t rng_len)
{
	FixedRNG rng(rng_data, rng_len);
	mesh::LocalIdentity identity(&rng);

	*dest = identity;
}

void sync_target_self_identity(TargetEnv &target,
			       mesh::LocalIdentity &reference_identity)
{
	uint8_t full_layout[PRV_KEY_SIZE + PUB_KEY_SIZE] = { 0 };
	size_t len = reference_identity.writeTo(full_layout, sizeof(full_layout));

	zassert_equal(sizeof(full_layout), len,
		      "reference identity serialize length mismatch");
	meshcore_local_identity_read_from(&target.mesh.self_id, full_layout, len);
}

void clone_target_packet_from_reference(
	struct meshcore_packet *target, const mesh::Packet *reference)
{
	uint8_t raw[MESHCORE_MAX_TRANS_UNIT_LEN] = { 0 };
	uint8_t raw_len = reference->writeTo(raw);

	memset(target, 0, sizeof(*target));
	zassert_true(meshcore_packet_read_from(target, raw, raw_len),
		     "target packet parse from reference raw failed");
}

void expect_packet_state_match(const mesh::Packet *expected,
			       const struct meshcore_packet *actual,
			       const char *label)
{
	uint8_t expected_path_len = expected->getPathByteLen();
	uint8_t actual_path_len = meshcore_packet_get_path_byte_len(actual);

	zassert_true(expected->header == actual->header,
		     "%s header mismatch exp=%u act=%u", label, expected->header,
		     actual->header);
	if (expected->header != actual->header) {
		return;
	}
	zassert_equal(expected->path_len, actual->path_len, "%s path_len mismatch",
		      label);
	if (expected->path_len != actual->path_len) {
		return;
	}
	zassert_equal(expected->payload_len, actual->payload_len,
		      "%s payload_len mismatch", label);
	if (expected->payload_len != actual->payload_len) {
		return;
	}
	zassert_equal(expected_path_len, actual_path_len, "%s path byte len mismatch",
		      label);
	if (expected_path_len != actual_path_len) {
		return;
	}
	if (expected_path_len > 0U) {
		zassert_mem_equal(expected->path, actual->path, expected_path_len,
				  "%s path mismatch", label);
	}
	if (expected->payload_len > 0U) {
		zassert_mem_equal(expected->payload, actual->payload,
				  expected->payload_len, "%s payload mismatch", label);
	}
}

void expect_created_packet_raw_match(const mesh::Packet *expected_packet,
				     const struct meshcore_packet *actual_packet,
				     const char *label)
{
	uint8_t expected_raw[MESHCORE_MAX_TRANS_UNIT_LEN] = { 0 };
	uint8_t actual_raw[MESHCORE_MAX_TRANS_UNIT_LEN] = { 0 };
	uint8_t expected_len;
	uint8_t actual_len;

	zassert_not_null(expected_packet, "%s expected packet null", label);
	zassert_not_null(actual_packet, "%s actual packet null", label);
	if (expected_packet == nullptr || actual_packet == NULL) {
		return;
	}

	expected_len = expected_packet->writeTo(expected_raw);
	actual_len = meshcore_packet_write_to(actual_packet, actual_raw);
	zassert_equal(expected_len, actual_len, "%s raw len mismatch", label);
	zassert_mem_equal(expected_raw, actual_raw, expected_len,
			  "%s raw bytes mismatch", label);
}

void expect_create_result_match_and_free(
	ReferenceEnv &expected, mesh::Packet *expected_packet, TargetEnv &actual,
	struct meshcore_packet *actual_packet, const char *label)
{
	bool expected_null = (expected_packet == nullptr);
	bool actual_null = (actual_packet == NULL);
	bool nullability_match = (expected_null == actual_null);

	if (!nullability_match) {
		if (expected_packet != nullptr) {
			expected.manager.free(expected_packet);
		}
		if (actual_packet != NULL) {
			meshcore_packet_queue_manager_free(&actual.manager, actual_packet);
		}
		zassert_equal(expected_null, actual_null, "%s nullability mismatch",
			      label);
		return;
	}

	if (expected_null) {
		return;
	}

	uint8_t expected_raw[MESHCORE_MAX_TRANS_UNIT_LEN] = { 0 };
	uint8_t actual_raw[MESHCORE_MAX_TRANS_UNIT_LEN] = { 0 };
	uint8_t expected_len = expected_packet->writeTo(expected_raw);
	uint8_t actual_len = meshcore_packet_write_to(actual_packet, actual_raw);

	expected.manager.free(expected_packet);
	meshcore_packet_queue_manager_free(&actual.manager, actual_packet);

	zassert_equal(expected_len, actual_len, "%s raw len mismatch", label);
	if (expected_len != actual_len) {
		return;
	}
	zassert_mem_equal(expected_raw, actual_raw, expected_len,
			  "%s raw bytes mismatch", label);
}

void expect_snapshot_match(const MeshPolicySnapshot &expected,
			   const MeshPolicySnapshot &actual,
			   const char *label)
{
	zassert_equal(expected.filter_recv_flood_packet, actual.filter_recv_flood_packet,
		      "%s filter_recv_flood_packet mismatch", label);
	zassert_equal(expected.allow_packet_forward, actual.allow_packet_forward,
		      "%s allow_packet_forward mismatch", label);
	zassert_equal(expected.retransmit_delay, actual.retransmit_delay,
		      "%s retransmit_delay mismatch", label);
	zassert_equal(expected.direct_retransmit_delay,
		      actual.direct_retransmit_delay,
		      "%s direct_retransmit_delay mismatch", label);
	zassert_equal(expected.extra_ack_transmit_count,
		      actual.extra_ack_transmit_count,
		      "%s extra_ack_transmit_count mismatch", label);
	zassert_equal(expected.cad_fail_retry_delay, actual.cad_fail_retry_delay,
		      "%s cad_fail_retry_delay mismatch", label);
	zassert_equal(expected.search_peers_by_hash, actual.search_peers_by_hash,
		      "%s search_peers_by_hash mismatch", label);
	zassert_equal(expected.search_channels_by_hash, actual.search_channels_by_hash,
		      "%s search_channels_by_hash mismatch", label);
}

void expect_script_observation_match(const MeshScript &expected,
				     const MeshScript &actual,
				     const char *label)
{
	zassert_equal(expected.on_peer_data_recv_count, actual.on_peer_data_recv_count,
		      "%s on_peer_data_recv_count mismatch", label);
	zassert_equal(expected.on_trace_recv_count, actual.on_trace_recv_count,
		      "%s on_trace_recv_count mismatch", label);
	zassert_equal(expected.on_peer_path_recv_count, actual.on_peer_path_recv_count,
		      "%s on_peer_path_recv_count mismatch", label);
	zassert_equal(expected.on_advert_recv_count, actual.on_advert_recv_count,
		      "%s on_advert_recv_count mismatch", label);
	zassert_equal(expected.on_anon_data_recv_count, actual.on_anon_data_recv_count,
		      "%s on_anon_data_recv_count mismatch", label);
	zassert_equal(expected.on_control_data_recv_count,
		      actual.on_control_data_recv_count,
		      "%s on_control_data_recv_count mismatch", label);
	zassert_equal(expected.on_raw_data_recv_count, actual.on_raw_data_recv_count,
		      "%s on_raw_data_recv_count mismatch", label);
	zassert_equal(expected.on_group_data_recv_count, actual.on_group_data_recv_count,
		      "%s on_group_data_recv_count mismatch exp=%u act=%u", label,
		      expected.on_group_data_recv_count,
		      actual.on_group_data_recv_count);
	zassert_equal(expected.on_ack_recv_count, actual.on_ack_recv_count,
		      "%s on_ack_recv_count mismatch", label);
	zassert_equal(expected.last_ack_crc, actual.last_ack_crc,
		      "%s last_ack_crc mismatch", label);
	zassert_equal(expected.last_peer_data_type, actual.last_peer_data_type,
		      "%s last_peer_data_type mismatch", label);
	zassert_equal(expected.last_peer_data_len, actual.last_peer_data_len,
		      "%s last_peer_data_len mismatch", label);
	zassert_equal(expected.last_group_data_type, actual.last_group_data_type,
		      "%s last_group_data_type mismatch", label);
	zassert_equal(expected.last_group_data_len, actual.last_group_data_len,
		      "%s last_group_data_len mismatch", label);
	zassert_equal(expected.last_anon_data_len, actual.last_anon_data_len,
		      "%s last_anon_data_len mismatch", label);
	zassert_equal(expected.last_peer_path_len, actual.last_peer_path_len,
		      "%s last_peer_path_len mismatch", label);
	zassert_equal(expected.last_peer_path_extra_type,
		      actual.last_peer_path_extra_type,
		      "%s last_peer_path_extra_type mismatch", label);
	zassert_equal(expected.last_peer_path_extra_len,
		      actual.last_peer_path_extra_len,
		      "%s last_peer_path_extra_len mismatch", label);
	zassert_equal(expected.last_trace_tag, actual.last_trace_tag,
		      "%s last_trace_tag mismatch", label);
	zassert_equal(expected.last_trace_auth_code, actual.last_trace_auth_code,
		      "%s last_trace_auth_code mismatch", label);
	zassert_equal(expected.last_trace_flags, actual.last_trace_flags,
		      "%s last_trace_flags mismatch", label);
}

} // namespace meshcore_mesh_tdd
```

## src/test_support.h
```c
// SPDX-License-Identifier: Apache-2.0
/*
 * Copyright (c) 2026 FoBE Studio
 */

#ifndef FOBE_TESTS_LIB_MESHCORE_MODULE_MESH_SRC_TEST_SUPPORT_H_
#define FOBE_TESTS_LIB_MESHCORE_MODULE_MESH_SRC_TEST_SUPPORT_H_

#include <stddef.h>
#include <stdint.h>

#include "test_packet_bridge.h"

namespace meshcore_mesh_tdd {

struct ReferenceEnv;
struct TargetEnv;

constexpr int kPoolSize = 8;
constexpr unsigned long kStartMillis = 1000UL;
constexpr uint32_t kStartRtc = 1700000000U;

using MeshScript = meshcore_hal_test_mesh_script_t;

struct MeshPolicySnapshot {
	bool filter_recv_flood_packet;
	bool allow_packet_forward;
	uint32_t retransmit_delay;
	uint32_t direct_retransmit_delay;
	uint8_t extra_ack_transmit_count;
	uint32_t cad_fail_retry_delay;
	int search_peers_by_hash;
	int search_channels_by_hash;
};

MeshScript default_script(void);
void reset_fake_runtime(void);

void init_reference_packet(mesh::Packet *packet, uint8_t route_type, uint8_t seed,
			   uint8_t payload_len = 5U);
void init_target_packet(struct meshcore_packet *packet, uint8_t route_type,
			uint8_t seed, uint8_t payload_len = 5U);
void make_reference_local_identity(mesh::LocalIdentity *dest,
				   const uint8_t *rng_data, size_t rng_len);
void sync_target_self_identity(TargetEnv &target,
			       mesh::LocalIdentity &reference_identity);
void clone_target_packet_from_reference(
	struct meshcore_packet *target, const mesh::Packet *reference);
void expect_packet_state_match(const mesh::Packet *expected,
			       const struct meshcore_packet *actual,
			       const char *label);
void expect_created_packet_raw_match(const mesh::Packet *expected_packet,
				     const struct meshcore_packet *actual_packet,
				     const char *label);
void expect_create_result_match_and_free(
	ReferenceEnv &expected, mesh::Packet *expected_packet, TargetEnv &actual,
	struct meshcore_packet *actual_packet, const char *label);

void expect_snapshot_match(const MeshPolicySnapshot &expected,
			   const MeshPolicySnapshot &actual,
			   const char *label);
void expect_script_observation_match(const MeshScript &expected,
				     const MeshScript &actual,
				     const char *label);

} // namespace meshcore_mesh_tdd

#endif /* FOBE_TESTS_LIB_MESHCORE_MODULE_MESH_SRC_TEST_SUPPORT_H_ */
```

## src/test_target_env.cpp
```c
// SPDX-License-Identifier: Apache-2.0
/*
 * Copyright (c) 2026 FoBE Studio
 */

#include "test_target_env.h"

#include <string.h>

namespace meshcore_mesh_tdd {

struct TargetEnvStorage {
	bool used;
	struct meshcore_packet_queue_manager manager;
	struct meshcore_tables tables;
	struct meshcore_mesh mesh;
};

static TargetEnvStorage g_target_env_storage[4];

static TargetEnvStorage &target_env_storage_acquire()
{
	for (size_t i = 0U;
	     i < sizeof(g_target_env_storage) / sizeof(g_target_env_storage[0]);
	     i++) {
		if (!g_target_env_storage[i].used) {
			memset(&g_target_env_storage[i], 0,
			       sizeof(g_target_env_storage[i]));
			g_target_env_storage[i].used = true;
			return g_target_env_storage[i];
		}
	}

	zassert_unreachable("too many concurrent TargetEnv instances");
	g_target_env_storage[0].used = true;
	return g_target_env_storage[0];
}

static void target_env_storage_release(TargetEnvStorage &storage)
{
	memset(&storage, 0, sizeof(storage));
}

static void copy_mesh_script_to_hal(const MeshScript &src)
{
	meshcore_hal_test_mesh_script_t *dest =
		meshcore_hal_test_mesh_script_get();

	memset(dest, 0, sizeof(*dest));
	dest->override_filter_recv_flood_packet =
		src.override_filter_recv_flood_packet;
	dest->filter_recv_flood_packet_value = src.filter_recv_flood_packet_value;
	dest->override_allow_packet_forward = src.override_allow_packet_forward;
	dest->allow_packet_forward_value = src.allow_packet_forward_value;
	dest->override_get_retransmit_delay = src.override_get_retransmit_delay;
	dest->get_retransmit_delay_value = src.get_retransmit_delay_value;
	dest->override_get_direct_retransmit_delay =
		src.override_get_direct_retransmit_delay;
	dest->get_direct_retransmit_delay_value =
		src.get_direct_retransmit_delay_value;
	dest->override_get_extra_ack_transmit_count =
		src.override_get_extra_ack_transmit_count;
	dest->get_extra_ack_transmit_count_value =
		src.get_extra_ack_transmit_count_value;
	dest->override_get_cad_fail_retry_delay =
		src.override_get_cad_fail_retry_delay;
	dest->get_cad_fail_retry_delay_value =
		src.get_cad_fail_retry_delay_value;
	dest->override_search_peers_by_hash = src.override_search_peers_by_hash;
	dest->search_peers_by_hash_value = src.search_peers_by_hash_value;
	dest->override_search_channels_by_hash =
		src.override_search_channels_by_hash;
	dest->search_channels_by_hash_value = src.search_channels_by_hash_value;
	dest->override_get_peer_shared_secret =
		src.override_get_peer_shared_secret;
	memcpy(dest->peer_shared_secret, src.peer_shared_secret,
	       sizeof(dest->peer_shared_secret));
	dest->override_search_channels_fill = src.override_search_channels_fill;
	memcpy(dest->search_channel_hash, src.search_channel_hash,
	       sizeof(dest->search_channel_hash));
	memcpy(dest->search_channel_secret, src.search_channel_secret,
	       sizeof(dest->search_channel_secret));
	dest->override_on_peer_path_recv = src.override_on_peer_path_recv;
	dest->on_peer_path_recv_value = src.on_peer_path_recv_value;
}

static void copy_mesh_script_from_hal(MeshScript *dest)
{
	const meshcore_hal_test_mesh_script_t *src =
		meshcore_hal_test_mesh_script_get();

	dest->on_peer_data_recv_count = src->on_peer_data_recv_count;
	dest->on_trace_recv_count = src->on_trace_recv_count;
	dest->on_peer_path_recv_count = src->on_peer_path_recv_count;
	dest->on_advert_recv_count = src->on_advert_recv_count;
	dest->on_anon_data_recv_count = src->on_anon_data_recv_count;
	dest->on_control_data_recv_count = src->on_control_data_recv_count;
	dest->on_raw_data_recv_count = src->on_raw_data_recv_count;
	dest->on_group_data_recv_count = src->on_group_data_recv_count;
	dest->on_ack_recv_count = src->on_ack_recv_count;
	dest->last_ack_crc = src->last_ack_crc;
	dest->last_peer_data_type = src->last_peer_data_type;
	dest->last_peer_data_len = src->last_peer_data_len;
	dest->last_group_data_type = src->last_group_data_type;
	dest->last_group_data_len = src->last_group_data_len;
	dest->last_anon_data_len = src->last_anon_data_len;
	dest->last_peer_path_len = src->last_peer_path_len;
	dest->last_peer_path_extra_type = src->last_peer_path_extra_type;
	dest->last_peer_path_extra_len = src->last_peer_path_extra_len;
	dest->last_trace_tag = src->last_trace_tag;
	dest->last_trace_auth_code = src->last_trace_auth_code;
	dest->last_trace_flags = src->last_trace_flags;
}

TargetEnv::TargetEnv()
	: storage(target_env_storage_acquire()), script(default_script()),
	  manager(storage.manager), tables(storage.tables), mesh(storage.mesh)
{
	meshcore_packet_queue_manager_prepare(&manager, kPoolSize);
	meshcore_tables_init(&tables);
	sync_script_to_hal();
	meshcore_mesh_init(&mesh, &manager, &tables);
}

TargetEnv::~TargetEnv()
{
	meshcore_hal_test_mesh_script_mirror_set(NULL);
	meshcore_packet_queue_manager_deinit(&manager);
	target_env_storage_release(storage);
}

void TargetEnv::sync_script_to_hal()
{
	copy_mesh_script_to_hal(script);
	meshcore_hal_test_mesh_script_mirror_set(&script);
}

void TargetEnv::sync_script_from_hal()
{
	copy_mesh_script_from_hal(&script);
}

MeshPolicySnapshot capture_target_snapshot(TargetEnv &env,
					   struct meshcore_packet *packet,
					   const uint8_t *hash)
{
	MeshPolicySnapshot snapshot = {};
	struct meshcore_group_channel channels[4] = {};
	uint8_t secret[MESHCORE_PUBLIC_KEY_SIZE] = {};
	meshcore_common_peer_identity_t peer = {};
	size_t cursor = 0U;
	size_t slot_id = 0U;

	env.sync_script_to_hal();
	snapshot.filter_recv_flood_packet =
		meshcore_mesh_runtime_filter_recv_flood_packet(&env.mesh, packet);
	snapshot.allow_packet_forward =
		meshcore_mesh_runtime_allow_packet_forward(&env.mesh, packet);
	snapshot.retransmit_delay =
		meshcore_mesh_runtime_get_retransmit_delay(&env.mesh, packet);
	snapshot.direct_retransmit_delay =
		meshcore_mesh_runtime_get_direct_retransmit_delay(&env.mesh, packet);
	snapshot.extra_ack_transmit_count =
		meshcore_mesh_runtime_get_extra_ack_transmit_count(&env.mesh);
	snapshot.cad_fail_retry_delay =
		meshcore_mesh_runtime_get_cad_fail_retry_delay(&env.mesh);
	while (meshcore_mesh_runtime_next_peer_shared_secret_by_hash(
		       &env.mesh, hash, cursor, &slot_id, secret, &peer) == 0) {
		cursor = slot_id + 1U;
		snapshot.search_peers_by_hash++;
	}
	snapshot.search_channels_by_hash =
		meshcore_mesh_runtime_search_channels_by_hash(&env.mesh, hash,
							      channels, 4);
	env.sync_script_from_hal();
	return snapshot;
}

} // namespace meshcore_mesh_tdd
```

## src/test_target_env.h
```c
// SPDX-License-Identifier: Apache-2.0
/*
 * Copyright (c) 2026 FoBE Studio
 */

#ifndef FOBE_TESTS_LIB_MESHCORE_MODULE_MESH_SRC_TEST_TARGET_ENV_H_
#define FOBE_TESTS_LIB_MESHCORE_MODULE_MESH_SRC_TEST_TARGET_ENV_H_

#include "test_support.h"

namespace meshcore_mesh_tdd {

struct TargetEnvStorage;

struct TargetEnv {
	TargetEnvStorage &storage;
	MeshScript script;
	struct meshcore_packet_queue_manager &manager;
	struct meshcore_tables &tables;
	struct meshcore_mesh &mesh;

	TargetEnv();
	~TargetEnv();

	void sync_script_to_hal();
	void sync_script_from_hal();
};

MeshPolicySnapshot capture_target_snapshot(TargetEnv &env,
					   struct meshcore_packet *packet,
					   const uint8_t *hash);

} // namespace meshcore_mesh_tdd

#endif /* FOBE_TESTS_LIB_MESHCORE_MODULE_MESH_SRC_TEST_TARGET_ENV_H_ */
```
