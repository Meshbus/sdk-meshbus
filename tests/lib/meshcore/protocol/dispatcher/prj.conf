## CMakeLists.txt
```
cmake_minimum_required(VERSION 3.20.0)

find_package(Zephyr REQUIRED HINTS $ENV{ZEPHYR_BASE})
project(meshcore_dispatcher_tdd_test)

include(${CMAKE_CURRENT_LIST_DIR}/../../common/reference_meshcore.cmake)

zephyr_include_directories(
  ${MESHCORE_REFERENCE_INCLUDE_DIRS}
  ${MESHCORE_INTERNAL_INCLUDE_DIRS}
  ${MESHCORE_TEST_COMMON_DIR}/include
  ${MESHCORE_TEST_COMMON_DIR}/lib/Crypto
)

target_sources(app PRIVATE
  src/main.cpp
  src/test_support.cpp
  src/test_reference_env.cpp
  src/test_target_env.cpp
  ${MESHCORE_TEST_COMMON_DIR}/src/meshcore_hal_zephyr.c
  ${MESHCORE_PLATFORM_BRIDGE_SOURCES}
  ${MESHCORE_PROTOCOL_CLOCK_SOURCES}
  ${MESHCORE_PROTOCOL_UTILS_SOURCES}
  ${MESHCORE_PROTOCOL_PACKET_SOURCES}
  ${MESHCORE_PROTOCOL_PACKET_MANAGER_SOURCES}
  ${MESHCORE_PROTOCOL_RADIO_SOURCES}
  ${MESHCORE_PROTOCOL_DISPATCHER_SOURCES}
  ${MESHCORE_REFERENCE_STATIC_POOL_PACKET_MANAGER_SOURCES}
  ${MESHCORE_REFERENCE_DISPATCHER_SOURCES}
  ${MESHCORE_REFERENCE_PACKET_SOURCES}
  ${MESHCORE_TEST_COMMON_DIR}/lib/Crypto/Crypto.cpp
  ${MESHCORE_TEST_COMMON_DIR}/lib/Crypto/Hash.cpp
  ${MESHCORE_TEST_COMMON_DIR}/lib/Crypto/SHA256.cpp
)

zephyr_library_compile_options(
  -Wno-unused-parameter
  -Wno-unused-variable
  $<$<COMPILE_LANGUAGE:CXX>:-Wno-sign-compare>
  $<$<COMPILE_LANGUAGE:CXX>:-Wno-reorder>
)
```

## prj.conf
```kconfig
CONFIG_ZTEST=y
CONFIG_ASSERT=y
CONFIG_LOG=y

CONFIG_CPP=y
CONFIG_STD_CPP11=y

CONFIG_PSA_CRYPTO=y
CONFIG_PSA_CRYPTO_PROVIDER_MBEDTLS=y
CONFIG_MBEDTLS_PSA_CRYPTO_C=y
CONFIG_PSA_WANT_ALG_SHA_256=y
CONFIG_ENTROPY_GENERATOR=y

CONFIG_MAIN_STACK_SIZE=6144
CONFIG_SYSTEM_WORKQUEUE_STACK_SIZE=4096
CONFIG_ZTEST_STACK_SIZE=6144
CONFIG_HEAP_MEM_POOL_SIZE=16384
```

## src/main.cpp
```c
// SPDX-License-Identifier: Apache-2.0
/*
 * Copyright (c) 2026 FoBE Studio
 */

#include "test_reference_env.h"
#include "test_support.h"
#include "test_target_env.h"

namespace meshcore_dispatcher_tdd {

ZTEST(meshcore_dispatcher_tdd, test_default_dispatcher_policy_matches_upstream)
{
	DispatcherInputScript script = default_script();

	zassert_true(script.override_airtime_budget_factor,
		     "airtime_budget_factor override default mismatch");
	zassert_equal(script.airtime_budget_factor, 2.0f,
		      "airtime_budget_factor default mismatch");
	zassert_true(script.override_rx_delay_ms,
		     "rx_delay override default mismatch");
	zassert_equal(script.cad_fail_max_duration_ms, 4000U,
		      "cad_fail_max_duration default mismatch");
	zassert_equal(script.interference_threshold, 0,
		      "interference_threshold default mismatch");
	zassert_equal(script.agc_reset_interval_ms, 0,
		      "agc_reset_interval default mismatch");
	zassert_equal(script.duty_cycle_window_ms, 3600000UL,
		      "duty_cycle_window default mismatch");
}

ZTEST(meshcore_dispatcher_tdd,
      test_begin_obtain_release_and_time_helpers_match_reference)
{
	ReferenceEnv &expected = reference_env_get();
	reset_fake_runtime();
	expected.script.interference_threshold = 7;
	expected.dispatcher.begin();

	unsigned long expected_future = expected.dispatcher.futureMillis(123);
	bool expected_passed_past = expected.dispatcher.millisHasNowPassed(900U);
	bool expected_passed_equal =
		expected.dispatcher.millisHasNowPassed(kStartMillis);
	mesh::Packet *expected_packet = expected.dispatcher.obtainNewPacket();
	int expected_free_after_alloc = expected.manager.getFreeCount();
	expected.dispatcher.releasePacket(expected_packet);
	DispatcherSnapshot expected_snapshot = capture_reference_snapshot(expected);

	reset_fake_runtime();
	TargetEnv actual;
	actual.script.interference_threshold = 7;
	actual.sync_driver_inputs();
	meshcore_dispatcher_begin(&actual.dispatcher);

	unsigned long actual_future =
		meshcore_dispatcher_future_millis(&actual.dispatcher, 123);
	bool actual_passed_past =
		meshcore_dispatcher_millis_has_now_passed(&actual.dispatcher, 900U);
	bool actual_passed_equal = meshcore_dispatcher_millis_has_now_passed(
		&actual.dispatcher, kStartMillis);
	struct meshcore_packet *actual_packet =
		meshcore_dispatcher_obtain_new_packet(&actual.dispatcher);
	int actual_free_after_alloc =
		meshcore_packet_queue_manager_get_free_count(&actual.manager);
	meshcore_dispatcher_release_packet(&actual.dispatcher, actual_packet);
	DispatcherSnapshot actual_snapshot = capture_target_snapshot(actual);

	zassert_equal(expected_future, actual_future, "futureMillis mismatch");
	zassert_equal(expected_passed_past, actual_passed_past,
		      "millisHasNowPassed(past) mismatch");
	zassert_equal(expected_passed_equal, actual_passed_equal,
		      "millisHasNowPassed(equal) mismatch");
	zassert_equal(expected_free_after_alloc, actual_free_after_alloc,
		      "free_count after alloc mismatch");
	expect_snapshot_match(expected_snapshot, actual_snapshot,
			      "begin/obtain/release");
}

ZTEST(meshcore_dispatcher_tdd, test_direct_receive_release_matches_reference)
{
	uint8_t raw[MESHCORE_MAX_TRANS_UNIT_LEN];
	uint8_t raw_len = build_raw_packet(ROUTE_TYPE_DIRECT, 0x11U, raw, 4U);

	ReferenceEnv &expected = reference_env_get();
	reset_fake_runtime();
	expected.script.interference_threshold = 5;
	expected.dispatcher.begin();
	zassert_true(meshcore_hal_test_radio_inject_receive(raw, raw_len, -35, 12,
							    0U),
		     "reference inject failed");
	expected.dispatcher.loop();
	DispatcherSnapshot expected_snapshot = capture_reference_snapshot(expected);

	reset_fake_runtime();
	TargetEnv actual;
	actual.script.interference_threshold = 5;
	actual.sync_driver_inputs();
	meshcore_dispatcher_begin(&actual.dispatcher);
	zassert_true(meshcore_hal_test_radio_inject_receive(raw, raw_len, -35, 12,
							    0U),
		     "actual inject failed");
	target_dispatcher_loop(actual);
	DispatcherSnapshot actual_snapshot = capture_target_snapshot(actual);

	expect_snapshot_match(expected_snapshot, actual_snapshot, "direct receive");
}

ZTEST(meshcore_dispatcher_tdd,
      test_zero_payload_direct_receive_matches_reference)
{
	uint8_t raw[MESHCORE_MAX_TRANS_UNIT_LEN];
	uint8_t raw_len = build_raw_packet(ROUTE_TYPE_DIRECT, 0x1AU, raw, 0U);

	ReferenceEnv &expected = reference_env_get();
	reset_fake_runtime();
	expected.dispatcher.begin();
	zassert_true(meshcore_hal_test_radio_inject_receive(raw, raw_len, -38, 10,
							    0U),
		     "reference inject failed");
	expected.dispatcher.loop();
	DispatcherSnapshot expected_snapshot = capture_reference_snapshot(expected);

	reset_fake_runtime();
	TargetEnv actual;
	actual.sync_driver_inputs();
	meshcore_dispatcher_begin(&actual.dispatcher);
	zassert_true(meshcore_hal_test_radio_inject_receive(raw, raw_len, -38, 10,
							    0U),
		     "actual inject failed");
	target_dispatcher_loop(actual);
	DispatcherSnapshot actual_snapshot = capture_target_snapshot(actual);

	expect_snapshot_match(expected_snapshot, actual_snapshot,
			      "zero payload direct receive");
}

ZTEST(meshcore_dispatcher_tdd,
      test_invalid_version_receive_is_dropped_matches_reference)
{
	uint8_t raw[MESHCORE_MAX_TRANS_UNIT_LEN] = { 0 };

	raw[0] = (uint8_t)(((PAYLOAD_VER_1 + 1U) << PH_VER_SHIFT) |
			   (PAYLOAD_TYPE_TXT_MSG << PH_TYPE_SHIFT) |
			   ROUTE_TYPE_DIRECT);

	ReferenceEnv &expected = reference_env_get();
	reset_fake_runtime();
	expected.dispatcher.begin();
	zassert_true(meshcore_hal_test_radio_inject_receive(raw, 1U, -36, 11, 0U),
		     "reference inject failed");
	expected.dispatcher.loop();
	DispatcherSnapshot expected_snapshot = capture_reference_snapshot(expected);

	reset_fake_runtime();
	TargetEnv actual;
	actual.sync_driver_inputs();
	meshcore_dispatcher_begin(&actual.dispatcher);
	zassert_true(meshcore_hal_test_radio_inject_receive(raw, 1U, -36, 11, 0U),
		     "actual inject failed");
	target_dispatcher_loop(actual);
	DispatcherSnapshot actual_snapshot = capture_target_snapshot(actual);

	expect_snapshot_match(expected_snapshot, actual_snapshot,
			      "invalid version receive");
}

ZTEST(meshcore_dispatcher_tdd,
      test_reserved_path_mode_receive_is_dropped_matches_reference)
{
	uint8_t raw[MESHCORE_MAX_TRANS_UNIT_LEN] = { 0 };

	raw[0] = (uint8_t)((PAYLOAD_VER_1 << PH_VER_SHIFT) |
			   (PAYLOAD_TYPE_TXT_MSG << PH_TYPE_SHIFT) |
			   ROUTE_TYPE_DIRECT);
	raw[1] = 0xC0U;

	ReferenceEnv &expected = reference_env_get();
	reset_fake_runtime();
	expected.dispatcher.begin();
	zassert_true(meshcore_hal_test_radio_inject_receive(raw, 2U, -37, 10, 0U),
		     "reference inject failed");
	expected.dispatcher.loop();
	DispatcherSnapshot expected_snapshot = capture_reference_snapshot(expected);

	reset_fake_runtime();
	TargetEnv actual;
	actual.sync_driver_inputs();
	meshcore_dispatcher_begin(&actual.dispatcher);
	zassert_true(meshcore_hal_test_radio_inject_receive(raw, 2U, -37, 10, 0U),
		     "actual inject failed");
	target_dispatcher_loop(actual);
	DispatcherSnapshot actual_snapshot = capture_target_snapshot(actual);

	expect_snapshot_match(expected_snapshot, actual_snapshot,
			      "reserved path mode receive");
}

ZTEST(meshcore_dispatcher_tdd,
      test_truncated_path_receive_is_dropped_matches_reference)
{
	uint8_t raw[MESHCORE_MAX_TRANS_UNIT_LEN] = { 0 };

	raw[0] = (uint8_t)((PAYLOAD_VER_1 << PH_VER_SHIFT) |
			   (PAYLOAD_TYPE_TXT_MSG << PH_TYPE_SHIFT) |
			   ROUTE_TYPE_FLOOD);
	raw[1] = 0x02U;
	raw[2] = 0xABU;

	ReferenceEnv &expected = reference_env_get();
	reset_fake_runtime();
	expected.dispatcher.begin();
	zassert_true(meshcore_hal_test_radio_inject_receive(raw, 3U, -39, 9, 0U),
		     "reference inject failed");
	expected.dispatcher.loop();
	DispatcherSnapshot expected_snapshot = capture_reference_snapshot(expected);

	reset_fake_runtime();
	TargetEnv actual;
	actual.sync_driver_inputs();
	meshcore_dispatcher_begin(&actual.dispatcher);
	zassert_true(meshcore_hal_test_radio_inject_receive(raw, 3U, -39, 9, 0U),
		     "actual inject failed");
	target_dispatcher_loop(actual);
	DispatcherSnapshot actual_snapshot = capture_target_snapshot(actual);

	expect_snapshot_match(expected_snapshot, actual_snapshot,
			      "truncated path receive");
}

ZTEST(meshcore_dispatcher_tdd, test_flood_receive_delayed_matches_reference)
{
	uint8_t raw[MESHCORE_MAX_TRANS_UNIT_LEN];
	uint8_t raw_len = build_raw_packet(ROUTE_TYPE_FLOOD, 0x22U, raw, 5U);

	ReferenceEnv &expected = reference_env_get();
	reset_fake_runtime();
	expected.script.rx_delay_ms = 120;
	expected.dispatcher.begin();
	zassert_true(meshcore_hal_test_radio_inject_receive(raw, raw_len, -40, 9,
							    0U),
		     "reference inject failed");
	expected.dispatcher.loop();
	DispatcherSnapshot expected_before = capture_reference_snapshot(expected);
	meshcore_hal_test_millis_advance(120U);
	expected.dispatcher.loop();
	DispatcherSnapshot expected_after = capture_reference_snapshot(expected);

	reset_fake_runtime();
	TargetEnv actual;
	actual.script.rx_delay_ms = 120;
	actual.sync_driver_inputs();
	meshcore_dispatcher_begin(&actual.dispatcher);
	zassert_true(meshcore_hal_test_radio_inject_receive(raw, raw_len, -40, 9,
							    0U),
		     "actual inject failed");
	target_dispatcher_loop(actual);
	DispatcherSnapshot actual_before = capture_target_snapshot(actual);
	meshcore_hal_test_millis_advance(120U);
	target_dispatcher_loop(actual);
	DispatcherSnapshot actual_after = capture_target_snapshot(actual);

	expect_snapshot_match(expected_before, actual_before, "flood delayed before");
	expect_snapshot_match(expected_after, actual_after, "flood delayed after");
}

ZTEST(meshcore_dispatcher_tdd,
      test_on_recv_retransmit_queues_outbound_matches_reference)
{
	uint8_t raw[MESHCORE_MAX_TRANS_UNIT_LEN];
	uint8_t raw_len = build_raw_packet(ROUTE_TYPE_DIRECT, 0x33U, raw, 3U);

	ReferenceEnv &expected = reference_env_get();
	reset_fake_runtime();
	expected.script.recv_action = MESHCORE_ACTION_RETRANSMIT_DELAYED(2U, 75U);
	expected.dispatcher.begin();
	zassert_true(meshcore_hal_test_radio_inject_receive(raw, raw_len, -32, 11,
							    0U),
		     "reference inject failed");
	expected.dispatcher.loop();
	DispatcherSnapshot expected_snapshot = capture_reference_snapshot(expected);

	reset_fake_runtime();
	TargetEnv actual;
	actual.script.recv_action = MESHCORE_ACTION_RETRANSMIT_DELAYED(2U, 75U);
	actual.sync_driver_inputs();
	meshcore_dispatcher_begin(&actual.dispatcher);
	zassert_true(meshcore_hal_test_radio_inject_receive(raw, raw_len, -32, 11,
							    0U),
		     "actual inject failed");
	target_dispatcher_loop(actual);
	DispatcherSnapshot actual_snapshot = capture_target_snapshot(actual);

	expect_snapshot_match(expected_snapshot, actual_snapshot,
			      "recv retransmit queue");
}

/* This case stays in protocol/dispatcher because it compares dispatcher's
 * handling of a returned retransmit action, not transport-direct owner logic. */
ZTEST(meshcore_dispatcher_tdd,
      test_transport_direct_receive_retransmit_matches_reference)
{
	uint8_t raw[MESHCORE_MAX_TRANS_UNIT_LEN];
	uint8_t raw_len = build_raw_transport_packet(ROUTE_TYPE_TRANSPORT_DIRECT,
						     0x1234U, 0xABCDU, 0x3CU,
						     raw, 4U);

	ReferenceEnv &expected = reference_env_get();
	reset_fake_runtime();
	expected.script.recv_action = MESHCORE_ACTION_RETRANSMIT_DELAYED(1U, 25U);
	expected.dispatcher.begin();
	zassert_true(meshcore_hal_test_radio_inject_receive(raw, raw_len, -28, 14,
							    0U),
		     "reference inject failed");
	expected.dispatcher.loop();
	DispatcherSnapshot expected_snapshot = capture_reference_snapshot(expected);

	reset_fake_runtime();
	TargetEnv actual;
	actual.script.recv_action = MESHCORE_ACTION_RETRANSMIT_DELAYED(1U, 25U);
	actual.sync_driver_inputs();
	meshcore_dispatcher_begin(&actual.dispatcher);
	zassert_true(meshcore_hal_test_radio_inject_receive(raw, raw_len, -28, 14,
							    0U),
		     "actual inject failed");
	target_dispatcher_loop(actual);
	DispatcherSnapshot actual_snapshot = capture_target_snapshot(actual);

	expect_snapshot_match(expected_snapshot, actual_snapshot,
			      "transport direct receive retransmit");
}

ZTEST(meshcore_dispatcher_tdd, test_send_packet_success_matches_reference)
{
	ReferenceEnv &expected = reference_env_get();
	reset_fake_runtime();
	expected.dispatcher.begin();
	meshcore_hal_test_radio_set_send_delay_per_byte(5U);
	mesh::Packet *expected_packet = expected.dispatcher.obtainNewPacket();
	zassert_not_null(expected_packet, "reference obtainNewPacket failed");
	init_reference_packet(expected_packet, ROUTE_TYPE_DIRECT, 0x44U, 4U);
	uint8_t expected_raw_len = expected_packet->getRawLength();
	expected.dispatcher.sendPacket(expected_packet, 0U, 0U);
	expected.dispatcher.loop();
	DispatcherSnapshot expected_before = capture_reference_snapshot(expected);
	meshcore_hal_test_millis_advance((unsigned long)expected_raw_len * 5U);
	expected.dispatcher.loop();
	DispatcherSnapshot expected_after = capture_reference_snapshot(expected);

	reset_fake_runtime();
	TargetEnv actual;
	actual.sync_driver_inputs();
	meshcore_dispatcher_begin(&actual.dispatcher);
	meshcore_hal_test_radio_set_send_delay_per_byte(5U);
	struct meshcore_packet *actual_packet =
		meshcore_dispatcher_obtain_new_packet(&actual.dispatcher);
	zassert_not_null(actual_packet, "actual obtainNewPacket failed");
	init_target_packet(actual_packet, ROUTE_TYPE_DIRECT, 0x44U, 4U);
	uint8_t actual_raw_len = (uint8_t)meshcore_packet_get_raw_length(actual_packet);
	meshcore_dispatcher_send_packet(&actual.dispatcher, actual_packet, 0U, 0U);
	target_dispatcher_loop(actual);
	DispatcherSnapshot actual_before = capture_target_snapshot(actual);
	meshcore_hal_test_millis_advance((unsigned long)actual_raw_len * 5U);
	target_dispatcher_loop(actual);
	DispatcherSnapshot actual_after = capture_target_snapshot(actual);

	zassert_equal(expected_raw_len, actual_raw_len, "raw length mismatch");
	expect_snapshot_match(expected_before, actual_before, "send success before");
	expect_snapshot_match(expected_after, actual_after, "send success after");
}

ZTEST(meshcore_dispatcher_tdd, test_send_start_fail_matches_reference)
{
	ReferenceEnv &expected = reference_env_get();
	reset_fake_runtime();
	expected.dispatcher.begin();
	meshcore_hal_test_radio_set_send_result(false);
	mesh::Packet *expected_packet = expected.dispatcher.obtainNewPacket();
	zassert_not_null(expected_packet, "reference obtainNewPacket failed");
	init_reference_packet(expected_packet, ROUTE_TYPE_DIRECT, 0x55U, 3U);
	expected.dispatcher.sendPacket(expected_packet, 0U, 0U);
	expected.dispatcher.loop();
	DispatcherSnapshot expected_snapshot = capture_reference_snapshot(expected);

	reset_fake_runtime();
	TargetEnv actual;
	actual.sync_driver_inputs();
	meshcore_dispatcher_begin(&actual.dispatcher);
	meshcore_hal_test_radio_set_send_result(false);
	struct meshcore_packet *actual_packet =
		meshcore_dispatcher_obtain_new_packet(&actual.dispatcher);
	zassert_not_null(actual_packet, "actual obtainNewPacket failed");
	init_target_packet(actual_packet, ROUTE_TYPE_DIRECT, 0x55U, 3U);
	meshcore_dispatcher_send_packet(&actual.dispatcher, actual_packet, 0U, 0U);
	target_dispatcher_loop(actual);
	DispatcherSnapshot actual_snapshot = capture_target_snapshot(actual);

	expect_snapshot_match(expected_snapshot, actual_snapshot, "send start fail");
}

ZTEST(meshcore_dispatcher_tdd, test_send_timeout_matches_reference)
{
	ReferenceEnv &expected = reference_env_get();
	reset_fake_runtime();
	expected.dispatcher.begin();
	meshcore_hal_test_radio_set_send_delay_per_byte(10U);
	meshcore_hal_test_radio_set_send_never_complete(true);
	mesh::Packet *expected_packet = expected.dispatcher.obtainNewPacket();
	zassert_not_null(expected_packet, "reference obtainNewPacket failed");
	init_reference_packet(expected_packet, ROUTE_TYPE_DIRECT, 0x66U, 5U);
	uint8_t expected_raw_len = expected_packet->getRawLength();
	expected.dispatcher.sendPacket(expected_packet, 0U, 0U);
	expected.dispatcher.loop();
	meshcore_hal_test_millis_advance((unsigned long)expected_raw_len * 20U);
	expected.dispatcher.loop();
	DispatcherSnapshot expected_snapshot = capture_reference_snapshot(expected);

	reset_fake_runtime();
	TargetEnv actual;
	actual.sync_driver_inputs();
	meshcore_dispatcher_begin(&actual.dispatcher);
	meshcore_hal_test_radio_set_send_delay_per_byte(10U);
	meshcore_hal_test_radio_set_send_never_complete(true);
	struct meshcore_packet *actual_packet =
		meshcore_dispatcher_obtain_new_packet(&actual.dispatcher);
	zassert_not_null(actual_packet, "actual obtainNewPacket failed");
	init_target_packet(actual_packet, ROUTE_TYPE_DIRECT, 0x66U, 5U);
	uint8_t actual_raw_len = (uint8_t)meshcore_packet_get_raw_length(actual_packet);
	meshcore_dispatcher_send_packet(&actual.dispatcher, actual_packet, 0U, 0U);
	target_dispatcher_loop(actual);
	meshcore_hal_test_millis_advance((unsigned long)actual_raw_len * 20U);
	target_dispatcher_loop(actual);
	DispatcherSnapshot actual_snapshot = capture_target_snapshot(actual);

	zassert_equal(expected_raw_len, actual_raw_len, "raw length mismatch");
	expect_snapshot_match(expected_snapshot, actual_snapshot, "send timeout");
}

ZTEST(meshcore_dispatcher_tdd, test_cad_busy_timeout_matches_reference)
{
	ReferenceEnv &expected = reference_env_get();
	reset_fake_runtime();
	expected.script.cad_fail_retry_delay_ms = 100U;
	expected.script.cad_fail_max_duration_ms = 300U;
	expected.dispatcher.begin();
	meshcore_hal_test_radio_force_receiving(true, true);
	mesh::Packet *expected_packet = expected.dispatcher.obtainNewPacket();
	zassert_not_null(expected_packet, "reference obtainNewPacket failed");
	init_reference_packet(expected_packet, ROUTE_TYPE_DIRECT, 0x77U, 4U);
	uint8_t expected_raw_len = expected_packet->getRawLength();
	expected.dispatcher.sendPacket(expected_packet, 0U, 0U);
	expected.dispatcher.loop();
	meshcore_hal_test_millis_advance(301U);
	expected.dispatcher.loop();
	meshcore_hal_test_millis_advance((unsigned long)expected_raw_len);
	expected.dispatcher.loop();
	DispatcherSnapshot expected_snapshot = capture_reference_snapshot(expected);

	reset_fake_runtime();
	TargetEnv actual;
	actual.script.cad_fail_retry_delay_ms = 100U;
	actual.script.cad_fail_max_duration_ms = 300U;
	actual.sync_driver_inputs();
	meshcore_dispatcher_begin(&actual.dispatcher);
	meshcore_hal_test_radio_force_receiving(true, true);
	struct meshcore_packet *actual_packet =
		meshcore_dispatcher_obtain_new_packet(&actual.dispatcher);
	zassert_not_null(actual_packet, "actual obtainNewPacket failed");
	init_target_packet(actual_packet, ROUTE_TYPE_DIRECT, 0x77U, 4U);
	uint8_t actual_raw_len = (uint8_t)meshcore_packet_get_raw_length(actual_packet);
	meshcore_dispatcher_send_packet(&actual.dispatcher, actual_packet, 0U, 0U);
	target_dispatcher_loop(actual);
	meshcore_hal_test_millis_advance(301U);
	target_dispatcher_loop(actual);
	meshcore_hal_test_millis_advance((unsigned long)actual_raw_len);
	target_dispatcher_loop(actual);
	DispatcherSnapshot actual_snapshot = capture_target_snapshot(actual);

	zassert_equal(expected_raw_len, actual_raw_len, "raw length mismatch");
	expect_snapshot_match(expected_snapshot, actual_snapshot, "cad busy timeout");
}

ZTEST(meshcore_dispatcher_tdd, test_radio_nonrx_timeout_matches_reference)
{
	ReferenceEnv &expected = reference_env_get();
	reset_fake_runtime();
	expected.dispatcher.begin();
	meshcore_hal_test_radio_force_in_rx_mode(true, false);
	expected.dispatcher.loop();
	meshcore_hal_test_millis_advance(8001U);
	expected.dispatcher.loop();
	DispatcherSnapshot expected_snapshot = capture_reference_snapshot(expected);

	reset_fake_runtime();
	TargetEnv actual;
	actual.sync_driver_inputs();
	meshcore_dispatcher_begin(&actual.dispatcher);
	meshcore_hal_test_radio_force_in_rx_mode(true, false);
	target_dispatcher_loop(actual);
	meshcore_hal_test_millis_advance(8001U);
	target_dispatcher_loop(actual);
	DispatcherSnapshot actual_snapshot = capture_target_snapshot(actual);

	expect_snapshot_match(expected_snapshot, actual_snapshot,
			      "radio non-rx timeout");
}

ZTEST(meshcore_dispatcher_tdd, test_reset_stats_preserves_queue_matches_reference)
{
	uint8_t raw[MESHCORE_MAX_TRANS_UNIT_LEN];
	uint8_t raw_len = build_raw_packet(ROUTE_TYPE_DIRECT, 0x88U, raw, 3U);

	ReferenceEnv &expected = reference_env_get();
	reset_fake_runtime();
	expected.dispatcher.begin();
	mesh::Packet *expected_packet = expected.dispatcher.obtainNewPacket();
	zassert_not_null(expected_packet, "reference obtainNewPacket failed");
	init_reference_packet(expected_packet, ROUTE_TYPE_DIRECT, 0x89U, 3U);
	expected.dispatcher.sendPacket(expected_packet, 0U, 1000U);
	zassert_true(meshcore_hal_test_radio_inject_receive(raw, raw_len, -25, 13,
							    0U),
		     "reference inject failed");
	expected.dispatcher.loop();
	expected.dispatcher.resetStats();
	DispatcherSnapshot expected_snapshot = capture_reference_snapshot(expected);

	reset_fake_runtime();
	TargetEnv actual;
	actual.sync_driver_inputs();
	meshcore_dispatcher_begin(&actual.dispatcher);
	struct meshcore_packet *actual_packet =
		meshcore_dispatcher_obtain_new_packet(&actual.dispatcher);
	zassert_not_null(actual_packet, "actual obtainNewPacket failed");
	init_target_packet(actual_packet, ROUTE_TYPE_DIRECT, 0x89U, 3U);
	meshcore_dispatcher_send_packet(&actual.dispatcher, actual_packet, 0U, 1000U);
	zassert_true(meshcore_hal_test_radio_inject_receive(raw, raw_len, -25, 13,
							    0U),
		     "actual inject failed");
	target_dispatcher_loop(actual);
	meshcore_dispatcher_reset_stats(&actual.dispatcher);
	DispatcherSnapshot actual_snapshot = capture_target_snapshot(actual);

	expect_snapshot_match(expected_snapshot, actual_snapshot,
			      "resetStats preserves queue");
}

ZTEST(meshcore_dispatcher_tdd, test_invalid_send_packet_is_dropped_matches_reference)
{
	ReferenceEnv &expected = reference_env_get();
	reset_fake_runtime();
	expected.dispatcher.begin();
	mesh::Packet *expected_packet = expected.dispatcher.obtainNewPacket();
	zassert_not_null(expected_packet, "reference obtainNewPacket failed");
	init_reference_packet(expected_packet, ROUTE_TYPE_DIRECT, 0x99U, 3U);
	expected_packet->path_len = 0xC0U;
	expected.dispatcher.sendPacket(expected_packet, 0U, 0U);
	DispatcherSnapshot expected_snapshot = capture_reference_snapshot(expected);

	reset_fake_runtime();
	TargetEnv actual;
	actual.sync_driver_inputs();
	meshcore_dispatcher_begin(&actual.dispatcher);
	struct meshcore_packet *actual_packet =
		meshcore_dispatcher_obtain_new_packet(&actual.dispatcher);
	zassert_not_null(actual_packet, "actual obtainNewPacket failed");
	init_target_packet(actual_packet, ROUTE_TYPE_DIRECT, 0x99U, 3U);
	actual_packet->path_len = 0xC0U;
	meshcore_dispatcher_send_packet(&actual.dispatcher, actual_packet, 0U, 0U);
	DispatcherSnapshot actual_snapshot = capture_target_snapshot(actual);

	expect_snapshot_match(expected_snapshot, actual_snapshot,
			      "invalid send packet");
}

} // namespace meshcore_dispatcher_tdd

ZTEST_SUITE(meshcore_dispatcher_tdd, NULL,
	    meshcore_dispatcher_tdd::reference_env_suite_setup,
	    meshcore_dispatcher_tdd::reference_env_before_each, NULL, NULL);
```

## src/test_packet_bridge.h
```c
// SPDX-License-Identifier: Apache-2.0
/*
 * Copyright (c) 2026 FoBE Studio
 */

#ifndef FOBE_TESTS_LIB_MESHCORE_MODULE_DISPATCHER_SRC_PACKET_BRIDGE_H_
#define FOBE_TESTS_LIB_MESHCORE_MODULE_DISPATCHER_SRC_PACKET_BRIDGE_H_

#include <zephyr/ztest.h>

extern "C" {
#include "meshcore_dispatcher.h"
#include "meshcore_packet.h"
#include "meshcore_packet_manager.h"
#include "meshcore_test_runtime.h"
#include "meshcore/types.h"
}

#undef PH_ROUTE_MASK
#undef PH_TYPE_SHIFT
#undef PH_TYPE_MASK
#undef PH_VER_SHIFT
#undef PH_VER_MASK
#undef ROUTE_TYPE_TRANSPORT_FLOOD
#undef ROUTE_TYPE_FLOOD
#undef ROUTE_TYPE_DIRECT
#undef ROUTE_TYPE_TRANSPORT_DIRECT
#undef PAYLOAD_TYPE_REQ
#undef PAYLOAD_TYPE_RESPONSE
#undef PAYLOAD_TYPE_TXT_MSG
#undef PAYLOAD_TYPE_ACK
#undef PAYLOAD_TYPE_ADVERT
#undef PAYLOAD_TYPE_GRP_TXT
#undef PAYLOAD_TYPE_GRP_DATA
#undef PAYLOAD_TYPE_ANON_REQ
#undef PAYLOAD_TYPE_PATH
#undef PAYLOAD_TYPE_TRACE
#undef PAYLOAD_TYPE_MULTIPART
#undef PAYLOAD_TYPE_CONTROL
#undef PAYLOAD_TYPE_RAW_CUSTOM
#undef PAYLOAD_VER_1
#undef PAYLOAD_VER_2
#undef PAYLOAD_VER_3
#undef PAYLOAD_VER_4

#include "Dispatcher.h"
#include "Packet.h"
#include "StaticPoolPacketManager.h"

#endif /* FOBE_TESTS_LIB_MESHCORE_MODULE_DISPATCHER_SRC_PACKET_BRIDGE_H_ */
```

## src/test_reference_env.cpp
```c
// SPDX-License-Identifier: Apache-2.0
/*
 * Copyright (c) 2026 FoBE Studio
 */

#include "test_reference_env.h"

#include <stddef.h>
#include <string.h>

inline void *operator new(size_t, void *ptr) noexcept
{
	return ptr;
}

namespace meshcore_dispatcher_tdd {

static ReferenceEnv *g_reference_env;
static bool g_reference_env_inited;
alignas(ReferenceEnv) static unsigned char g_reference_env_storage[sizeof(ReferenceEnv)];

unsigned long CommonMillisecondClock::getMillis()
{
	return meshcore_hal_millis_get();
}

void CommonFakeRadio::begin()
{
	meshcore_hal_radio_begin();
}

int CommonFakeRadio::recvRaw(uint8_t *bytes, int sz)
{
	return meshcore_hal_test_radio_recv_raw(bytes, (size_t)sz);
}

uint32_t CommonFakeRadio::getEstAirtimeFor(int len_bytes)
{
	return meshcore_hal_radio_airtime((size_t)len_bytes);
}

float CommonFakeRadio::packetScore(float snr, int packet_len)
{
	return meshcore_hal_radio_packet_score((int8_t)(snr * 4.0f),
					       (size_t)packet_len);
}

bool CommonFakeRadio::startSendRaw(const uint8_t *bytes, int len)
{
	return meshcore_hal_radio_packet_send(bytes, (size_t)len) != 0;
}

bool CommonFakeRadio::isSendComplete()
{
	return meshcore_hal_test_radio_tx_complete_get();
}

void CommonFakeRadio::onSendFinished()
{
	meshcore_hal_test_radio_on_send_finished();
}

void CommonFakeRadio::loop()
{
	meshcore_hal_test_radio_loop();
}

void CommonFakeRadio::triggerNoiseFloorCalibrate(int threshold)
{
	meshcore_hal_radio_noise_floor_calibrate(threshold);
}

void CommonFakeRadio::resetAGC()
{
	meshcore_hal_radio_agc_reset();
}

bool CommonFakeRadio::isInRecvMode() const
{
	return meshcore_hal_radio_in_rx_mode_get();
}

bool CommonFakeRadio::isReceiving()
{
	return meshcore_hal_radio_receiving_get();
}

float CommonFakeRadio::getLastRSSI() const
{
	return meshcore_hal_test_radio_last_rssi_get();
}

float CommonFakeRadio::getLastSNR() const
{
	return meshcore_hal_test_radio_last_snr_get();
}

ReferenceHarness::ReferenceHarness(
	mesh::Radio &radio, mesh::MillisecondClock &clock,
	mesh::PacketManager &manager, DispatcherInputScript *script)
	: mesh::Dispatcher(radio, clock, manager), script_(script)
{
}

uint16_t ReferenceHarness::getErrFlags() const
{
	return _err_flags;
}

mesh::DispatcherAction ReferenceHarness::onRecvPacket(
	mesh::Packet *packet)
{
	(void)packet;
	/* Owner callback is intentionally a pure action source in this module. */
	script_->handled_count++;
	return (mesh::DispatcherAction)script_->recv_action;
}

void ReferenceHarness::logRxRaw(float, float, const uint8_t[], int)
{
	script_->log_rx_raw_count++;
}

void ReferenceHarness::logRx(mesh::Packet *, int, float)
{
	script_->log_rx_count++;
}

void ReferenceHarness::logTx(mesh::Packet *, int)
{
	script_->log_tx_count++;
}

void ReferenceHarness::logTxFail(mesh::Packet *, int)
{
	script_->log_tx_fail_count++;
}

const char *ReferenceHarness::getLogDateTime()
{
	return "";
}

float ReferenceHarness::getAirtimeBudgetFactor() const
{
	if (!script_->override_airtime_budget_factor) {
		return mesh::Dispatcher::getAirtimeBudgetFactor();
	}

	return script_->airtime_budget_factor;
}

int ReferenceHarness::calcRxDelay(float score, uint32_t air_time) const
{
	if (!script_->override_rx_delay_ms) {
		return mesh::Dispatcher::calcRxDelay(score, air_time);
	}

	return script_->rx_delay_ms;
}

uint32_t ReferenceHarness::getCADFailRetryDelay() const
{
	return script_->cad_fail_retry_delay_ms;
}

uint32_t ReferenceHarness::getCADFailMaxDuration() const
{
	return script_->cad_fail_max_duration_ms;
}

int ReferenceHarness::getInterferenceThreshold() const
{
	return script_->interference_threshold;
}

int ReferenceHarness::getAGCResetInterval() const
{
	return script_->agc_reset_interval_ms;
}

unsigned long ReferenceHarness::getDutyCycleWindowMs() const
{
	return script_->duty_cycle_window_ms;
}

ReferenceEnv::ReferenceEnv()
	: script(default_script()),
	  manager(kPoolSize),
	  dispatcher(radio, clock, manager, &script)
{
}

static void reference_env_settle_and_drain(ReferenceEnv &env)
{
	env.script = default_script();

	meshcore_hal_test_radio_set_send_result(true);
	meshcore_hal_test_radio_set_send_never_complete(false);
	meshcore_hal_test_radio_force_in_rx_mode(false, false);
	meshcore_hal_test_radio_force_receiving(false, false);
	meshcore_hal_test_radio_set_send_delay_per_byte(1U);

	for (int i = 0; i < kPoolSize * 4; i++) {
		env.dispatcher.loop();
		meshcore_hal_test_millis_advance(100000U);
		env.dispatcher.loop();
	}

	for (;;) {
		mesh::Packet *packet = env.manager.removeOutboundByIdx(0);
		if (packet == nullptr) {
			break;
		}
		env.manager.free(packet);
	}

	for (;;) {
		mesh::Packet *packet = env.manager.getNextInbound(meshcore_hal_millis_get());
		if (packet == nullptr) {
			break;
		}
		env.manager.free(packet);
	}
}

void *reference_env_suite_setup(void)
{
	if (!g_reference_env_inited) {
		g_reference_env = ::new (static_cast<void *>(g_reference_env_storage))
			ReferenceEnv();
		g_reference_env_inited = true;
	}

	return g_reference_env;
}

void reference_env_before_each(void *fixture)
{
	ReferenceEnv *env = static_cast<ReferenceEnv *>(fixture);

	reset_fake_runtime();
	reference_env_settle_and_drain(*env);
	reset_fake_runtime();
	env->script = default_script();
	env->dispatcher.~ReferenceHarness();
	::new (static_cast<void *>(&env->dispatcher))
		ReferenceHarness(env->radio, env->clock, env->manager, &env->script);

	zassert_equal(env->manager.getOutboundTotal(), 0,
		     "reference outbound queue not empty after reset");
	zassert_equal(env->manager.getFreeCount(), kPoolSize,
		     "reference pool not fully restored after reset");
}

ReferenceEnv &reference_env_get(void)
{
	zassert_not_null(g_reference_env, "reference env not initialized");
	return *g_reference_env;
}

DispatcherSnapshot capture_reference_snapshot(ReferenceEnv &env)
{
	DispatcherSnapshot snapshot = {};
	mesh::Packet *outbound;

	snapshot.total_air_time = env.dispatcher.getTotalAirTime();
	snapshot.rx_air_time = env.dispatcher.getReceiveAirTime();
	snapshot.remaining_tx_budget = env.dispatcher.getRemainingTxBudget();
	snapshot.num_sent_flood = env.dispatcher.getNumSentFlood();
	snapshot.num_sent_direct = env.dispatcher.getNumSentDirect();
	snapshot.num_recv_flood = env.dispatcher.getNumRecvFlood();
	snapshot.num_recv_direct = env.dispatcher.getNumRecvDirect();
	snapshot.err_flags = env.dispatcher.getErrFlags();
	snapshot.free_count = env.manager.getFreeCount();
	snapshot.outbound_total = env.manager.getOutboundTotal();
	snapshot.log_rx_raw_count = env.script.log_rx_raw_count;
	snapshot.log_rx_count = env.script.log_rx_count;
	snapshot.log_tx_count = env.script.log_tx_count;
	snapshot.log_tx_fail_count = env.script.log_tx_fail_count;
	snapshot.radio_packets_recv = meshcore_hal_test_radio_get_packets_recv();
	snapshot.radio_packets_sent = meshcore_hal_test_radio_get_packets_sent();
	snapshot.noise_floor_calibrate_count =
		meshcore_hal_test_radio_get_noise_floor_calibrate_count();
	snapshot.agc_reset_count =
		meshcore_hal_test_radio_get_agc_reset_count();
	snapshot.on_send_finished_count =
		meshcore_hal_test_radio_get_on_send_finished_count();
	snapshot.last_send_len = meshcore_hal_test_radio_get_last_send_len();
	outbound = snapshot.outbound_total > 0 ? env.manager.getOutboundByIdx(0)
					       : nullptr;
	if (outbound != nullptr) {
		snapshot.first_outbound_len =
			outbound->writeTo(snapshot.first_outbound_raw);
	}
	return snapshot;
}

} // namespace meshcore_dispatcher_tdd
```

## src/test_reference_env.h
```c
// SPDX-License-Identifier: Apache-2.0
/*
 * Copyright (c) 2026 FoBE Studio
 */

#ifndef FOBE_TESTS_LIB_MESHCORE_MODULE_DISPATCHER_SRC_REFERENCE_ENV_H_
#define FOBE_TESTS_LIB_MESHCORE_MODULE_DISPATCHER_SRC_REFERENCE_ENV_H_

#include "test_support.h"

extern "C" {
#include <zephyr/ztest.h>
}

namespace meshcore_dispatcher_tdd {

class CommonMillisecondClock : public mesh::MillisecondClock {
public:
	unsigned long getMillis() override;
};

class CommonFakeRadio : public mesh::Radio {
public:
	void begin() override;
	int recvRaw(uint8_t *bytes, int sz) override;
	uint32_t getEstAirtimeFor(int len_bytes) override;
	float packetScore(float snr, int packet_len) override;
	bool startSendRaw(const uint8_t *bytes, int len) override;
	bool isSendComplete() override;
	void onSendFinished() override;
	void loop() override;
	void triggerNoiseFloorCalibrate(int threshold) override;
	void resetAGC() override;
	bool isInRecvMode() const override;
	bool isReceiving() override;
	float getLastRSSI() const override;
	float getLastSNR() const override;
};

class ReferenceHarness : public mesh::Dispatcher {
public:
	ReferenceHarness(mesh::Radio &radio, mesh::MillisecondClock &clock,
			 mesh::PacketManager &manager,
			 DispatcherInputScript *script);

	uint16_t getErrFlags() const;

protected:
	mesh::DispatcherAction onRecvPacket(mesh::Packet *packet) override;
	void logRxRaw(float, float, const uint8_t[], int) override;
	void logRx(mesh::Packet *, int, float) override;
	void logTx(mesh::Packet *, int) override;
	void logTxFail(mesh::Packet *, int) override;
	const char *getLogDateTime() override;
	float getAirtimeBudgetFactor() const override;
	int calcRxDelay(float, uint32_t) const override;
	uint32_t getCADFailRetryDelay() const override;
	uint32_t getCADFailMaxDuration() const override;
	int getInterferenceThreshold() const override;
	int getAGCResetInterval() const override;
	unsigned long getDutyCycleWindowMs() const override;

private:
	DispatcherInputScript *script_;
};

struct ReferenceEnv {
	DispatcherInputScript script;
	CommonFakeRadio radio;
	CommonMillisecondClock clock;
	StaticPoolPacketManager manager;
	ReferenceHarness dispatcher;

	ReferenceEnv();
};

void *reference_env_suite_setup(void);
void reference_env_before_each(void *fixture);
ReferenceEnv &reference_env_get(void);
DispatcherSnapshot capture_reference_snapshot(ReferenceEnv &env);

} // namespace meshcore_dispatcher_tdd

#endif /* FOBE_TESTS_LIB_MESHCORE_MODULE_DISPATCHER_SRC_REFERENCE_ENV_H_ */
```

## src/test_support.cpp
```c
// SPDX-License-Identifier: Apache-2.0
/*
 * Copyright (c) 2026 FoBE Studio
 */

#include "test_support.h"

#include <string.h>

namespace meshcore_dispatcher_tdd {

DispatcherInputScript default_script(void)
{
	DispatcherInputScript script = {};

	script.recv_action = MESHCORE_ACTION_RELEASE;
	script.override_airtime_budget_factor = true;
	script.airtime_budget_factor = 2.0f;
	script.override_rx_delay_ms = true;
	script.rx_delay_ms = 0;
	script.cad_fail_retry_delay_ms = 200U;
	script.cad_fail_max_duration_ms = 4000U;
	script.interference_threshold = 0;
	script.agc_reset_interval_ms = 0;
	script.duty_cycle_window_ms = 3600000UL;
	return script;
}

void reset_fake_runtime(void)
{
	meshcore_hal_test_host_state_reset();
	meshcore_hal_test_radio_reset();
	meshcore_hal_test_millis_clear();
	meshcore_hal_test_millis_set(kStartMillis);
	meshcore_hal_test_rtc_set_current_time(kStartRtc);
}

void init_reference_packet(mesh::Packet *packet, uint8_t route_type, uint8_t seed,
			   uint8_t payload_len)
{
	*packet = mesh::Packet();
	packet->header = (PAYLOAD_VER_1 << PH_VER_SHIFT) |
			 (PAYLOAD_TYPE_TXT_MSG << PH_TYPE_SHIFT) | route_type;
	packet->path_len = 0U;
	packet->payload_len = payload_len;
	for (uint8_t i = 0; i < payload_len; i++) {
		packet->payload[i] = (uint8_t)(seed + i);
	}
}

void init_target_packet(struct meshcore_packet *packet, uint8_t route_type,
			uint8_t seed, uint8_t payload_len)
{
	memset(packet, 0, sizeof(*packet));
	packet->header = (PAYLOAD_VER_1 << PH_VER_SHIFT) |
			 (PAYLOAD_TYPE_TXT_MSG << PH_TYPE_SHIFT) | route_type;
	packet->path_len = 0U;
	packet->payload_len = payload_len;
	for (uint8_t i = 0; i < payload_len; i++) {
		packet->payload[i] = (uint8_t)(seed + i);
	}
}

uint8_t build_raw_packet(uint8_t route_type, uint8_t seed,
			 uint8_t raw[MESHCORE_MAX_TRANS_UNIT_LEN],
			 uint8_t payload_len)
{
	mesh::Packet packet;

	init_reference_packet(&packet, route_type, seed, payload_len);
	return packet.writeTo(raw);
}

uint8_t build_raw_transport_packet(uint8_t route_type, uint16_t transport_code0,
				   uint16_t transport_code1, uint8_t seed,
				   uint8_t raw[MESHCORE_MAX_TRANS_UNIT_LEN],
				   uint8_t payload_len)
{
	mesh::Packet packet;

	init_reference_packet(&packet, route_type, seed, payload_len);
	packet.transport_codes[0] = transport_code0;
	packet.transport_codes[1] = transport_code1;
	return packet.writeTo(raw);
}

void expect_snapshot_match(const DispatcherSnapshot &expected,
			   const DispatcherSnapshot &actual,
			   const char *label)
{
	zassert_equal(expected.total_air_time, actual.total_air_time,
		      "%s total_air_time mismatch", label);
	zassert_equal(expected.rx_air_time, actual.rx_air_time,
		      "%s rx_air_time mismatch", label);
	zassert_equal(expected.remaining_tx_budget, actual.remaining_tx_budget,
		      "%s remaining_tx_budget mismatch", label);
	zassert_equal(expected.num_sent_flood, actual.num_sent_flood,
		      "%s num_sent_flood mismatch", label);
	zassert_equal(expected.num_sent_direct, actual.num_sent_direct,
		      "%s num_sent_direct mismatch", label);
	zassert_equal(expected.num_recv_flood, actual.num_recv_flood,
		      "%s num_recv_flood mismatch", label);
	zassert_equal(expected.num_recv_direct, actual.num_recv_direct,
		      "%s num_recv_direct mismatch", label);
	zassert_equal(expected.err_flags, actual.err_flags,
		      "%s err_flags mismatch", label);
	zassert_equal(expected.free_count, actual.free_count,
		      "%s free_count mismatch", label);
	zassert_equal(expected.outbound_total, actual.outbound_total,
		      "%s outbound_total mismatch: expected=%d actual=%d", label,
		      expected.outbound_total, actual.outbound_total);
	zassert_equal(expected.log_rx_raw_count, actual.log_rx_raw_count,
		      "%s log_rx_raw_count mismatch", label);
	zassert_equal(expected.log_rx_count, actual.log_rx_count,
		      "%s log_rx_count mismatch", label);
	zassert_equal(expected.log_tx_count, actual.log_tx_count,
		      "%s log_tx_count mismatch", label);
	zassert_equal(expected.log_tx_fail_count, actual.log_tx_fail_count,
		      "%s log_tx_fail_count mismatch", label);
	zassert_equal(expected.radio_packets_recv, actual.radio_packets_recv,
		      "%s radio_packets_recv mismatch", label);
	zassert_equal(expected.radio_packets_sent, actual.radio_packets_sent,
		      "%s radio_packets_sent mismatch", label);
	zassert_equal(expected.noise_floor_calibrate_count,
		      actual.noise_floor_calibrate_count,
		      "%s noise_floor_calibrate_count mismatch", label);
	zassert_equal(expected.agc_reset_count, actual.agc_reset_count,
		      "%s agc_reset_count mismatch", label);
	zassert_equal(expected.on_send_finished_count,
		      actual.on_send_finished_count,
		      "%s on_send_finished_count mismatch", label);
	zassert_equal(expected.last_send_len, actual.last_send_len,
		      "%s last_send_len mismatch", label);
	zassert_equal(expected.first_outbound_len, actual.first_outbound_len,
		      "%s first_outbound_len mismatch", label);
	if (expected.first_outbound_len > 0U || actual.first_outbound_len > 0U) {
		zassert_mem_equal(expected.first_outbound_raw, actual.first_outbound_raw,
				  expected.first_outbound_len,
				  "%s first_outbound_raw mismatch", label);
	}
}

} // namespace meshcore_dispatcher_tdd
```

## src/test_support.h
```c
// SPDX-License-Identifier: Apache-2.0
/*
 * Copyright (c) 2026 FoBE Studio
 */

#ifndef FOBE_TESTS_LIB_MESHCORE_MODULE_DISPATCHER_SRC_SUPPORT_H_
#define FOBE_TESTS_LIB_MESHCORE_MODULE_DISPATCHER_SRC_SUPPORT_H_

#include <stdint.h>

#include "test_packet_bridge.h"

namespace meshcore_dispatcher_tdd {

constexpr int kPoolSize = 8;
constexpr unsigned long kStartMillis = 1000UL;
constexpr uint32_t kStartRtc = 1700000000U;

/*
 * Dispatcher module tests treat owner callbacks as controlled inputs.
 * This script only feeds dispatcher branches; owner business logic is covered
 * by protocol/mesh and protocol/dispatcher_mesh.
 */
using DispatcherInputScript = meshcore_hal_test_dispatcher_script_t;

struct DispatcherSnapshot {
	unsigned long total_air_time;
	unsigned long rx_air_time;
	unsigned long remaining_tx_budget;
	uint32_t num_sent_flood;
	uint32_t num_sent_direct;
	uint32_t num_recv_flood;
	uint32_t num_recv_direct;
	uint16_t err_flags;
	int free_count;
	int outbound_total;
	int log_rx_raw_count;
	int log_rx_count;
	int log_tx_count;
	int log_tx_fail_count;
	uint32_t radio_packets_recv;
	uint32_t radio_packets_sent;
	uint32_t noise_floor_calibrate_count;
	uint32_t agc_reset_count;
	uint32_t on_send_finished_count;
	int last_send_len;
	uint8_t first_outbound_len;
	uint8_t first_outbound_raw[MESHCORE_MAX_TRANS_UNIT_LEN];
};

DispatcherInputScript default_script(void);
void reset_fake_runtime(void);
void init_reference_packet(mesh::Packet *packet, uint8_t route_type,
			   uint8_t seed, uint8_t payload_len = 3U);
void init_target_packet(struct meshcore_packet *packet, uint8_t route_type,
			uint8_t seed, uint8_t payload_len = 3U);
uint8_t build_raw_packet(uint8_t route_type, uint8_t seed,
			 uint8_t raw[MESHCORE_MAX_TRANS_UNIT_LEN],
			 uint8_t payload_len = 3U);
uint8_t build_raw_transport_packet(uint8_t route_type, uint16_t transport_code0,
				   uint16_t transport_code1, uint8_t seed,
				   uint8_t raw[MESHCORE_MAX_TRANS_UNIT_LEN],
				   uint8_t payload_len = 3U);
void expect_snapshot_match(const DispatcherSnapshot &expected,
			   const DispatcherSnapshot &actual,
			   const char *label);

} // namespace meshcore_dispatcher_tdd

#endif /* FOBE_TESTS_LIB_MESHCORE_MODULE_DISPATCHER_SRC_SUPPORT_H_ */
```

## src/test_target_env.cpp
```c
// SPDX-License-Identifier: Apache-2.0
/*
 * Copyright (c) 2026 FoBE Studio
 */

#include "test_target_env.h"

#include <string.h>

namespace meshcore_dispatcher_tdd {

static void sync_input_script_to_hal(const DispatcherInputScript &src)
{
	meshcore_hal_test_dispatcher_script_t *dest =
		meshcore_hal_test_dispatcher_script_get();

	*dest = src;
}

TargetEnv::TargetEnv()
	: script(default_script()),
	  manager(),
	  owner_mesh(),
	  dispatcher()
{
	meshcore_packet_queue_manager_prepare(&manager, kPoolSize);
	memset(&owner_mesh, 0, sizeof(owner_mesh));
	sync_driver_inputs();
	meshcore_dispatcher_init(&dispatcher, &manager, &owner_mesh);
}

TargetEnv::~TargetEnv()
{
	meshcore_hal_test_dispatcher_script_mirror_set(NULL);
	meshcore_packet_queue_manager_deinit(&manager);
}

void TargetEnv::sync_driver_inputs()
{
	sync_input_script_to_hal(script);
	meshcore_hal_test_dispatcher_script_mirror_set(&script);
	owner_mesh.script = &script;
}

static void complete_tx_if_ready(TargetEnv &env)
{
	if (env.dispatcher.outbound != NULL &&
	    meshcore_hal_test_radio_tx_complete_get()) {
		meshcore_hal_test_radio_on_send_finished();
		(void)meshcore_dispatcher_tx_done(&env.dispatcher, true);
	}
}

static void receive_injected_raw(TargetEnv &env)
{
	uint8_t raw[MESHCORE_MAX_TRANS_UNIT_LEN];
	int len;
	int rc;

	len = meshcore_hal_test_radio_recv_raw(raw, sizeof(raw));
	if (len <= 0) {
		return;
	}

	rc = meshcore_dispatcher_receive_raw(
		&env.dispatcher, raw, (size_t)len,
		(int16_t)meshcore_hal_test_radio_last_rssi_get(),
		(int8_t)(meshcore_hal_test_radio_last_snr_get() * 4.0f));
	zassert_true(rc == 0 || rc == -EINVAL,
		     "target receive_raw returned unexpected rc=%d", rc);
}

void target_dispatcher_loop(TargetEnv &env)
{
	bool had_active_outbound;

	env.sync_driver_inputs();
	complete_tx_if_ready(env);
	receive_injected_raw(env);

	had_active_outbound = env.dispatcher.outbound != NULL;
	meshcore_dispatcher_loop(&env.dispatcher);
	if (had_active_outbound && env.dispatcher.outbound == NULL) {
		meshcore_hal_test_radio_on_send_finished();
	}
}

DispatcherSnapshot capture_target_snapshot(TargetEnv &env)
{
	DispatcherSnapshot snapshot = {};
	struct meshcore_packet *outbound;

	env.sync_driver_inputs();
	outbound = meshcore_packet_queue_manager_get_outbound_total(&env.manager) > 0
			   ? meshcore_packet_queue_manager_get_outbound_by_idx(
				 &env.manager, 0)
			   : nullptr;

	snapshot.total_air_time =
		meshcore_dispatcher_get_total_air_time(&env.dispatcher);
	snapshot.rx_air_time =
		meshcore_dispatcher_get_receive_air_time(&env.dispatcher);
	snapshot.remaining_tx_budget =
		meshcore_dispatcher_get_remaining_tx_budget(&env.dispatcher);
	snapshot.num_sent_flood =
		meshcore_dispatcher_get_num_sent_flood(&env.dispatcher);
	snapshot.num_sent_direct =
		meshcore_dispatcher_get_num_sent_direct(&env.dispatcher);
	snapshot.num_recv_flood =
		meshcore_dispatcher_get_num_recv_flood(&env.dispatcher);
	snapshot.num_recv_direct =
		meshcore_dispatcher_get_num_recv_direct(&env.dispatcher);
	snapshot.err_flags = meshcore_dispatcher_get_err_flags(&env.dispatcher);
	snapshot.free_count =
		meshcore_packet_queue_manager_get_free_count(&env.manager);
	snapshot.outbound_total =
		meshcore_packet_queue_manager_get_outbound_total(&env.manager);
	snapshot.log_rx_raw_count = env.script.log_rx_raw_count;
	snapshot.log_rx_count = env.script.log_rx_count;
	snapshot.log_tx_count = env.script.log_tx_count;
	snapshot.log_tx_fail_count = env.script.log_tx_fail_count;
	snapshot.radio_packets_recv = meshcore_hal_test_radio_get_packets_recv();
	snapshot.radio_packets_sent = meshcore_hal_test_radio_get_packets_sent();
	snapshot.noise_floor_calibrate_count =
		meshcore_hal_test_radio_get_noise_floor_calibrate_count();
	snapshot.agc_reset_count =
		meshcore_hal_test_radio_get_agc_reset_count();
	snapshot.on_send_finished_count =
		meshcore_hal_test_radio_get_on_send_finished_count();
	snapshot.last_send_len = meshcore_hal_test_radio_get_last_send_len();
	if (outbound != nullptr) {
		snapshot.first_outbound_len =
			meshcore_packet_write_to(outbound, snapshot.first_outbound_raw);
	}
	return snapshot;
}

} // namespace meshcore_dispatcher_tdd

extern "C" {

meshcore_dispatcher_action meshcore_mesh_on_recv_packet(
	struct meshcore_mesh *mesh, struct meshcore_packet *packet)
{
	meshcore_hal_test_dispatcher_script_t *script;

	if (mesh == NULL || packet == NULL) {
		return MESHCORE_ACTION_RELEASE;
	}

	script = mesh->script;
	if (script == NULL) {
		return MESHCORE_ACTION_RELEASE;
	}

	/* Keep owner behavior minimal: dispatcher tests only care about the action. */
	script->handled_count++;
	return script->recv_action;
}

uint32_t meshcore_mesh_runtime_get_cad_fail_retry_delay(
	struct meshcore_mesh *mesh)
{
	if (mesh == NULL || mesh->script == NULL) {
		return 200U;
	}

	return mesh->script->cad_fail_retry_delay_ms;
}

} // extern "C"
```

## src/test_target_env.h
```c
// SPDX-License-Identifier: Apache-2.0
/*
 * Copyright (c) 2026 FoBE Studio
 */

#ifndef FOBE_TESTS_LIB_MESHCORE_MODULE_DISPATCHER_SRC_TARGET_ENV_H_
#define FOBE_TESTS_LIB_MESHCORE_MODULE_DISPATCHER_SRC_TARGET_ENV_H_

#include "test_support.h"

extern "C" {

/*
 * Minimal owner shim for dispatcher-only tests.
 * It exists solely because dispatcher now calls owner-only entry points.
 */
struct meshcore_mesh {
	meshcore_hal_test_dispatcher_script_t *script;
};

meshcore_dispatcher_action meshcore_mesh_on_recv_packet(
	struct meshcore_mesh *mesh, struct meshcore_packet *packet);
uint32_t meshcore_mesh_runtime_get_cad_fail_retry_delay(
	struct meshcore_mesh *mesh);

}

namespace meshcore_dispatcher_tdd {

struct TargetEnv {
	DispatcherInputScript script;
	struct meshcore_packet_queue_manager manager;
	struct meshcore_mesh owner_mesh;
	struct meshcore_dispatcher dispatcher;

	TargetEnv();
	~TargetEnv();

	void sync_driver_inputs();
};

void target_dispatcher_loop(TargetEnv &env);
DispatcherSnapshot capture_target_snapshot(TargetEnv &env);

} // namespace meshcore_dispatcher_tdd

#endif /* FOBE_TESTS_LIB_MESHCORE_MODULE_DISPATCHER_SRC_TARGET_ENV_H_ */
```
