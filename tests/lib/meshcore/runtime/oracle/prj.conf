## CMakeLists.txt
```
cmake_minimum_required(VERSION 3.20.0)

find_package(Zephyr REQUIRED HINTS $ENV{ZEPHYR_BASE})
project(meshcore_oracle_parity_test)

include(${CMAKE_CURRENT_LIST_DIR}/../../common/reference_meshcore.cmake)

set(MESHCORE_TARGET_C_SOURCES
  ${MESHCORE_TEST_COMMON_DIR}/src/meshcore_hal_zephyr.c
  ${MESHCORE_RUNTIME_LIBRARY_SOURCES}
)
set(MESHCORE_REFERENCE_CPP_SOURCES
  ${MESHCORE_REFERENCE_DISPATCHER_SOURCES}
  ${MESHCORE_REFERENCE_IDENTITY_SOURCES}
  ${MESHCORE_REFERENCE_MESH_SOURCES}
  ${MESHCORE_REFERENCE_PACKET_SOURCES}
  ${MESHCORE_REFERENCE_UTILS_SOURCES}
  ${MESHCORE_REFERENCE_DIR}/helpers/BaseChatMesh.cpp
  ${MESHCORE_REFERENCE_ADVERT_DATA_SOURCES}
  ${MESHCORE_REFERENCE_DIR}/helpers/TxtDataHelpers.cpp
  ${MESHCORE_REFERENCE_STATIC_POOL_PACKET_MANAGER_SOURCES}
)

zephyr_include_directories(
  include
  ${MESHCORE_REFERENCE_INCLUDE_DIRS}
  ${MESHCORE_INTERNAL_INCLUDE_DIRS}
  ${MESHCORE_TEST_COMMON_DIR}/include
  ${MESHCORE_TEST_COMMON_DIR}/lib/Crypto
  ${MESHCORE_TEST_COMMON_DIR}/lib/ed25519
)

target_sources(app PRIVATE
  src/suite_runtime_oracle.cpp
  src/case_helpers.cpp
  src/cases_send_side.cpp
  src/cases_receive_discover.cpp
  src/cases_receive_trace.cpp
  src/cases_receive_telemetry.cpp
  src/cases_negative.cpp
  src/reference_chat_harness.cpp
  src/test_support.cpp
  ${MESHCORE_TARGET_C_SOURCES}
  ${MESHCORE_REFERENCE_CPP_SOURCES}
  ${MESHCORE_TEST_COMMON_DIR}/lib/Crypto/Crypto.cpp
  ${MESHCORE_TEST_COMMON_DIR}/lib/Crypto/Hash.cpp
  ${MESHCORE_TEST_COMMON_DIR}/lib/Crypto/SHA256.cpp
  ${MESHCORE_TEST_COMMON_DIR}/lib/Crypto/SHA512.cpp
  ${MESHCORE_TEST_COMMON_DIR}/lib/Crypto/BlockCipher.cpp
  ${MESHCORE_TEST_COMMON_DIR}/lib/Crypto/AESCommon.cpp
  ${MESHCORE_TEST_COMMON_DIR}/lib/Crypto/AES128.cpp
  ${MESHCORE_TEST_COMMON_DIR}/lib/Crypto/Ed25519.cpp
  ${MESHCORE_TEST_COMMON_DIR}/lib/Crypto/BigNumberUtil.cpp
  ${MESHCORE_TEST_COMMON_DIR}/lib/Crypto/Curve25519.cpp
  ${MESHCORE_TEST_COMMON_DIR}/lib/ed25519/add_scalar.c
  ${MESHCORE_TEST_COMMON_DIR}/lib/ed25519/fe.c
  ${MESHCORE_TEST_COMMON_DIR}/lib/ed25519/ge.c
  ${MESHCORE_TEST_COMMON_DIR}/lib/ed25519/key_exchange.c
  ${MESHCORE_TEST_COMMON_DIR}/lib/ed25519/keypair.c
  ${MESHCORE_TEST_COMMON_DIR}/lib/ed25519/sc.c
  ${MESHCORE_TEST_COMMON_DIR}/lib/ed25519/seed.c
  ${MESHCORE_TEST_COMMON_DIR}/lib/ed25519/sha512.c
  ${MESHCORE_TEST_COMMON_DIR}/lib/ed25519/sign.c
  ${MESHCORE_TEST_COMMON_DIR}/lib/ed25519/verify.c
)

target_compile_definitions(app PRIVATE MESHCORE_ENABLE_TEST_HOOKS)

set_source_files_properties(${MESHCORE_TARGET_C_SOURCES} PROPERTIES
  INCLUDE_DIRECTORIES
  "${MESHCORE_INTERNAL_INCLUDE_DIRS};${MESHCORE_TEST_COMMON_DIR}/include;${MESHCORE_TEST_COMMON_DIR}/lib/Crypto;${MESHCORE_TEST_COMMON_DIR}/lib/ed25519;${CMAKE_CURRENT_LIST_DIR}/include"
)
set_source_files_properties(${MESHCORE_REFERENCE_CPP_SOURCES} PROPERTIES
  COMPILE_OPTIONS "-include;meshcore_reference_prefix.h"
)

zephyr_library_compile_options(
  -Wno-unused-parameter
  -Wno-unused-variable
  $<$<COMPILE_LANGUAGE:CXX>:-Wno-sign-compare>
  $<$<COMPILE_LANGUAGE:CXX>:-Wno-reorder>
  $<$<COMPILE_LANGUAGE:CXX>:-Wno-error>
  $<$<COMPILE_LANGUAGE:CXX>:-Wno-class-memaccess>
)

find_package(Python3 REQUIRED COMPONENTS Interpreter)

execute_process(
  COMMAND ${Python3_EXECUTABLE}
          ${CMAKE_CURRENT_LIST_DIR}/tools/check_test_cases_sync.py
          --src-dir ${CMAKE_CURRENT_LIST_DIR}/src
          --cases ${CMAKE_CURRENT_LIST_DIR}/test_cases.md
  WORKING_DIRECTORY ${CMAKE_CURRENT_LIST_DIR}
  RESULT_VARIABLE MESHCORE_RUNTIME_ORACLE_CASES_RESULT
  OUTPUT_VARIABLE MESHCORE_RUNTIME_ORACLE_CASES_OUTPUT
  ERROR_VARIABLE MESHCORE_RUNTIME_ORACLE_CASES_ERROR
  OUTPUT_STRIP_TRAILING_WHITESPACE
  ERROR_STRIP_TRAILING_WHITESPACE
)

if(NOT MESHCORE_RUNTIME_ORACLE_CASES_RESULT EQUAL 0)
  message(FATAL_ERROR
    "MeshCore runtime oracle test-case sync check failed\n"
    "${MESHCORE_RUNTIME_ORACLE_CASES_OUTPUT}\n"
    "${MESHCORE_RUNTIME_ORACLE_CASES_ERROR}"
  )
endif()

message(STATUS "${MESHCORE_RUNTIME_ORACLE_CASES_OUTPUT}")

add_custom_target(oracle_parity_check_test_cases
  COMMAND ${Python3_EXECUTABLE}
          ${CMAKE_CURRENT_LIST_DIR}/tools/check_test_cases_sync.py
          --src-dir ${CMAKE_CURRENT_LIST_DIR}/src
          --cases ${CMAKE_CURRENT_LIST_DIR}/test_cases.md
  WORKING_DIRECTORY ${CMAKE_CURRENT_LIST_DIR}
  COMMENT "Check oracle_parity ZTEST list is synced with test_cases.md"
  VERBATIM
)
```

## prj.conf
```kconfig
CONFIG_ZTEST=y
CONFIG_ZTEST_SHUFFLE=n
CONFIG_ZTEST_NO_YIELD=y
CONFIG_CPP=y
CONFIG_LOG=n
CONFIG_STD_CPP17=y

CONFIG_HEAP_MEM_POOL_SIZE=8192
CONFIG_MAIN_STACK_SIZE=16384
CONFIG_SYSTEM_WORKQUEUE_STACK_SIZE=8192
CONFIG_IDLE_STACK_SIZE=256
CONFIG_ZTEST_STACK_SIZE=16384

CONFIG_MBEDTLS=y
CONFIG_PSA_CRYPTO=y
CONFIG_MBEDTLS_PSA_CRYPTO_C=y
CONFIG_PSA_CRYPTO_ENABLE_ALL=y
CONFIG_PSA_WANT_ALG_SHA_256=y
CONFIG_PSA_WANT_ALG_ECB_NO_PADDING=y
CONFIG_PSA_WANT_KEY_TYPE_AES=y
```

## include/Arduino.h
```c
#ifndef FOBE_TESTS_LIB_MESHCORE_BLACKBOX_RUNTIME_ORACLE_INCLUDE_ARDUINO_H_
#define FOBE_TESTS_LIB_MESHCORE_BLACKBOX_RUNTIME_ORACLE_INCLUDE_ARDUINO_H_

#include <stdbool.h>
#include <stddef.h>
#include <stdint.h>
#include <stdio.h>
#include <stdlib.h>
#include <string.h>

typedef uint8_t byte;
typedef bool boolean;

#ifdef __cplusplus
template <typename T>
static inline T constrain(T value, T low, T high)
{
	if (value < low) {
		return low;
	}
	if (value > high) {
		return high;
	}
	return value;
}
extern "C" {
#endif

static inline char *ltoa(long value, char *str, int base)
{
	char buf[65];
	char *out = str;
	unsigned long magnitude;
	size_t pos = 0U;

	if (str == NULL || base < 2 || base > 36) {
		return str;
	}

	if (value < 0 && base == 10) {
		*out++ = '-';
		magnitude = (unsigned long)(-value);
	} else {
		magnitude = (unsigned long)value;
	}

	do {
		unsigned long digit = magnitude % (unsigned long)base;

		buf[pos++] = (char)(digit < 10U ? ('0' + digit) : ('a' + (digit - 10U)));
		magnitude /= (unsigned long)base;
	} while (magnitude != 0U);

	while (pos > 0U) {
		*out++ = buf[--pos];
	}
	*out = '\0';
	return str;
}

#ifdef __cplusplus
}
#endif

#endif /* FOBE_TESTS_LIB_MESHCORE_BLACKBOX_RUNTIME_ORACLE_INCLUDE_ARDUINO_H_ */
```

## include/meshcore_reference_prefix.h
```c
#ifndef FOBE_TESTS_LIB_MESHCORE_BLACKBOX_RUNTIME_ORACLE_INCLUDE_MESHCORE_REFERENCE_PREFIX_H_
#define FOBE_TESTS_LIB_MESHCORE_BLACKBOX_RUNTIME_ORACLE_INCLUDE_MESHCORE_REFERENCE_PREFIX_H_

#include <stddef.h>

#endif /* FOBE_TESTS_LIB_MESHCORE_BLACKBOX_RUNTIME_ORACLE_INCLUDE_MESHCORE_REFERENCE_PREFIX_H_ */
```

## src/case_helpers.cpp
```c
// SPDX-License-Identifier: Apache-2.0
/*
 * Copyright (c) 2026 FoBE Studio
 */

#include "case_helpers.h"

#include <errno.h>

static ReferenceChatHarness g_oracle;

ReferenceChatHarness &shared_oracle(void)
{
	return g_oracle;
}

void build_inbound_advert_from_oracle(
	const runtime_fixture_data *fixture,
	ReferenceChatHarness::observed_packet *out_packet)
{
	ReferenceChatHarness source;

	zassert_not_null(fixture, "fixture is null");
	zassert_not_null(out_packet, "out_packet is null");

	source.reset();
	source.set_self_identity(fixture->inbound_identity);
	source.set_node_name("inbound_peer");
	source.set_advert_profile(true, 22.0, 113.0);
	zassert_true(source.send_self_advert(false),
		     "oracle inbound advert build failed");
	zassert_true(source.drive_until_packets_sent(1U),
		     "oracle inbound advert send did not complete");
	zassert_true(source.capture_last_packet(out_packet),
		     "oracle inbound advert packet missing");
}

void build_inbound_path_raw_from_peer(
	const runtime_fixture_data *fixture, uint8_t extra_type,
	const uint8_t *extra, uint8_t extra_len,
	ReferenceChatHarness::observed_packet *out_packet)
{
	ReferenceChatHarness source;

	zassert_not_null(fixture, "fixture is null");
	zassert_not_null(out_packet, "out_packet is null");

	source.reset();
	source.set_self_identity(fixture->peer_identity);
	zassert_true(source.build_inbound_path_raw(
			     fixture->local_identity.identity.pub_key,
			     k_trace_out_path, sizeof(k_trace_out_path), 2U,
			     extra_type, extra, extra_len, 6, out_packet),
		     "oracle inbound path raw build failed");
}

int target_trace_request_from_out_path(
	const uint8_t *public_key, const uint8_t *out_path,
	uint8_t out_path_len, uint8_t path_hash_size, uint32_t *tag)
{
	uint8_t trace_path[MESHCORE_MAX_PATH_LEN] = {};
	uint8_t trace_len = 0U;

	if (public_key == nullptr || out_path == nullptr || out_path_len == 0U ||
	    path_hash_size == 0U || path_hash_size > 3U ||
	    (out_path_len % path_hash_size) != 0U) {
		return -EINVAL;
	}

	memcpy(trace_path, out_path, out_path_len);
	trace_len = out_path_len;
	for (uint8_t hop = out_path_len; hop >= (uint8_t)(2U * path_hash_size);
	     hop = (uint8_t)(hop - path_hash_size)) {
		if ((size_t)trace_len + path_hash_size > sizeof(trace_path)) {
			return -EINVAL;
		}
		memcpy(&trace_path[trace_len],
		       &out_path[hop - (uint8_t)(2U * path_hash_size)],
		       path_hash_size);
		trace_len = (uint8_t)(trace_len + path_hash_size);
	}

	return meshcore_node_trace_request(trace_path, trace_len, path_hash_size, tag);
}

void target_process_until_packets_sent_lenient(uint32_t expected_packets)
{
	uint32_t now_ms = 0U;

	(void)meshcore_timer_fired(now_ms);
	for (int i = 0; i < 24 &&
			meshcore_hal_test_radio_get_packets_sent() < expected_packets;
	     i++) {
		if (meshcore_test_runtime_dispatcher_has_active_outbound()) {
			meshcore_hal_test_radio_on_send_finished();
			(void)meshcore_radio_tx_done(now_ms, true);
		}
		now_ms += 250U;
		meshcore_hal_test_millis_set(now_ms);
		(void)meshcore_timer_fired(now_ms);
	}
	if (meshcore_test_runtime_dispatcher_has_active_outbound()) {
		meshcore_hal_test_radio_on_send_finished();
		(void)meshcore_radio_tx_done(now_ms, true);
	}

	zassert_true(meshcore_hal_test_radio_get_packets_sent() >= expected_packets,
		     "lenient sent packet count mismatch");
	meshcore_hal_test_rng_clear();
}
```

## src/case_helpers.h
```c
// SPDX-License-Identifier: Apache-2.0
/*
 * Copyright (c) 2026 FoBE Studio
 */

#ifndef FOBE_TESTS_LIB_MESHCORE_BLACKBOX_RUNTIME_ORACLE_SRC_CASE_HELPERS_H_
#define FOBE_TESTS_LIB_MESHCORE_BLACKBOX_RUNTIME_ORACLE_SRC_CASE_HELPERS_H_

#include <string.h>

#include "test_support.h"

ReferenceChatHarness &shared_oracle(void);

void build_inbound_advert_from_oracle(
	const runtime_fixture_data *fixture,
	ReferenceChatHarness::observed_packet *out_packet);

void build_inbound_path_raw_from_peer(
	const runtime_fixture_data *fixture, uint8_t extra_type,
	const uint8_t *extra, uint8_t extra_len,
	ReferenceChatHarness::observed_packet *out_packet);

int target_trace_request_from_out_path(
	const uint8_t *public_key, const uint8_t *out_path,
	uint8_t out_path_len, uint8_t path_hash_size, uint32_t *tag);

void target_process_until_packets_sent_lenient(uint32_t expected_packets);

#endif /* FOBE_TESTS_LIB_MESHCORE_BLACKBOX_RUNTIME_ORACLE_SRC_CASE_HELPERS_H_ */
```

## src/cases_negative.cpp
```c
// SPDX-License-Identifier: Apache-2.0
/*
 * Copyright (c) 2026 FoBE Studio
 */

#include "case_helpers.h"

ZTEST(meshcore_runtime_oracle,
      test_no_local_identity_discover_emits_no_outbound_like_oracle)
{
	static const uint8_t k_rng[] = {0x61, 0x62, 0x63, 0x64};
	runtime_fixture_data fixture = setup_target_runtime_fixture();
	ReferenceChatHarness &oracle = shared_oracle();
	int target_init_rc;
	int target_req_rc;

	oracle.reset();
	oracle.set_require_local_identity_for_send(true);
	oracle.set_random_bytes(k_rng, sizeof(k_rng));

	meshcore_hal_test_host_state_reset();
	clear_target_publish_events();
	meshcore_hal_test_millis_set(0U);
	meshcore_hal_test_rtc_set_current_time(0U);
	target_init_rc = meshcore_init();
	meshcore_hal_test_radio_reset();
	target_req_rc = meshcore_node_discover_path_request(
		fixture.peer_identity.identity.pub_key, nullptr);
	if (target_init_rc == 0 && target_req_rc == 0) {
		zassert_ok(meshcore_timer_fired(0U), "target discover process failed");
	}

	zassert_false(oracle.send_discover_request(
			      fixture.peer_identity.identity.pub_key),
		      "oracle discover should fail without local identity");
	zassert_equal(meshcore_hal_test_radio_get_packets_sent(), 0U,
		      "target should not send without local identity");
	zassert_equal(oracle.sent_packets(), 0U,
		      "oracle should not send without local identity");
}

ZTEST(meshcore_runtime_oracle, test_no_path_trace_emits_no_outbound_like_oracle)
{
	runtime_fixture_data fixture = setup_target_runtime_fixture();
	ReferenceChatHarness &oracle = shared_oracle();
	int target_req_rc;

	setup_reference_fixture(&oracle, &fixture);
	zassert_ok(meshcore_init(), "init failed");
	meshcore_hal_test_radio_reset();
	target_req_rc = meshcore_node_trace_path_request(
		fixture.peer_identity.identity.pub_key, nullptr);
	if (target_req_rc == 0) {
		zassert_ok(meshcore_timer_fired(0U), "target trace process failed");
	}

	zassert_false(oracle.send_trace_request(fixture.peer_identity.identity.pub_key),
		      "oracle trace should fail without out-path");
	zassert_equal(meshcore_hal_test_radio_get_packets_sent(), 0U,
		      "target should not send trace without out-path");
	zassert_equal(oracle.sent_packets(), 0U,
		      "oracle should not send trace without out-path");
	zassert_false(meshcore_test_runtime_pending_trace_is_valid(),
		      "target should not register pending trace");
	zassert_false(oracle.pending_trace_active(),
		      "oracle should not register pending trace");
}

ZTEST(meshcore_runtime_oracle,
      test_no_channel_send_group_emits_no_outbound_like_oracle)
{
	static const uint8_t k_unknown_secret_16[16] = {
		0xf1, 0xe2, 0xd3, 0xc4, 0xb5, 0xa6, 0x97, 0x88,
		0x79, 0x6a, 0x5b, 0x4c, 0x3d, 0x2e, 0x1f, 0x10,
	};
	static const uint8_t k_payload[] = {'n', 'o', '_', 'c', 'h'};
	runtime_fixture_data fixture = setup_target_runtime_fixture();
	ReferenceChatHarness &oracle = shared_oracle();
	int target_req_rc;

	setup_reference_fixture(&oracle, &fixture);
	zassert_ok(meshcore_init(), "init failed");
	meshcore_hal_test_radio_reset();
	target_req_rc = meshcore_message_send_to_channel(
		k_unknown_secret_16, sizeof(k_unknown_secret_16),
		k_payload, sizeof(k_payload));
	if (target_req_rc == 0) {
		zassert_ok(meshcore_timer_fired(0U), "target group send process failed");
	}

	zassert_false(oracle.send_group_message(
			      k_unknown_secret_16, sizeof(k_unknown_secret_16),
			      k_payload, sizeof(k_payload)),
		      "oracle should reject unknown group channel secret");
	zassert_equal(meshcore_hal_test_radio_get_packets_sent(), 0U,
		      "target should not send without known channel");
	zassert_equal(oracle.sent_packets(), 0U,
		      "oracle should not send without known channel");
}

ZTEST(meshcore_runtime_oracle,
      test_zz_encrypted_path_ack_extra_keeps_discover_pending_like_oracle)
{
	static const uint8_t k_rng[] = {0x81, 0x82, 0x83, 0x84};
	static const uint8_t k_ack_extra[] = {0x78, 0x56, 0x34, 0x12};
	runtime_fixture_data fixture = setup_target_runtime_fixture();
	ReferenceChatHarness &oracle = shared_oracle();
	ReferenceChatHarness::observed_packet inbound_packet = {};
	meshcore_test_peer_path_event_t target_event = {};
	ReferenceChatHarness::observed_peer_path_event oracle_event = {};
	uint32_t target_sent_packets = 0U;
	uint32_t oracle_sent_packets = 0U;

	setup_reference_fixture(&oracle, &fixture);
	target_set_request_rng_bytes(k_rng, sizeof(k_rng));
	oracle.set_random_bytes(k_rng, sizeof(k_rng));

	zassert_ok(meshcore_init(), "init failed");
	zassert_ok(meshcore_node_discover_path_request(
			   fixture.peer_identity.identity.pub_key, nullptr),
		   "target discover enqueue failed");
	target_process_until_packets_sent(1U);
	zassert_true(meshcore_test_runtime_pending_discovery_is_valid(),
		     "target discover pending missing");
	zassert_true(oracle.send_discover_request(
			     fixture.peer_identity.identity.pub_key),
		     "oracle discover send failed");
	zassert_true(oracle.drive_until_packets_sent(1U), "oracle discover loop failed");
	zassert_true(oracle.pending_discovery_active(),
		     "oracle discover pending missing");

	build_inbound_path_raw_from_peer(&fixture, PAYLOAD_TYPE_ACK, k_ack_extra,
					 sizeof(k_ack_extra), &inbound_packet);

	clear_target_publish_events();
	target_sent_packets = meshcore_hal_test_radio_get_packets_sent();
	oracle_sent_packets = oracle.sent_packets();
	zassert_ok(target_radio_packet_inject(inbound_packet.raw,
					      (size_t)inbound_packet.raw_len, -40,
					      8, 0U),
		   "target encrypted path inject failed");
	(void)meshcore_timer_fired(0U);
	zassert_true(oracle.inject_raw_packet(inbound_packet.raw,
					      (size_t)inbound_packet.raw_len),
		     "oracle encrypted path inject failed");

	zassert_false(target_await_peer_path_event(&target_event, 20),
		      "target ack-extra path should not publish peer-path");
	zassert_false(oracle.capture_last_peer_path_event(&oracle_event),
		      "oracle ack-extra path should not publish peer-path");
	zassert_true(meshcore_test_runtime_pending_discovery_is_valid(),
		     "target discover pending should remain");
	zassert_true(oracle.pending_discovery_active(),
		     "oracle discover pending should remain");
	zassert_equal(meshcore_hal_test_radio_get_packets_sent(), target_sent_packets,
		      "target encrypted path should not emit follow-up packets");
	zassert_equal(oracle.sent_packets(), oracle_sent_packets,
		      "oracle encrypted path should not emit follow-up packets");
}

ZTEST(meshcore_runtime_oracle, test_invalid_inbound_is_ignored_like_oracle)
{
	static const uint8_t k_invalid_raw[] = {0xff};
	runtime_fixture_data fixture = setup_target_runtime_fixture();
	ReferenceChatHarness &oracle = shared_oracle();
	meshcore_test_advert_event_t target_advert_event = {};

	setup_reference_fixture(&oracle, &fixture);
	zassert_ok(meshcore_init(), "init failed");
	clear_target_publish_events();
	meshcore_hal_test_radio_reset();
	zassert_ok(target_radio_packet_inject(k_invalid_raw, sizeof(k_invalid_raw),
					      -35, 7, 0U),
		   "target invalid packet inject failed");
	zassert_ok(meshcore_timer_fired(0U), "target invalid packet process failed");

	zassert_false(oracle.inject_advert(k_invalid_raw, sizeof(k_invalid_raw)),
		      "oracle invalid advert should be ignored");
	zassert_equal(target_advert_recv_count(), 0U,
		      "target should not publish invalid advert");
	zassert_false(target_await_advert_event(&target_advert_event, 20),
		      "target invalid advert should not emit publish");
	zassert_equal(oracle.advert_observed_count(), 0U,
		      "oracle should not observe invalid advert");
	zassert_equal(meshcore_hal_test_radio_get_packets_sent(), 0U,
		      "target invalid inbound should not emit follow-up packets");
	zassert_equal(oracle.sent_packets(), 0U,
		      "oracle invalid inbound should not emit follow-up packets");
}

ZTEST(meshcore_runtime_oracle,
      test_invalid_inbound_req_is_ignored_like_oracle)
{
	static const uint8_t k_invalid_req_raw[] = {
		(uint8_t)((PAYLOAD_TYPE_REQ << PH_TYPE_SHIFT) | ROUTE_TYPE_DIRECT),
		0x00,
	};
	runtime_fixture_data fixture = setup_target_runtime_fixture();
	ReferenceChatHarness &oracle = shared_oracle();
	meshcore_test_advert_event_t target_advert_event = {};
	meshcore_test_peer_path_event_t target_peer_path_event = {};
	meshcore_test_trace_event_t target_trace_event = {};
	meshcore_test_telemetry_event_t target_telemetry_event = {};

	setup_reference_fixture(&oracle, &fixture);
	zassert_ok(meshcore_init(), "init failed");
	clear_target_publish_events();
	meshcore_hal_test_radio_reset();
	zassert_ok(target_radio_packet_inject(k_invalid_req_raw,
					      sizeof(k_invalid_req_raw), -44, 6, 0U),
		   "target invalid req inject failed");
	(void)meshcore_timer_fired(0U);

	zassert_false(oracle.inject_raw_packet(k_invalid_req_raw,
					       sizeof(k_invalid_req_raw)),
		      "oracle invalid req should be ignored");
	zassert_false(target_await_advert_event(&target_advert_event, 20),
		      "target invalid req should not publish advert");
	zassert_false(target_await_peer_path_event(&target_peer_path_event, 20),
		      "target invalid req should not publish peer-path");
	zassert_false(target_await_trace_event(&target_trace_event, 20),
		      "target invalid req should not publish trace");
	zassert_false(target_await_telemetry_event(&target_telemetry_event, 20),
		      "target invalid req should not publish telemetry");
	zassert_equal(meshcore_hal_test_radio_get_packets_sent(), 0U,
		      "target invalid req should not emit follow-up packets");
	zassert_equal(oracle.sent_packets(), 0U,
		      "oracle invalid req should not emit follow-up packets");
}

ZTEST(meshcore_runtime_oracle,
      test_invalid_inbound_response_keeps_telemetry_pending_like_oracle)
{
	static const uint8_t k_rng[] = {0x8a, 0x8b, 0x8c, 0x8d};
	static const uint8_t k_invalid_response_raw[] = {
		(uint8_t)((PAYLOAD_TYPE_RESPONSE << PH_TYPE_SHIFT) |
			  ROUTE_TYPE_DIRECT),
		0x00,
	};
	runtime_fixture_data fixture = setup_target_runtime_fixture();
	ReferenceChatHarness &oracle = shared_oracle();
	meshcore_test_telemetry_event_t target_telemetry_event = {};
	uint32_t target_sent_packets = 0U;
	uint32_t oracle_sent_packets = 0U;

	setup_reference_fixture(&oracle, &fixture);
	target_set_request_rng_bytes(k_rng, sizeof(k_rng));
	oracle.set_random_bytes(k_rng, sizeof(k_rng));

	zassert_ok(meshcore_init(), "init failed");
	zassert_ok(meshcore_node_telemetry_request(
			   fixture.peer_identity.identity.pub_key,
			   MESHCORE_TELEM_PERM_BASE, NULL),
		   "target telemetry enqueue failed");
	target_process_until_packets_sent(1U);
	zassert_true(meshcore_test_runtime_pending_telemetry_is_valid(),
		     "target pending telemetry missing");
	zassert_true(oracle.send_telemetry_request(
			     fixture.peer_identity.identity.pub_key,
			     MESHCORE_TELEM_PERM_BASE),
		     "oracle telemetry send failed");
	zassert_true(oracle.drive_until_packets_sent(1U),
		     "oracle telemetry loop failed");
	zassert_true(oracle.pending_telemetry_active(),
		     "oracle pending telemetry missing");

	clear_target_publish_events();
	target_sent_packets = meshcore_hal_test_radio_get_packets_sent();
	oracle_sent_packets = oracle.sent_packets();
	zassert_ok(target_radio_packet_inject(k_invalid_response_raw,
					      sizeof(k_invalid_response_raw), -47,
					      5, 0U),
		   "target invalid response inject failed");
	(void)meshcore_timer_fired(0U);
	zassert_false(oracle.inject_raw_packet(k_invalid_response_raw,
					       sizeof(k_invalid_response_raw)),
		      "oracle invalid response should be ignored");

	zassert_false(target_await_telemetry_event(&target_telemetry_event, 20),
		      "target invalid response should not publish telemetry");
	zassert_true(meshcore_test_runtime_pending_telemetry_is_valid(),
		     "target pending telemetry should remain");
	zassert_true(oracle.pending_telemetry_active(),
		     "oracle pending telemetry should remain");
	zassert_equal(meshcore_hal_test_radio_get_packets_sent(), target_sent_packets,
		      "target invalid response should not emit follow-up packets");
	zassert_equal(oracle.sent_packets(), oracle_sent_packets,
		      "oracle invalid response should not emit follow-up packets");
	zassert_equal(oracle.telemetry_publish_count(), 0U,
		      "oracle invalid response should not publish");
}

ZTEST(meshcore_runtime_oracle,
      test_invalid_inbound_path_is_ignored_like_oracle)
{
	static const uint8_t k_invalid_path_raw[] = {
		(uint8_t)((PAYLOAD_TYPE_PATH << PH_TYPE_SHIFT) | ROUTE_TYPE_DIRECT),
		0x00,
	};
	runtime_fixture_data fixture = setup_target_runtime_fixture();
	ReferenceChatHarness &oracle = shared_oracle();
	meshcore_test_peer_path_event_t target_peer_path_event = {};
	uint32_t target_sent_packets = 0U;
	uint32_t oracle_sent_packets = 0U;

	setup_reference_fixture(&oracle, &fixture);
	zassert_ok(meshcore_init(), "init failed");
	zassert_ok(meshcore_node_discover_path_request(
			   fixture.peer_identity.identity.pub_key, nullptr),
		   "target discover enqueue failed");
	target_process_until_packets_sent(1U);
	zassert_true(meshcore_test_runtime_pending_discovery_is_valid(),
		     "target pending discovery missing");
	zassert_true(oracle.send_discover_request(
			     fixture.peer_identity.identity.pub_key),
		     "oracle discover send failed");
	zassert_true(oracle.drive_until_packets_sent(1U), "oracle discover loop failed");
	zassert_true(oracle.pending_discovery_active(),
		     "oracle pending discovery missing");

	clear_target_publish_events();
	target_sent_packets = meshcore_hal_test_radio_get_packets_sent();
	oracle_sent_packets = oracle.sent_packets();
	zassert_ok(target_radio_packet_inject(k_invalid_path_raw,
					      sizeof(k_invalid_path_raw), -46, 5, 0U),
		   "target invalid path inject failed");
	(void)meshcore_timer_fired(0U);
	zassert_false(oracle.inject_raw_packet(k_invalid_path_raw,
					       sizeof(k_invalid_path_raw)),
		      "oracle invalid path should be ignored");

	zassert_false(target_await_peer_path_event(&target_peer_path_event, 20),
		      "target invalid path should not publish peer-path");
	zassert_true(meshcore_test_runtime_pending_discovery_is_valid(),
		     "target pending discovery should remain");
	zassert_true(oracle.pending_discovery_active(),
		     "oracle pending discovery should remain");
	zassert_equal(meshcore_hal_test_radio_get_packets_sent(), target_sent_packets,
		      "target invalid path should not emit follow-up packets");
	zassert_equal(oracle.sent_packets(), oracle_sent_packets,
		      "oracle invalid path should not emit follow-up packets");
	zassert_equal(oracle.peer_path_publish_count(), 0U,
		      "oracle invalid path should not publish");
}

ZTEST(meshcore_runtime_oracle,
      test_invalid_inbound_trace_is_ignored_like_oracle)
{
	static const uint8_t k_invalid_trace_raw[] = {
		(uint8_t)((PAYLOAD_TYPE_TRACE << PH_TYPE_SHIFT) | ROUTE_TYPE_DIRECT),
		0x00,
	};
	runtime_fixture_data fixture = setup_target_runtime_fixture();
	ReferenceChatHarness &oracle = shared_oracle();
	meshcore_test_trace_event_t target_trace_event = {};
	uint32_t target_sent_packets = 0U;
	uint32_t oracle_sent_packets = 0U;

	setup_reference_fixture(&oracle, &fixture);
	target_set_peer_out_path(fixture.peer_identity.identity.pub_key, k_trace_out_path,
				 sizeof(k_trace_out_path), 1U);
	zassert_true(oracle.set_contact_out_path(fixture.peer_identity.identity.pub_key,
						 k_trace_out_path,
						 sizeof(k_trace_out_path), 1U),
		     "oracle trace path install failed");

	zassert_ok(meshcore_init(), "init failed");
	zassert_ok(target_trace_request_from_out_path(
			   fixture.peer_identity.identity.pub_key,
			   k_trace_out_path, sizeof(k_trace_out_path), 1U,
			   nullptr),
		   "target trace enqueue failed");
	target_process_until_packets_sent(1U);
	zassert_true(meshcore_test_runtime_pending_trace_is_valid(),
		     "target pending trace missing");
	zassert_true(oracle.send_trace_request(fixture.peer_identity.identity.pub_key),
		     "oracle trace send failed");
	zassert_true(oracle.drive_until_packets_sent(1U), "oracle trace loop failed");
	zassert_true(oracle.pending_trace_active(), "oracle pending trace missing");

	clear_target_publish_events();
	target_sent_packets = meshcore_hal_test_radio_get_packets_sent();
	oracle_sent_packets = oracle.sent_packets();
	zassert_ok(target_radio_packet_inject(k_invalid_trace_raw,
					      sizeof(k_invalid_trace_raw), -49, 4,
					      0U),
		   "target invalid trace inject failed");
	(void)meshcore_timer_fired(0U);
	zassert_false(oracle.inject_raw_packet(k_invalid_trace_raw,
					       sizeof(k_invalid_trace_raw)),
		      "oracle invalid trace should be ignored");

	zassert_false(target_await_trace_event(&target_trace_event, 20),
		      "target invalid trace should not publish");
	zassert_true(meshcore_test_runtime_pending_trace_is_valid(),
		     "target pending trace should remain");
	zassert_true(oracle.pending_trace_active(),
		     "oracle pending trace should remain");
	zassert_equal(meshcore_hal_test_radio_get_packets_sent(), target_sent_packets,
		      "target invalid trace should not emit follow-up packets");
	zassert_equal(oracle.sent_packets(), oracle_sent_packets,
		      "oracle invalid trace should not emit follow-up packets");
	zassert_equal(oracle.trace_publish_count(), 0U,
		      "oracle invalid trace should not publish");
}

ZTEST(meshcore_runtime_oracle,
      test_inbound_advert_is_observed_without_followup_like_oracle)
{
	runtime_fixture_data fixture = setup_target_runtime_fixture();
	ReferenceChatHarness &oracle = shared_oracle();
	ReferenceChatHarness::observed_packet inbound_packet = {};
	meshcore_test_advert_event_t target_event = {};
	ReferenceChatHarness::observed_advert_event oracle_event = {};

	setup_reference_fixture(&oracle, &fixture);
	build_inbound_advert_from_oracle(&fixture, &inbound_packet);

	zassert_ok(meshcore_init(), "init failed");
	zassert_ok(target_radio_packet_inject(inbound_packet.raw,
					      (size_t)inbound_packet.raw_len, -45,
					      12, 0U),
		   "target advert inject failed");
	zassert_ok(meshcore_timer_fired(0U), "target advert process failed");
	zassert_true(oracle.inject_advert(inbound_packet.raw,
					  (size_t)inbound_packet.raw_len),
		     "oracle advert inject failed");

	zassert_equal(target_advert_recv_count(), 1U,
		      "target advert receive count mismatch");
	zassert_equal(oracle.advert_observed_count(), 1U,
		      "oracle advert observe count mismatch");
	zassert_true(oracle.capture_last_advert_event(&oracle_event),
		     "oracle advert event missing");
	zassert_true(target_await_advert_event(&target_event, 20),
		     "target advert event missing");
	assert_advert_events_equal(&target_event, &oracle_event,
				   "inbound advert");
	zassert_equal(meshcore_hal_test_radio_get_packets_sent(), 0U,
		      "target advert should not emit follow-up packets");
	zassert_equal(oracle.sent_packets(), 0U,
		      "oracle advert should not emit follow-up packets");
	zassert_equal(oracle.getNumContacts(), 2, "oracle contact count mismatch");
	zassert_mem_equal(oracle_event.public_key,
			  fixture.inbound_identity.identity.pub_key,
			  sizeof(oracle_event.public_key),
			  "oracle inbound public key mismatch");
}
```

## src/cases_receive_discover.cpp
```c
// SPDX-License-Identifier: Apache-2.0
/*
 * Copyright (c) 2026 FoBE Studio
 */

#include "case_helpers.h"

ZTEST(meshcore_runtime_oracle, test_discover_response_publish_matches_oracle)
{
	static const uint8_t k_rng[] = {0x44, 0x45, 0x46, 0x47};
	runtime_fixture_data fixture = setup_target_runtime_fixture();
	ReferenceChatHarness &oracle = shared_oracle();
	meshcore_test_peer_path_event_t target_event = {};
	ReferenceChatHarness::observed_peer_path_event oracle_event = {};
	uint32_t target_discover_tag = 0U;

	setup_reference_fixture(&oracle, &fixture);
	target_set_request_rng_bytes(k_rng, sizeof(k_rng));
	oracle.set_random_bytes(k_rng, sizeof(k_rng));

	zassert_ok(meshcore_init(), "init failed");
	zassert_ok(meshcore_node_discover_path_request(
			   fixture.peer_identity.identity.pub_key, nullptr),
		   "target discover enqueue failed");
	target_process_until_packets_sent(1U);
	zassert_true(meshcore_test_runtime_pending_discovery_get(
			     &target_discover_tag, nullptr, nullptr),
		     "target pending discovery missing");
	zassert_true(oracle.send_discover_request(
			     fixture.peer_identity.identity.pub_key),
		     "oracle discover failed");
	zassert_true(oracle.drive_until_packets_sent(1U), "oracle discover send failed");
	zassert_true(oracle.pending_discovery_active(),
		     "oracle pending discovery missing");

	clear_target_publish_events();
	zassert_true(meshcore_test_runtime_simulate_peer_path_recv(
			     fixture.peer_identity.identity.pub_key, k_trace_out_path,
			     sizeof(k_trace_out_path), 2U, PAYLOAD_TYPE_RESPONSE,
			     (const int8_t *)&target_discover_tag,
			     sizeof(target_discover_tag), nullptr, 0U, 9),
		     "target discover response simulation failed");
	zassert_true(oracle.inject_discover_response(
			     fixture.peer_identity.identity.pub_key, k_trace_out_path,
			     sizeof(k_trace_out_path), 2U, nullptr, 0U, nullptr,
			     0U, 9),
		     "oracle discover response inject failed");

	zassert_true(target_await_peer_path_event(&target_event, 100),
		     "target peer-path publish missing");
	zassert_true(oracle.capture_last_peer_path_event(&oracle_event),
		     "oracle peer-path publish missing");
	zassert_false(meshcore_test_runtime_pending_discovery_is_valid(),
		      "target pending discovery should clear");
	zassert_false(oracle.pending_discovery_active(),
		      "oracle pending discovery should clear");
	assert_peer_path_events_equal(&target_event, &oracle_event,
				      "discover response publish");
}

ZTEST(meshcore_runtime_oracle,
      test_discover_response_without_snr_publish_matches_oracle)
{
	runtime_fixture_data fixture = setup_target_runtime_fixture();
	ReferenceChatHarness &oracle = shared_oracle();
	meshcore_test_peer_path_event_t target_event = {};
	ReferenceChatHarness::observed_peer_path_event oracle_event = {};
	uint32_t target_discover_tag = 0U;

	setup_reference_fixture(&oracle, &fixture);

	zassert_ok(meshcore_init(), "init failed");
	zassert_ok(meshcore_node_discover_path_request(
			   fixture.peer_identity.identity.pub_key, nullptr),
		   "target discover enqueue failed");
	target_process_until_packets_sent(1U);
	zassert_true(meshcore_test_runtime_pending_discovery_get(
			     &target_discover_tag, nullptr, nullptr),
		     "target pending discovery missing");
	zassert_true(oracle.send_discover_request(
			     fixture.peer_identity.identity.pub_key),
		     "oracle discover failed");
	zassert_true(oracle.drive_until_packets_sent(1U), "oracle discover send failed");
	zassert_true(oracle.pending_discovery_active(),
		     "oracle pending discovery missing");

	clear_target_publish_events();
	zassert_true(meshcore_test_runtime_simulate_peer_path_recv(
			     fixture.peer_identity.identity.pub_key, k_trace_out_path,
			     sizeof(k_trace_out_path), 2U, PAYLOAD_TYPE_RESPONSE,
			     (const int8_t *)&target_discover_tag,
			     sizeof(target_discover_tag), nullptr, 0U, 5),
		     "target discover plain response simulation failed");
	zassert_true(oracle.inject_discover_response(
			     fixture.peer_identity.identity.pub_key, k_trace_out_path,
			     sizeof(k_trace_out_path), 2U, nullptr, 0U, nullptr,
			     0U, 5),
		     "oracle discover plain response inject failed");

	zassert_true(target_await_peer_path_event(&target_event, 100),
		     "target peer-path publish missing");
	zassert_true(oracle.capture_last_peer_path_event(&oracle_event),
		     "oracle peer-path publish missing");
	zassert_false(meshcore_test_runtime_pending_discovery_is_valid(),
		      "target pending discovery should clear");
	zassert_false(oracle.pending_discovery_active(),
		      "oracle pending discovery should clear");
	assert_peer_path_events_equal(&target_event, &oracle_event,
				      "discover response plain publish");
}

ZTEST(meshcore_runtime_oracle,
      test_discover_response_wrong_peer_is_ignored_like_oracle)
{
	runtime_fixture_data fixture = setup_target_runtime_fixture();
	ReferenceChatHarness &oracle = shared_oracle();
	meshcore_test_peer_path_event_t target_event = {};
	ReferenceChatHarness::observed_peer_path_event oracle_event = {};

	setup_reference_fixture(&oracle, &fixture);
	zassert_true(oracle.upsert_contact(fixture.inbound_identity.identity.pub_key,
					   "runtime_other", ADV_TYPE_CHAT),
		     "oracle secondary contact install failed");

	zassert_ok(meshcore_init(), "init failed");
	zassert_ok(meshcore_node_discover_path_request(
			   fixture.peer_identity.identity.pub_key, nullptr),
		   "target discover enqueue failed");
	target_process_until_packets_sent(1U);
	zassert_true(oracle.send_discover_request(
			     fixture.peer_identity.identity.pub_key),
		     "oracle discover failed");
	zassert_true(oracle.drive_until_packets_sent(1U), "oracle discover send failed");

	clear_target_publish_events();
	zassert_false(meshcore_test_runtime_simulate_peer_path_recv(
			      fixture.inbound_identity.identity.pub_key,
			      k_trace_out_path, sizeof(k_trace_out_path), 2U,
			      PAYLOAD_TYPE_RESPONSE, nullptr, 0U, nullptr, 0U, 6),
		      "target wrong-peer discover should be ignored");
	zassert_true(oracle.inject_discover_response_for(
			     fixture.inbound_identity.identity.pub_key,
			     k_trace_out_path, sizeof(k_trace_out_path), 2U,
			     PAYLOAD_TYPE_RESPONSE, nullptr, 0U, 6),
		     "oracle wrong-peer discover inject failed");

	zassert_false(target_await_peer_path_event(&target_event, 20),
		      "target wrong-peer discover should not publish");
	zassert_false(oracle.capture_last_peer_path_event(&oracle_event),
		      "oracle wrong-peer discover should not publish");
	zassert_true(meshcore_test_runtime_pending_discovery_is_valid(),
		     "target pending discovery should remain");
	zassert_true(oracle.pending_discovery_active(),
		     "oracle pending discovery should remain");
	zassert_equal(oracle.peer_path_publish_count(), 0U,
		      "oracle peer-path publish count mismatch");
}

ZTEST(meshcore_runtime_oracle,
      test_discover_duplicate_response_after_completion_is_ignored_like_oracle)
{
	runtime_fixture_data fixture = setup_target_runtime_fixture();
	ReferenceChatHarness &oracle = shared_oracle();
	meshcore_test_peer_path_event_t target_event = {};
	ReferenceChatHarness::observed_peer_path_event oracle_event = {};
	uint32_t oracle_publish_count = 0U;
	uint32_t target_discover_tag = 0U;

	setup_reference_fixture(&oracle, &fixture);

	zassert_ok(meshcore_init(), "init failed");
	zassert_ok(meshcore_node_discover_path_request(
			   fixture.peer_identity.identity.pub_key, nullptr),
		   "target discover enqueue failed");
	target_process_until_packets_sent(1U);
	zassert_true(meshcore_test_runtime_pending_discovery_get(
			     &target_discover_tag, nullptr, nullptr),
		     "target pending discovery missing");
	zassert_true(oracle.send_discover_request(
			     fixture.peer_identity.identity.pub_key),
		     "oracle discover failed");
	zassert_true(oracle.drive_until_packets_sent(1U), "oracle discover send failed");
	zassert_true(oracle.pending_discovery_active(),
		     "oracle pending discovery missing");

	clear_target_publish_events();
	zassert_true(meshcore_test_runtime_simulate_peer_path_recv(
			     fixture.peer_identity.identity.pub_key, k_trace_out_path,
			     sizeof(k_trace_out_path), 2U, PAYLOAD_TYPE_RESPONSE,
			     (const int8_t *)&target_discover_tag,
			     sizeof(target_discover_tag), nullptr, 0U, 5),
		     "target discover first response simulation failed");
	zassert_true(oracle.inject_discover_response(
			     fixture.peer_identity.identity.pub_key, k_trace_out_path,
			     sizeof(k_trace_out_path), 2U, nullptr, 0U, nullptr,
			     0U, 5),
		     "oracle discover first response inject failed");

	zassert_true(target_await_peer_path_event(&target_event, 100),
		     "target discover publish missing");
	zassert_true(oracle.capture_last_peer_path_event(&oracle_event),
		     "oracle discover publish missing");
	assert_peer_path_events_equal(&target_event, &oracle_event,
				      "discover duplicate first publish");
	zassert_false(meshcore_test_runtime_pending_discovery_is_valid(),
		      "target pending discovery should clear");
	zassert_false(oracle.pending_discovery_active(),
		      "oracle pending discovery should clear");

	clear_target_publish_events();
	oracle_publish_count = oracle.peer_path_publish_count();
	zassert_false(meshcore_test_runtime_simulate_peer_path_recv(
			      fixture.peer_identity.identity.pub_key,
			      k_trace_out_path, sizeof(k_trace_out_path), 2U,
			      PAYLOAD_TYPE_RESPONSE, nullptr, 0U, nullptr, 0U, 5),
		      "target duplicate discover should be ignored");
	zassert_true(oracle.inject_discover_response_for(
			     fixture.peer_identity.identity.pub_key,
			     k_trace_out_path, sizeof(k_trace_out_path), 2U,
			     PAYLOAD_TYPE_RESPONSE, nullptr, 0U, 5),
		     "oracle duplicate discover inject failed");

	zassert_false(target_await_peer_path_event(&target_event, 20),
		      "target duplicate discover should not republish");
	zassert_false(meshcore_test_runtime_pending_discovery_is_valid(),
		      "target pending discovery should stay cleared");
	zassert_false(oracle.pending_discovery_active(),
		      "oracle pending discovery should stay cleared");
	zassert_equal(oracle.peer_path_publish_count(), oracle_publish_count,
		      "oracle duplicate discover should not republish");
}

ZTEST(meshcore_runtime_oracle,
      test_discover_no_response_timeout_clears_pending_like_oracle)
{
	static const uint8_t k_rng[] = {0x35, 0x36, 0x37, 0x38};
	runtime_fixture_data fixture = setup_target_runtime_fixture();
	ReferenceChatHarness &oracle = shared_oracle();
	meshcore_test_peer_path_event_t target_event = {};
	unsigned long target_expires_at = 0U;
	unsigned long oracle_advance_ms = 0U;
	uint32_t target_process_ms = 0U;

	setup_reference_fixture(&oracle, &fixture);
	target_set_request_rng_bytes(k_rng, sizeof(k_rng));
	oracle.set_random_bytes(k_rng, sizeof(k_rng));

	zassert_ok(meshcore_init(), "init failed");
	zassert_ok(meshcore_node_discover_path_request(
			   fixture.peer_identity.identity.pub_key, nullptr),
		   "target discover enqueue failed");
	target_process_until_packets_sent(1U);
	zassert_true(meshcore_test_runtime_pending_discovery_get(
			     nullptr, nullptr, &target_expires_at),
		     "target pending discovery missing");
	zassert_true(oracle.send_discover_request(
			     fixture.peer_identity.identity.pub_key),
		     "oracle discover failed");
	zassert_true(oracle.drive_until_packets_sent(1U), "oracle discover send failed");
	zassert_true(oracle.pending_discovery_active(),
		     "oracle pending discovery missing");

	clear_target_publish_events();
	target_process_ms = (uint32_t)(target_expires_at + 1U);
	meshcore_hal_test_millis_set(target_expires_at + 1U);
	zassert_ok(meshcore_timer_fired(target_process_ms),
		   "target discover timeout process failed");

	oracle_advance_ms = oracle.pending_discovery_expires_at() + 1U;
	oracle.advance_time(oracle_advance_ms);

	zassert_false(target_await_peer_path_event(&target_event, 20),
		      "target discover timeout should not publish");
	zassert_false(meshcore_test_runtime_pending_discovery_is_valid(),
		      "target pending discovery should timeout clear");
	zassert_false(oracle.pending_discovery_active(),
		      "oracle pending discovery should timeout clear");
	zassert_equal(oracle.peer_path_publish_count(), 0U,
		      "oracle discover timeout should not publish");
}

ZTEST(meshcore_runtime_oracle,
      test_discover_same_surface_overwrites_like_oracle)
{
	runtime_fixture_data fixture = setup_target_runtime_fixture();
	ReferenceChatHarness &oracle = shared_oracle();
	meshcore_test_peer_path_event_t target_event = {};
	ReferenceChatHarness::observed_peer_path_event oracle_event = {};
	uint8_t target_pending_prefix[MESHCORE_NODE_KEY_PREFIX_BYTES] = {0};
	uint8_t oracle_pending_prefix[MESHCORE_NODE_KEY_PREFIX_BYTES] = {0};
	uint8_t old_oracle_extra[sizeof(uint32_t)] = {0};
	uint32_t target_tag_first = 0U;
	uint32_t target_tag_second = 0U;
	uint32_t oracle_tag_first = 0U;
	uint32_t oracle_tag_second = 0U;

	setup_reference_fixture(&oracle, &fixture);

	zassert_ok(meshcore_init(), "init failed");
	zassert_ok(meshcore_node_discover_path_request(
			   fixture.peer_identity.identity.pub_key, nullptr),
		   "target discover #1 enqueue failed");
	target_process_until_packets_sent_lenient(1U);
	zassert_true(oracle.send_discover_request(
			     fixture.peer_identity.identity.pub_key),
		     "oracle discover #1 failed");
	zassert_true(oracle.drive_until_packets_sent(1U),
		     "oracle discover #1 send failed");

	zassert_true(meshcore_test_runtime_pending_discovery_get(
			     &target_tag_first, target_pending_prefix, nullptr),
		     "target discover #1 pending missing");
	zassert_true(oracle.pending_discovery_get(oracle_pending_prefix,
						  &oracle_tag_first),
		     "oracle discover #1 pending missing");
	zassert_mem_equal(target_pending_prefix, fixture.peer_identity.identity.pub_key,
			  sizeof(target_pending_prefix),
			  "target discover #1 prefix mismatch");
	zassert_mem_equal(oracle_pending_prefix, fixture.peer_identity.identity.pub_key,
			  sizeof(oracle_pending_prefix),
			  "oracle discover #1 prefix mismatch");
	zassert_ok(meshcore_node_discover_path_request(
			   fixture.peer_identity.identity.pub_key, nullptr),
		   "target discover #2 enqueue failed");
	target_process_until_packets_sent_lenient(2U);
	zassert_true(oracle.send_discover_request(
			     fixture.peer_identity.identity.pub_key),
		     "oracle discover #2 failed");
	zassert_true(oracle.drive_until_packets_sent(2U),
		     "oracle discover #2 send failed");

	memset(target_pending_prefix, 0, sizeof(target_pending_prefix));
	memset(oracle_pending_prefix, 0, sizeof(oracle_pending_prefix));
	zassert_true(meshcore_test_runtime_pending_discovery_get(
			     &target_tag_second, target_pending_prefix, nullptr),
		     "target discover #2 pending missing");
	zassert_true(oracle.pending_discovery_get(oracle_pending_prefix,
						  &oracle_tag_second),
		     "oracle discover #2 pending missing");
	zassert_mem_equal(target_pending_prefix, fixture.peer_identity.identity.pub_key,
			  sizeof(target_pending_prefix),
			  "target discover #2 prefix mismatch");
	zassert_mem_equal(oracle_pending_prefix, fixture.peer_identity.identity.pub_key,
			  sizeof(oracle_pending_prefix),
			  "oracle discover #2 prefix mismatch");
	zassert_not_equal(target_tag_second, target_tag_first,
			  "target discover #2 should replace the tag");
	zassert_not_equal(oracle_tag_second, oracle_tag_first,
			  "oracle discover #2 should replace the tag");

	memcpy(old_oracle_extra, &oracle_tag_first, sizeof(oracle_tag_first));
	clear_target_publish_events();
	zassert_false(meshcore_test_runtime_simulate_peer_path_recv(
			      fixture.peer_identity.identity.pub_key,
			      k_trace_out_path, sizeof(k_trace_out_path), 2U,
			      PAYLOAD_TYPE_RESPONSE,
			      (const int8_t *)&target_tag_first,
			      sizeof(target_tag_first), nullptr, 0U, 8),
		      "target discover #1 response should be ignored");
	zassert_true(oracle.inject_discover_response_for(
			     fixture.peer_identity.identity.pub_key,
			     k_trace_out_path, sizeof(k_trace_out_path), 2U,
			     PAYLOAD_TYPE_RESPONSE, old_oracle_extra,
			     sizeof(old_oracle_extra), 8),
		     "oracle discover #1 response inject failed");
	zassert_false(target_await_peer_path_event(&target_event, 20),
		      "target discover #1 response should not publish");
	zassert_false(oracle.capture_last_peer_path_event(&oracle_event),
		      "oracle discover #1 response should not publish");
	zassert_true(meshcore_test_runtime_pending_discovery_is_valid(),
		     "target discover #2 pending should remain");
	zassert_true(oracle.pending_discovery_active(),
		     "oracle discover #2 pending should remain");

	clear_target_publish_events();
	zassert_true(meshcore_test_runtime_simulate_peer_path_recv(
			     fixture.peer_identity.identity.pub_key,
			     k_trace_out_path, sizeof(k_trace_out_path), 2U,
			     PAYLOAD_TYPE_RESPONSE,
			     (const int8_t *)&target_tag_second,
			     sizeof(target_tag_second), nullptr, 0U, 8),
		     "target discover #2 response simulation failed");
	zassert_true(oracle.inject_discover_response(
			     fixture.peer_identity.identity.pub_key,
			     k_trace_out_path, sizeof(k_trace_out_path), 2U,
			     nullptr, 0U, nullptr, 0U, 8),
		     "oracle discover #2 response inject failed");

	zassert_true(target_await_peer_path_event(&target_event, 100),
		     "target discover #2 publish missing");
	zassert_true(oracle.capture_last_peer_path_event(&oracle_event),
		     "oracle discover #2 publish missing");
	zassert_false(meshcore_test_runtime_pending_discovery_is_valid(),
		      "target discover pending should clear");
	zassert_false(oracle.pending_discovery_active(),
		      "oracle discover pending should clear");
	assert_peer_path_events_equal(&target_event, &oracle_event,
				      "discover overwrite response");
}
```

## src/suite_runtime_oracle.cpp
```c
// SPDX-License-Identifier: Apache-2.0
/*
 * Copyright (c) 2026 FoBE Studio
 */

#include "case_helpers.h"

static void *meshcore_runtime_oracle_setup(void)
{
	reset_target_runtime_state();
	return NULL;
}

static void meshcore_runtime_oracle_before(void *fixture)
{
	ARG_UNUSED(fixture);
	reset_target_runtime_state();
}

ZTEST_SUITE(meshcore_runtime_oracle, NULL, meshcore_runtime_oracle_setup,
	    meshcore_runtime_oracle_before, NULL, NULL);
```
